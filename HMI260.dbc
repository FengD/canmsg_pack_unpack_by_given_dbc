VERSION ""

NS_ :

BS_:

BU_:
VAL_TABLE_ Eyeq_Fatal_Error 70 "APP_PATTERN_TEST" 52 "APP_I2C_TIMEOUT_ERROR" 51 "APP_I2C_CAMERA_SELF_RESET" 50 "APP_I2C_VIDEO_GRAB_FAILED" 21 "APP_INIT_CAMERA_INIT" 20 "APP_INIT_FAILED" 11 "APP_CALIBRATION_ERROR" 10 "APP_FS_ERROR" 1 "APP_ERROR" 0 "APP_OK" ;
VAL_TABLE_ Eyeq_Main_Status 172 "running tac2" 170 "running burn" 146 "pending vision" 133 "pending tac2" 130 "pending spc" 34 "running spc" 3 "boot" 2 "running vision" 1 "pending" 0 "unkown" ;
VAL_TABLE_ Phi_Line_Right_Valid 1 "Valid" 0 "Invalid" ;
VAL_TABLE_ Phi_Line_Left_Valid 1 "Valid" 0 "Invalid" ;
VAL_TABLE_ Cut_In_Cut_Out 8 "Next Cut Out Right" 7 "Next Cut Out Left" 6 "Next Cut In Right" 5 "Next Cut In Left" 4 "Host Cut Out Right" 3 "Host Cut Out Left" 2 "Host Cut In Right" 1 "Host Cut In Left" 0 "Unknown" ;
VAL_TABLE_ Lane_Movement_Type 2 "Moving Right" 1 "Moving Left" 0 "Unknown" ;
VAL_TABLE_ Brake_Light 2 "Off" 1 "On" 0 "Not available" ;
VAL_TABLE_ RightAnglePredicted 1 "True" 0 "False" ;
VAL_TABLE_ LeftAnglePredicted 1 "True" 0 "False" ;
VAL_TABLE_ Turn_Indicator 4 "Both" 3 "Right" 2 "Left" 1 "Off" 0 "Not available" ;
VAL_TABLE_ Lane_Assignment 5 "Next next Lane right" 4 "Next next Lane left" 3 "Next Lane right" 2 "Next Lane left" 1 "Ego Lane" 0 "Not assigned" ;
VAL_TABLE_ Motion_Status 8 "Moving (Oncoming )" 7 "Unknown (Oncoming )" 6 "Stopped (Oncoming )" 5 "Moving (movable)" 4 "Unknown (movable)" 3 "Stopped (movable)" 2 "Parked (never moved, back lights are off)" 1 "Standing (never moved back lights are on)" 0 "Not Defined" ;
VAL_TABLE_ Object_Class 6 "Undecided" 5 "Pedestrian" 4 "Bicycle" 3 "MotorBike" 2 "Car" 1 "Truck" 0 "Unknown" ;

BO_ 3221225472 VECTOR__INDEPENDENT_SIG_MSG: 0 Vector__XXX
 SG_ CS_zero_Byte : 0|8@1- (1,0) [0|0] "" Vector__XXX
 SG_ FS_SafetySuppress : 0|4@1+ (1,0) [0|15] "enum" Vector__XXX
 SG_ FCW_CRC : 0|16@1+ (1,0) [0|0] "" Vector__XXX
 SG_ FCW_reserved3 : 0|2@1+ (1,0) [0|0] "" Vector__XXX
 SG_ SPI_VIS_OBS_TTC_WITH_ACC : 0|10@1+ (0.01,0) [0|7] "sec" Vector__XXX
 SG_ FCW_reserved1 : 0|2@1+ (1,0) [0|0] "" Vector__XXX
 SG_ FCW_VO_FCW_SUPPRESSIONS_SETB : 0|18@1+ (1,0) [0|262143] "BIT MAP" Vector__XXX
 SG_ FCW_VO_AEB_SUPPRESSIONS_SETC : 0|16@1+ (1,0) [0|255] "BIT MAP" Vector__XXX
 SG_ Day_Night_Decision : 0|2@1+ (1,0) [0|3] "ENUM" Vector__XXX
 SG_ TAC2_reserved2 : 0|7@1+ (1,0) [0|0] "" Vector__XXX
 SG_ tac2_top : 0|8@1+ (1,0) [0|120] "pixel" Vector__XXX
 SG_ tac2_bottom : 0|8@1+ (1,-120) [-120|0] "pixel" Vector__XXX
 SG_ tac2_squareSideSize : 0|9@1+ (0.001,0) [0|0.5] "[m]" Vector__XXX
 SG_ tac2_max_rollAngle : 0|8@1+ (0.001,0) [0|0.055] "" Vector__XXX
 SG_ tac2_min_yaw : 0|8@1+ (1,-47) [-47|0] "" Vector__XXX
 SG_ tac2_max_yaw : 0|8@1+ (1,0) [0|47] "pixel" Vector__XXX
 SG_ tac2_min_horizon : 0|8@1+ (1,-40) [-40|0] "pixel" Vector__XXX
 SG_ tac2_max_horizon : 0|8@1+ (1,0) [0|62] "pixel" Vector__XXX
 SG_ cameraInfo_tac2_Z : 0|16@1+ (0.001,0) [0|10] "" Vector__XXX
 SG_ cameraInfo_tac2_height : 0|16@1+ (0.01,0) [0.5|3] "meter" Vector__XXX
 SG_ cameraInfo_tac2_focal_length : 0|16@1+ (1,0) [100|1000] "pixel" Vector__XXX
 SG_ tac2_right_wheel : 0|16@1+ (0.01,0) [0.2|5] "meter" Vector__XXX
 SG_ tac2_left_wheel : 0|16@1+ (0.01,0) [0.2|5] "meter" Vector__XXX
 SG_ targetInfo_tac2_height_1 : 0|16@1+ (0.01,0) [0|5] "" Vector__XXX
 SG_ SPC_maxAttempts : 0|8@1+ (1,0) [1|10] "integer" Vector__XXX
 SG_ SPC_SessionTimeout : 0|8@1+ (8,0) [180|1800] "seconds" Vector__XXX
 SG_ tac2_numTargets : 0|2@1+ (1,0) [0|3] "" Vector__XXX
 SG_ targetInfo_tac2_height_0 : 0|16@1+ (0.01,0) [0|5] "" Vector__XXX
 SG_ targetInfo_lateral_distance_1 : 0|16@1+ (0.01,-5) [-5|5] "" Vector__XXX
 SG_ targetInfo_lateral_distance_0 : 0|16@1+ (0.01,-5) [-5|5] "" Vector__XXX
 SG_ targetInfo_bottomLeftSquare_1 : 0|2@1+ (1,0) [0|1] "" Vector__XXX
 SG_ targetInfo_bottomLeftSquare_0 : 0|2@1+ (1,0) [0|1] "" Vector__XXX
 SG_ TAC2_tac2_mode : 0|8@1+ (1,0) [0|4] "" Vector__XXX
 SG_ TAC_reserved1 : 0|2@1+ (1,0) [0|0] "" Vector__XXX
 SG_ InitV_horizonFull : 0|16@1+ (1,-160) [-160|248] "pixel" Vector__XXX
 SG_ InitV_yawFull : 0|16@1+ (1,-190) [-190|190] "pixel" Vector__XXX
 SG_ InitV_autofix_horizon : 0|8@1+ (1,-40) [-40|40] "pixel" Vector__XXX
 SG_ InitV_autofix_yaw : 0|8@1+ (1,-40) [-40|40] "pixel" Vector__XXX
 SG_ InitV_bottom : 0|8@1+ (1,-120) [-120|0] "pixel" Vector__XXX
 SG_ InitV_top : 0|8@1+ (1,0) [0|120] "pixel" Vector__XXX
 SG_ InitV_rollAngle : 0|16@1+ (0.001,-0.055) [-0.055|0.055] "radians" Vector__XXX
 SG_ InitV_minYaw : 0|8@1+ (1,-47) [-47|0] "" Vector__XXX
 SG_ InitV_regionCode : 0|8@1+ (1,0) [1|10] "Enum" Vector__XXX
 SG_ InitV_drivingSide : 0|8@1+ (1,0) [0|2] "" Vector__XXX
 SG_ InitV_maxHorizon : 0|8@1+ (1,0) [0|62] "pixel" Vector__XXX
 SG_ InitV_minHorizon : 0|8@1+ (1,-40) [-40|0] "pixel" Vector__XXX
 SG_ InitV_maxYaw : 0|8@1+ (1,0) [0|47] "pixel" Vector__XXX
 SG_ RefPointY : 0|8@1+ (0.01,-1.28) [-1.28|1.27] "[m]" Vector__XXX
 SG_ RefPointX : 0|8@1+ (0.01,0) [0|2.55] "[m]" Vector__XXX
 SG_ InitV_rightWheel : 0|16@1+ (0.01,0) [0.2|5] "meter" Vector__XXX
 SG_ InitV_cameraHeight : 0|16@1+ (0.01,0) [0.5|3] "meter" Vector__XXX
 SG_ InitParamSPC_minYaw : 0|8@1+ (1,-47) [-47|0] "pixel" Vector__XXX
 SG_ InitParamSPC_top : 0|8@1+ (1,0) [0|120] "pixel" Vector__XXX
 SG_ InitParamSPC_maxYaw : 0|8@1+ (1,0) [0|47] "pixel" Vector__XXX
 SG_ InitParamSPC_bottom : 0|8@1+ (1,-120) [-120|0] "pixel" Vector__XXX
 SG_ InitParamSPC_minHorizon : 0|8@1+ (1,-40) [-40|0] "pixel" Vector__XXX
 SG_ InitParamSPC_maxHorizon : 0|8@1+ (1,0) [0|62] "pixel" Vector__XXX
 SG_ InitParamSPC_rollAngle : 0|16@1+ (0.001,-0.055) [-0.055|0.055] "radians" Vector__XXX
 SG_ InitParamSPC_cameraHeight : 0|16@1+ (0.01,0) [0.5|3] "meter" Vector__XXX
 SG_ InitParamSPC_drivingSide : 0|8@1+ (1,0) [0|2] "Enum" Vector__XXX
 SG_ InitParamSPC_regionCode : 0|8@1+ (1,0) [1|10] "Enum" Vector__XXX
 SG_ InitParamSPC_autofix_yaw : 0|8@1+ (1,-40) [-40|40] "pixel" Vector__XXX
 SG_ InitParamSPC_autofix_horizon : 0|8@1+ (1,-40) [-40|40] "pixel" Vector__XXX
 SG_ InitParamSPC_yawFull : 0|16@1+ (1,-190) [-190|190] "pixel" Vector__XXX
 SG_ InitParamSPC_horizonFull : 0|16@1+ (1,-160) [-160|248] "pixel" Vector__XXX
 SG_ CS_reserved3 : 0|4@1+ (1,0) [0|0] "NA" Vector__XXX
 SG_ ss_reserved_7 : 0|32@0+ (1,0) [0|0] "NA" Vector__XXX
 SG_ ss_reserved_6 : 0|32@0+ (1,0) [0|0] "NA" Vector__XXX
 SG_ ss_reserved_5 : 0|3@0+ (1,0) [0|0] "NA" Vector__XXX
 SG_ Event_Request3 : 0|1@0+ (1,0) [0|1] "ENUM" Vector__XXX
 SG_ Event_Request2 : 0|1@0+ (1,0) [0|1] "ENUM" Vector__XXX
 SG_ Event_Request1 : 0|1@0+ (1,0) [0|1] "ENUM" Vector__XXX
 SG_ clearTSMSecondaryCond : 0|1@0+ (1,0) [0|1] "ENUM" Vector__XXX
 SG_ clearTSMSecondary : 0|1@0+ (1,0) [0|1] "ENUM" Vector__XXX
 SG_ clearTSMPrimaryCond : 0|1@0+ (1,0) [0|1] "ENUM" Vector__XXX
 SG_ clearTSMPrimary : 0|1@0+ (1,0) [0|1] "ENUM" Vector__XXX
 SG_ clearTSMall : 0|1@0+ (1,0) [0|1] "ENUM" Vector__XXX
 SG_ ss_reserved_3 : 0|5@0+ (1,0) [0|0] "NA" Vector__XXX
 SG_ ldwSensitivity : 0|2@0+ (1,0) [0|2] "ENUM" Vector__XXX
 SG_ ldwSensitivityValid : 0|1@0+ (1,0) [0|1] "ENUM" Vector__XXX
 SG_ gpsCountryCode_SecondChar : 0|5@0+ (1,0) [0|26] "ENUM" Vector__XXX
 SG_ ss_reserved_1 : 0|1@0+ (1,0) [0|0] "NA" Vector__XXX
 SG_ hbaReducedSensitivity : 0|1@0+ (1,0) [0|1] "ENUM" Vector__XXX
 SG_ hbaReducedSensitivityValid : 0|1@0+ (1,0) [0|1] "ENUM" Vector__XXX
 SG_ gpsCountryCode_FirstChar : 0|5@0+ (1,0) [0|26] "ENUM" Vector__XXX
 SG_ DriverSensitivity : 0|1@0+ (1,0) [0|1] "ENUM" Vector__XXX
 SG_ DriverSensitivityValid : 0|1@0+ (1,0) [0|1] "ENUM" Vector__XXX
 SG_ pcwGapSensitivity : 0|2@0+ (1,0) [0|3] "ENUM" Vector__XXX
 SG_ pcwGapSensitivityValid : 0|1@0+ (1,0) [0|1] "ENUM" Vector__XXX
 SG_ fcaGapSensitivity : 0|2@0+ (1,0) [0|3] "ENUM" Vector__XXX
 SG_ fcaGapSensitivityValid : 0|1@0+ (1,0) [0|1] "ENUM" Vector__XXX
 SG_ ss_Sync_Frame_Index : 0|8@0+ (1,0) [0|255] "counter" Vector__XXX
 SG_ ss_Sensor_Version : 0|8@0+ (1,0) [0|255] "NA" Vector__XXX
 SG_ ss_reserved_0 : 0|8@0+ (1,0) [0|0] "NA" Vector__XXX
 SG_ sys_fault : 0|32@1+ (1,0) [0|0] "" Vector__XXX
 SG_ EQ_Reset_Flag : 0|32@1+ (1,0) [0|0] "" Vector__XXX
 SG_ ee_write_addr : 0|16@1+ (1,0) [0|0] "" Vector__XXX
 SG_ ee_write_times : 0|8@1+ (1,0) [0|0] "" Vector__XXX
 SG_ last_MESP_Result : 0|8@1+ (1,0) [0|0] "" Vector__XXX
 SG_ curr_MESP_State : 0|8@1+ (1,0) [0|0] "" Vector__XXX
 SG_ Num_Rcv_Nack : 0|8@1+ (1,0) [0|0] "" Vector__XXX
 SG_ Num_Send_Nack : 0|8@1+ (1,0) [0|0] "" Vector__XXX
 SG_ MESTP_Datalink_Err_Flag : 0|8@1+ (1,0) [0|0] "" Vector__XXX
 SG_ RGM_DES_R : 0|32@1+ (1,0) [0|0] "" Vector__XXX
 SG_ RGM_FES_R : 0|32@1+ (1,0) [0|0] "" Vector__XXX
 SG_ AD_TMP : 0|16@1+ (1,0) [0|0] "" Vector__XXX
 SG_ fs_AD_WkupEn : 0|16@1+ (1,0) [0|0] "" Vector__XXX
 SG_ SysVoltage : 0|16@1+ (1,0) [0|0] "" Vector__XXX
 SG_ fvcm_debug_msg03_reserved3 : 0|16@1+ (1,0) [0|0] "" Vector__XXX
 SG_ fvcm_debug_msg03_reserved2 : 0|16@1+ (1,0) [0|0] "" Vector__XXX
 SG_ fvcm_debug_msg03_reserved1 : 0|16@1+ (1,0) [0|0] "" Vector__XXX
 SG_ fvcm_debug_msg03_reserved0 : 0|16@1+ (1,0) [0|0] "" Vector__XXX
 SG_ fvcm_debug_msg02_reserved7 : 0|8@1+ (1,0) [0|0] "" Vector__XXX
 SG_ fvcm_debug_msg02_reserved6 : 0|8@1+ (1,0) [0|0] "" Vector__XXX
 SG_ fvcm_debug_msg02_reserved5 : 0|8@1+ (1,0) [0|0] "" Vector__XXX
 SG_ fvcm_debug_msg02_reserved4 : 0|8@1+ (1,0) [0|0] "" Vector__XXX
 SG_ fvcm_debug_msg02_reserved3 : 0|8@1+ (1,0) [0|0] "" Vector__XXX
 SG_ fvcm_debug_msg02_reserved2 : 0|8@1+ (1,0) [0|0] "" Vector__XXX
 SG_ fvcm_debug_msg02_reserved1 : 0|8@1+ (1,0) [0|0] "" Vector__XXX
 SG_ fvcm_debug_msg02_reserved0 : 0|8@1+ (1,0) [0|0] "" Vector__XXX
 SG_ DSM_ConditionF_Count : 0|8@1+ (1,0) [0|80] "" Vector__XXX
 SG_ DSM_ConditionE_Count : 0|8@1+ (1,0) [0|80] "" Vector__XXX
 SG_ DSM_ConditionD_Count : 0|8@1+ (1,0) [0|80] "" Vector__XXX
 SG_ DSM_ConditionC_Count : 0|8@1+ (1,0) [0|80] "" Vector__XXX
 SG_ DSM_ConditionB_Count : 0|8@1+ (1,0) [0|80] "" Vector__XXX
 SG_ DSM_ConditionA_Count : 0|8@1+ (1,0) [0|80] "" Vector__XXX
 SG_ DSM_Warning : 0|2@1+ (1,0) [0|2] "" Vector__XXX
 SG_ DSM_Main_State : 0|2@1+ (1,0) [0|3] "" Vector__XXX
 SG_ DSM_Fatigue_Index_Official : 0|8@1+ (1,0) [0|100] "" Vector__XXX
 SG_ DSM_Fatigue_Index : 0|8@1+ (1,-5) [-5|45] "" Vector__XXX
 SG_ DSM_Drv_Time_Second : 0|6@1+ (1,0) [0|64] "" Vector__XXX
 SG_ DSM_Drv_Time_Minutes : 0|6@1+ (1,0) [0|64] "" Vector__XXX
 SG_ DSM_Drv_Time_Hour : 0|6@1+ (1,0) [0|64] "" Vector__XXX
 SG_ AEB_Safety_Zero_Byte : 0|8@1+ (1,0) [0|0] "" Vector__XXX
 SG_ AEB_Safety_syncFrameIndex : 0|8@1+ (1,0) [0|255] "counter" Vector__XXX
 SG_ Safety_Challenge_Identifier : 0|8@1+ (1,0) [0|255] "NA" Vector__XXX
 SG_ Safety_Challenge_Response1 : 0|8@1+ (1,0) [0|0] "NA" Vector__XXX
 SG_ Safety_Challenge_Response2 : 0|8@1+ (1,0) [0|0] "NA" Vector__XXX
 SG_ Safety_Challenge_Response3 : 0|8@1+ (1,0) [0|0] "NA" Vector__XXX
 SG_ Safety_Challenge_Response4 : 0|8@1+ (1,0) [0|0] "NA" Vector__XXX
 SG_ Safety_Diagnostic_Manager7 : 0|1@1+ (1,0) [0|1] "ENUM" Vector__XXX
 SG_ Safety_Diagnostic_Manager6 : 0|1@1+ (1,0) [0|1] "ENUM" Vector__XXX
 SG_ Safety_Diagnostic_Manager5 : 0|1@1+ (1,0) [0|1] "NA" Vector__XXX
 SG_ Safety_Diagnostic_Manager4 : 0|1@1+ (1,0) [0|1] "ENUM" Vector__XXX
 SG_ Safety_Diagnostic_Manager3 : 0|1@1+ (1,0) [0|1] "NA" Vector__XXX
 SG_ Safety_Diagnostic_Manager2 : 0|1@1+ (1,0) [0|1] "NA" Vector__XXX
 SG_ Safety_Diagnostic_Manager1 : 0|1@1+ (1,0) [0|1] "NA" Vector__XXX
 SG_ Safety_Diagnostic_Manager0 : 0|1@1+ (1,0) [0|1] "NA" Vector__XXX
 SG_ Safety_Diagnostic_Manager15 : 0|1@1+ (1,0) [0|1] "NA" Vector__XXX
 SG_ Safety_Diagnostic_Manager14 : 0|1@1+ (1,0) [0|1] "NA" Vector__XXX
 SG_ Safety_Diagnostic_Manager13 : 0|1@1+ (1,0) [0|1] "ENUM" Vector__XXX
 SG_ Safety_Diagnostic_Manager12 : 0|1@1+ (1,0) [0|1] "ENUM" Vector__XXX
 SG_ Safety_Diagnostic_Manager11 : 0|1@1+ (1,0) [0|1] "ENUM" Vector__XXX
 SG_ Safety_Diagnostic_Manager10 : 0|1@1+ (1,0) [0|1] "NA" Vector__XXX
 SG_ Safety_Diagnostic_Manager9 : 0|1@1+ (1,0) [0|1] "ENUM" Vector__XXX
 SG_ Safety_Diagnostic_Manager8 : 0|1@1+ (1,0) [0|1] "ENUM" Vector__XXX
 SG_ Safety_Diagnostic_Manager23 : 0|1@1+ (1,0) [0|1] "NA" Vector__XXX
 SG_ Safety_Diagnostic_Manager22 : 0|1@1+ (1,0) [0|1] "ENUM" Vector__XXX
 SG_ Safety_Diagnostic_Manager21 : 0|1@1+ (1,0) [0|1] "NA" Vector__XXX
 SG_ Safety_Diagnostic_Manager20 : 0|1@1+ (1,0) [0|1] "NA" Vector__XXX
 SG_ Safety_Diagnostic_Manager19 : 0|1@1+ (1,0) [0|1] "ENUM" Vector__XXX
 SG_ Safety_Diagnostic_Manager18 : 0|1@1+ (1,0) [0|1] "ENUM" Vector__XXX
 SG_ Safety_Diagnostic_Manager17 : 0|1@1+ (1,0) [0|1] "NA" Vector__XXX
 SG_ Safety_Diagnostic_Manager16 : 0|1@1+ (1,0) [0|1] "NA" Vector__XXX
 SG_ Safety_Diagnostic_Manager31 : 0|1@1+ (1,0) [0|1] "ENUM" Vector__XXX
 SG_ Safety_Diagnostic_Manager30 : 0|1@1+ (1,0) [0|1] "ENUM" Vector__XXX
 SG_ Safety_Diagnostic_Manager29 : 0|1@1+ (1,0) [0|1] "ENUM" Vector__XXX
 SG_ Safety_Diagnostic_Manager28 : 0|1@1+ (1,0) [0|1] "ENUM" Vector__XXX
 SG_ Safety_Diagnostic_Manager27 : 0|1@1+ (1,0) [0|1] "ENUM" Vector__XXX
 SG_ Safety_Diagnostic_Manager26 : 0|1@1+ (1,0) [0|1] "ENUM" Vector__XXX
 SG_ Safety_Diagnostic_Manager25 : 0|1@1+ (1,0) [0|1] "ENUM" Vector__XXX
 SG_ Safety_Diagnostic_Manager24 : 0|1@1+ (1,0) [0|1] "NA" Vector__XXX
 SG_ AEB_Safety_Reserved_1 : 0|7@1+ (1,0) [0|0] "NA" Vector__XXX
 SG_ Safety_Diagnostic_Manager32 : 0|1@1+ (1,0) [0|1] "Enum" Vector__XXX
 SG_ AEB_Safety_CRC : 0|16@1+ (1,0) [0|65535] "NA" Vector__XXX
 SG_ SPTAC_Output_cameraHeight : 0|8@1+ (1,50) [50|300] "cm" Vector__XXX
 SG_ SPTAC_Output_Zero_byte : 0|8@1+ (1,0) [0|0] "" Vector__XXX
 SG_ SPTAC_Output_Roll_Angle : 0|8@1+ (0.005,-0.055) [-0.055|0.055] "Radians" Vector__XXX
 SG_ SPTAC_Output_Horizon : 0|16@1+ (1,-40) [-40|62] "Pixel" Vector__XXX
 SG_ SPTAC_Output_SPTAC_Status : 0|8@1+ (1,0) [0|10] "ENUM" Vector__XXX
 SG_ SPTAC_Output_Yaw : 0|16@1+ (1,-47) [-47|47] "Pixel" Vector__XXX
 SG_ Objects_Top_Obj9 : 0|10@1+ (2,-1023) [-1023|1023] "pixels" Vector__XXX
 SG_ Objects_Bottom_Obj9 : 0|10@1+ (2,-1023) [-1023|1023] "pixels" Vector__XXX
 SG_ Objects_Lateral_Distance_Obj9 : 0|12@1+ (0.05,-102.4) [-102.4|102.35] "m" Vector__XXX
 SG_ Objects_Extended_ID_Obj9 : 0|16@1+ (1,0) [0|65535] "counter" Vector__XXX
 SG_ Objects_Angle_Rate_Mean_Obj9 : 0|12@1+ (0.002,-2.234) [-2.234|2.2318] "rad/s" Vector__XXX
 SG_ Objects_Cut_In_Cut_Out_Obj9 : 0|4@1+ (1,0) [0|8] "ENUM" Vector__XXX
 SG_ Objects_Top_Obj8 : 0|10@1+ (2,-1023) [-1023|1023] "pixels" Vector__XXX
 SG_ Objects_Bottom_Obj8 : 0|10@1+ (2,-1023) [-1023|1023] "pixels" Vector__XXX
 SG_ Objects_Lateral_Distance_Obj8 : 0|12@1+ (0.05,-102.4) [-102.4|102.35] "m" Vector__XXX
 SG_ Objects_Extended_ID_Obj8 : 0|16@1+ (1,0) [0|65535] "counter" Vector__XXX
 SG_ Objects_Angle_Rate_Mean_Obj8 : 0|12@1+ (0.002,-2.234) [-2.234|2.2318] "rad/s" Vector__XXX
 SG_ Objects_Cut_In_Cut_Out_Obj8 : 0|4@1+ (1,0) [0|8] "ENUM" Vector__XXX
 SG_ Objects_Top_Obj7 : 0|10@1+ (2,-1023) [-1023|1023] "pixels" Vector__XXX
 SG_ Objects_Bottom_Obj7 : 0|10@1+ (2,-1023) [-1023|1023] "pixels" Vector__XXX
 SG_ Objects_Lateral_Distance_Obj7 : 0|12@1+ (0.05,-102.4) [-102.4|102.35] "m" Vector__XXX
 SG_ Objects_Extended_ID_Obj7 : 0|16@1+ (1,0) [0|65535] "counter" Vector__XXX
 SG_ Objects_Angle_Rate_Mean_Obj7 : 0|12@1+ (0.002,-2.234) [-2.234|2.2318] "rad/s" Vector__XXX
 SG_ Objects_Cut_In_Cut_Out_Obj7 : 0|4@1+ (1,0) [0|8] "ENUM" Vector__XXX
 SG_ Objects_Top_Obj6 : 0|10@1+ (2,-1023) [-1023|1023] "pixels" Vector__XXX
 SG_ Objects_Bottom_Obj6 : 0|10@1+ (2,-1023) [-1023|1023] "pixels" Vector__XXX
 SG_ Objects_Lateral_Distance_Obj6 : 0|12@1+ (0.05,-102.4) [-102.4|102.35] "m" Vector__XXX
 SG_ Objects_Extended_ID_Obj6 : 0|16@1+ (1,0) [0|65535] "counter" Vector__XXX
 SG_ Objects_Angle_Rate_Mean_Obj6 : 0|12@1+ (0.002,-2.234) [-2.234|2.2318] "rad/s" Vector__XXX
 SG_ Objects_Cut_In_Cut_Out_Obj6 : 0|4@1+ (1,0) [0|8] "ENUM" Vector__XXX
 SG_ Objects_Top_Obj5 : 0|10@1+ (2,-1023) [-1023|1023] "pixels" Vector__XXX
 SG_ Objects_Bottom_Obj5 : 0|10@1+ (2,-1023) [-1023|1023] "pixels" Vector__XXX
 SG_ Objects_Lateral_Distance_Obj5 : 0|12@1+ (0.05,-102.4) [-102.4|102.35] "m" Vector__XXX
 SG_ Objects_Extended_ID_Obj5 : 0|16@1+ (1,0) [0|65535] "counter" Vector__XXX
 SG_ Objects_Angle_Rate_Mean_Obj5 : 0|12@1+ (0.002,-2.234) [-2.234|2.2318] "rad/s" Vector__XXX
 SG_ Objects_Cut_In_Cut_Out_Obj5 : 0|4@1+ (1,0) [0|8] "ENUM" Vector__XXX
 SG_ Object9_Relevancy_RMC : 0|1@1+ (1,0) [0|0] "boot" Vector__XXX
 SG_ Object9_Relevancy_reserved : 0|1@1+ (1,0) [0|0] "bool" Vector__XXX
 SG_ Object9_Relevancy_LMC : 0|1@1+ (1,0) [0|0] "bool" Vector__XXX
 SG_ Object9_Relevancy_2nd_CIPV : 0|1@1+ (1,0) [0|0] "bool" Vector__XXX
 SG_ Objects_Phi_Line_Right_Obj9 : 0|9@1+ (0.0010246551382,-0.2617993878) [-0.2617993878|0.2617993878] "rad" Vector__XXX
 SG_ Objects_PhiLineRightValid_Obj9 : 0|1@1+ (1,0) [0|1] "bool" Vector__XXX
 SG_ Objects_Object_Age_Obj9 : 0|11@1+ (1,0) [0|2047] "frames" Vector__XXX
 SG_ Objects_Phi_Line_Left_Obj9 : 0|9@1+ (0.0010246551382,-0.2617993878) [-0.2617993878|0.2617993878] "rad" Vector__XXX
 SG_ Objects_Phi_Line_Left_Valid_Obj9 : 0|1@1+ (1,0) [0|1] "bool" Vector__XXX
 SG_ Objects_Lateral_Velocity_Obj9 : 0|9@1+ (0.05,-12.8) [-12.8|12.75] "m/s" Vector__XXX
 SG_ Objects_ObstacleReplaced_Obj9 : 0|1@1+ (1,0) [0|1] "bool" Vector__XXX
 SG_ Objects_CIPVFlag_Obj9 : 0|1@1+ (1,0) [0|1] "bool" Vector__XXX
 SG_ Object8_Relevancy_RMC : 0|1@1+ (1,0) [0|0] "boot" Vector__XXX
 SG_ Object8_Relevancy_reserved : 0|1@1+ (1,0) [0|0] "bool" Vector__XXX
 SG_ Object8_Relevancy_LMC : 0|1@1+ (1,0) [0|0] "bool" Vector__XXX
 SG_ Object8_Relevancy_2nd_CIPV : 0|1@1+ (1,0) [0|0] "bool" Vector__XXX
 SG_ Objects_Phi_Line_Right_Obj8 : 0|9@1+ (0.0010246551382,-0.2617993878) [-0.2617993878|0.2617993878] "rad" Vector__XXX
 SG_ Objects_PhiLineRightValid_Obj8 : 0|1@1+ (1,0) [0|1] "bool" Vector__XXX
 SG_ Objects_Object_Age_Obj8 : 0|11@1+ (1,0) [0|2047] "frames" Vector__XXX
 SG_ Objects_Phi_Line_Left_Obj8 : 0|9@1+ (0.0010246551382,-0.2617993878) [-0.2617993878|0.2617993878] "rad" Vector__XXX
 SG_ Objects_Phi_Line_Left_Valid_Obj8 : 0|1@1+ (1,0) [0|1] "bool" Vector__XXX
 SG_ Objects_Lateral_Velocity_Obj8 : 0|9@1+ (0.05,-12.8) [-12.8|12.75] "m/s" Vector__XXX
 SG_ Objects_ObstacleReplaced_Obj8 : 0|1@1+ (1,0) [0|1] "bool" Vector__XXX
 SG_ Objects_CIPVFlag_Obj8 : 0|1@1+ (1,0) [0|1] "bool" Vector__XXX
 SG_ Object7_Relevancy_RMC : 0|1@1+ (1,0) [0|0] "boot" Vector__XXX
 SG_ Object7_Relevancy_reserved : 0|1@1+ (1,0) [0|0] "bool" Vector__XXX
 SG_ Object7_Relevancy_LMC : 0|1@1+ (1,0) [0|0] "bool" Vector__XXX
 SG_ Object7_Relevancy_2nd_CIPV : 0|1@1+ (1,0) [0|0] "bool" Vector__XXX
 SG_ Objects_Phi_Line_Right_Obj7 : 0|9@1+ (0.0010246551382,-0.2617993878) [-0.2617993878|0.2617993878] "rad" Vector__XXX
 SG_ Objects_PhiLineRightValid_Obj7 : 0|1@1+ (1,0) [0|1] "bool" Vector__XXX
 SG_ Objects_Object_Age_Obj7 : 0|11@1+ (1,0) [0|2047] "frames" Vector__XXX
 SG_ Objects_Phi_Line_Left_Obj7 : 0|9@1+ (0.0010246551382,-0.2617993878) [-0.2617993878|0.2617993878] "rad" Vector__XXX
 SG_ Objects_Phi_Line_Left_Valid_Obj7 : 0|1@1+ (1,0) [0|1] "bool" Vector__XXX
 SG_ Objects_Lateral_Velocity_Obj7 : 0|9@1+ (0.05,-12.8) [-12.8|12.75] "m/s" Vector__XXX
 SG_ Objects_ObstacleReplaced_Obj7 : 0|1@1+ (1,0) [0|1] "bool" Vector__XXX
 SG_ Objects_CIPVFlag_Obj7 : 0|1@1+ (1,0) [0|1] "bool" Vector__XXX
 SG_ Object6_Relevancy_RMC : 0|1@1+ (1,0) [0|0] "boot" Vector__XXX
 SG_ Object6_Relevancy_reserved : 0|1@1+ (1,0) [0|0] "bool" Vector__XXX
 SG_ Object6_Relevancy_LMC : 0|1@1+ (1,0) [0|0] "bool" Vector__XXX
 SG_ Object6_Relevancy_2nd_CIPV : 0|1@1+ (1,0) [0|0] "bool" Vector__XXX
 SG_ Objects_Phi_Line_Right_Obj6 : 0|9@1+ (0.0010246551382,-0.2617993878) [-0.2617993878|0.2617993878] "rad" Vector__XXX
 SG_ Objects_PhiLineRightValid_Obj6 : 0|1@1+ (1,0) [0|1] "bool" Vector__XXX
 SG_ Objects_Object_Age_Obj6 : 0|11@1+ (1,0) [0|2047] "frames" Vector__XXX
 SG_ Objects_Phi_Line_Left_Obj6 : 0|9@1+ (0.0010246551382,-0.2617993878) [-0.2617993878|0.2617993878] "rad" Vector__XXX
 SG_ Objects_Phi_Line_Left_Valid_Obj6 : 0|1@1+ (1,0) [0|1] "bool" Vector__XXX
 SG_ Objects_Lateral_Velocity_Obj6 : 0|9@1+ (0.05,-12.8) [-12.8|12.75] "m/s" Vector__XXX
 SG_ Objects_ObstacleReplaced_Obj6 : 0|1@1+ (1,0) [0|1] "bool" Vector__XXX
 SG_ Objects_CIPVFlag_Obj6 : 0|1@1+ (1,0) [0|1] "bool" Vector__XXX
 SG_ Object5_Relevancy_RMC : 0|1@1+ (1,0) [0|0] "boot" Vector__XXX
 SG_ Object5_Relevancy_reserved : 0|1@1+ (1,0) [0|0] "bool" Vector__XXX
 SG_ Object5_Relevancy_LMC : 0|1@1+ (1,0) [0|0] "bool" Vector__XXX
 SG_ Object5_Relevancy_2nd_CIPV : 0|1@1+ (1,0) [0|0] "bool" Vector__XXX
 SG_ Objects_Phi_Line_Right_Obj5 : 0|9@1+ (0.0010246551382,-0.2617993878) [-0.2617993878|0.2617993878] "rad" Vector__XXX
 SG_ Objects_PhiLineRightValid_Obj5 : 0|1@1+ (1,0) [0|1] "bool" Vector__XXX
 SG_ Objects_Object_Age_Obj5 : 0|11@1+ (1,0) [0|2047] "frames" Vector__XXX
 SG_ Objects_Phi_Line_Left_Obj5 : 0|9@1+ (0.0010246551382,-0.2617993878) [-0.2617993878|0.2617993878] "rad" Vector__XXX
 SG_ Objects_Phi_Line_Left_Valid_Obj5 : 0|1@1+ (1,0) [0|1] "bool" Vector__XXX
 SG_ Objects_Lateral_Velocity_Obj5 : 0|9@1+ (0.05,-12.8) [-12.8|12.75] "m/s" Vector__XXX
 SG_ Objects_ObstacleReplaced_Obj5 : 0|1@1+ (1,0) [0|1] "bool" Vector__XXX
 SG_ Objects_CIPVFlag_Obj5 : 0|1@1+ (1,0) [0|1] "bool" Vector__XXX
 SG_ Objects_FOE_Y_Obj9 : 0|10@1+ (2,-1023) [-1023|1023] "pixels" Vector__XXX
 SG_ Objects_FOE_X_Obj9 : 0|10@1+ (2,-1023) [-1023|1023] "pixels" Vector__XXX
 SG_ Objects_Right_Obj9 : 0|10@1+ (2,-1023) [-1023|1023] "pixels" Vector__XXX
 SG_ Objects_Left_Obj9 : 0|10@1+ (2,-1023) [-1023|1023] "pixels" Vector__XXX
 SG_ Objects_FOE_Y_Obj8 : 0|10@1+ (2,-1023) [-1023|1023] "pixels" Vector__XXX
 SG_ Objects_FOE_X_Obj8 : 0|10@1+ (2,-1023) [-1023|1023] "pixels" Vector__XXX
 SG_ Objects_Right_Obj8 : 0|10@1+ (2,-1023) [-1023|1023] "pixels" Vector__XXX
 SG_ Objects_Left_Obj8 : 0|10@1+ (2,-1023) [-1023|1023] "pixels" Vector__XXX
 SG_ Objects_FOE_Y_Obj7 : 0|10@1+ (2,-1023) [-1023|1023] "pixels" Vector__XXX
 SG_ Objects_FOE_X_Obj7 : 0|10@1+ (2,-1023) [-1023|1023] "pixels" Vector__XXX
 SG_ Objects_Right_Obj7 : 0|10@1+ (2,-1023) [-1023|1023] "pixels" Vector__XXX
 SG_ Objects_Left_Obj7 : 0|10@1+ (2,-1023) [-1023|1023] "pixels" Vector__XXX
 SG_ Objects_FOE_Y_Obj6 : 0|10@1+ (2,-1023) [-1023|1023] "pixels" Vector__XXX
 SG_ Objects_FOE_X_Obj6 : 0|10@1+ (2,-1023) [-1023|1023] "pixels" Vector__XXX
 SG_ Objects_Right_Obj6 : 0|10@1+ (2,-1023) [-1023|1023] "pixels" Vector__XXX
 SG_ Objects_Left_Obj6 : 0|10@1+ (2,-1023) [-1023|1023] "pixels" Vector__XXX
 SG_ Objects_FOE_Y_Obj5 : 0|10@1+ (2,-1023) [-1023|1023] "pixels" Vector__XXX
 SG_ Objects_FOE_X_Obj5 : 0|10@1+ (2,-1023) [-1023|1023] "pixels" Vector__XXX
 SG_ Objects_Right_Obj5 : 0|10@1+ (2,-1023) [-1023|1023] "pixels" Vector__XXX
 SG_ Objects_Left_Obj5 : 0|10@1+ (2,-1023) [-1023|1023] "pixels" Vector__XXX
 SG_ Objects_Reserved4_Obj9 : 0|1@1+ (1,0) [0|0] "NA" Vector__XXX
 SG_ Objects_Width_Obj9 : 0|7@1+ (0.05,0) [0|6.35] "m" Vector__XXX
 SG_ Objects_Lane_Movement_Type_Obj9 : 0|2@1+ (1,0) [0|2] "ENUM" Vector__XXX
 SG_ Objects_Reserved3_Obj9 : 0|1@1+ (1,0) [0|0] "NA" Vector__XXX
 SG_ Objects_Brake_Light_Obj9 : 0|2@1+ (1,0) [0|2] "ENUM" Vector__XXX
 SG_ Objects_Relative_Velocity_Obj9 : 0|13@1+ (0.05,-128) [-128|128] "m/s" Vector__XXX
 SG_ Objects_Reserved2_Obj9 : 0|3@1+ (1,0) [0|0] "NA" Vector__XXX
 SG_ Objects_RightAnglePredicted_Obj9 : 0|1@1+ (1,0) [0|1] "bool" Vector__XXX
 SG_ Objects_LeftAnglePredicted_Obj9 : 0|1@1+ (1,0) [0|1] "bool" Vector__XXX
 SG_ Objects_Acceleration_Abs_Obj9 : 0|9@1+ (0.05,-12.8) [-12.8|12.75] "m/s2" Vector__XXX
 SG_ Objects_Turn_Indicator_Obj9 : 0|3@1+ (1,0) [0|4] "ENUM" Vector__XXX
 SG_ Objects_Angle_Right_Obj9 : 0|13@1+ (0.0002,-0.8192) [-0.8192|0.819] "rad" Vector__XXX
 SG_ Objects_Reserved4_Obj8 : 0|1@1+ (1,0) [0|0] "NA" Vector__XXX
 SG_ Objects_Width_Obj8 : 0|7@1+ (0.05,0) [0|6.35] "m" Vector__XXX
 SG_ Objects_Lane_Movement_Type_Obj8 : 0|2@1+ (1,0) [0|2] "ENUM" Vector__XXX
 SG_ Objects_Reserved3_Obj8 : 0|1@1+ (1,0) [0|0] "NA" Vector__XXX
 SG_ Objects_Brake_Light_Obj8 : 0|2@1+ (1,0) [0|2] "ENUM" Vector__XXX
 SG_ Objects_Relative_Velocity_Obj8 : 0|13@1+ (0.05,-128) [-128|128] "m/s" Vector__XXX
 SG_ Objects_Reserved2_Obj8 : 0|3@1+ (1,0) [0|0] "NA" Vector__XXX
 SG_ Objects_RightAnglePredicted_Obj8 : 0|1@1+ (1,0) [0|1] "bool" Vector__XXX
 SG_ Objects_LeftAnglePredicted_Obj8 : 0|1@1+ (1,0) [0|1] "bool" Vector__XXX
 SG_ Objects_Acceleration_Abs_Obj8 : 0|9@1+ (0.05,-12.8) [-12.8|12.75] "m/s2" Vector__XXX
 SG_ Objects_Turn_Indicator_Obj8 : 0|3@1+ (1,0) [0|4] "ENUM" Vector__XXX
 SG_ Objects_Angle_Right_Obj8 : 0|13@1+ (0.0002,-0.8192) [-0.8192|0.819] "rad" Vector__XXX
 SG_ Objects_Reserved4_Obj7 : 0|1@1+ (1,0) [0|0] "NA" Vector__XXX
 SG_ Objects_Width_Obj7 : 0|7@1+ (0.05,0) [0|6.35] "m" Vector__XXX
 SG_ Objects_Lane_Movement_Type_Obj7 : 0|2@1+ (1,0) [0|2] "ENUM" Vector__XXX
 SG_ Objects_Reserved3_Obj7 : 0|1@1+ (1,0) [0|0] "NA" Vector__XXX
 SG_ Objects_Brake_Light_Obj7 : 0|2@1+ (1,0) [0|2] "ENUM" Vector__XXX
 SG_ Objects_Relative_Velocity_Obj7 : 0|13@1+ (0.05,-128) [-128|128] "m/s" Vector__XXX
 SG_ Objects_Reserved2_Obj7 : 0|3@1+ (1,0) [0|0] "NA" Vector__XXX
 SG_ Objects_RightAnglePredicted_Obj7 : 0|1@1+ (1,0) [0|1] "bool" Vector__XXX
 SG_ Objects_LeftAnglePredicted_Obj7 : 0|1@1+ (1,0) [0|1] "bool" Vector__XXX
 SG_ Objects_Acceleration_Abs_Obj7 : 0|9@1+ (0.05,-12.8) [-12.8|12.75] "m/s2" Vector__XXX
 SG_ Objects_Turn_Indicator_Obj7 : 0|3@1+ (1,0) [0|4] "ENUM" Vector__XXX
 SG_ Objects_Angle_Right_Obj7 : 0|13@1+ (0.0002,-0.8192) [-0.8192|0.819] "rad" Vector__XXX
 SG_ Objects_Reserved4_Obj6 : 0|1@1+ (1,0) [0|0] "NA" Vector__XXX
 SG_ Objects_Width_Obj6 : 0|7@1+ (0.05,0) [0|6.35] "m" Vector__XXX
 SG_ Objects_Lane_Movement_Type_Obj6 : 0|2@1+ (1,0) [0|2] "ENUM" Vector__XXX
 SG_ Objects_Reserved3_Obj6 : 0|1@1+ (1,0) [0|0] "NA" Vector__XXX
 SG_ Objects_Brake_Light_Obj6 : 0|2@1+ (1,0) [0|2] "ENUM" Vector__XXX
 SG_ Objects_Relative_Velocity_Obj6 : 0|13@1+ (0.05,-128) [-128|128] "m/s" Vector__XXX
 SG_ Objects_Reserved2_Obj6 : 0|3@1+ (1,0) [0|0] "NA" Vector__XXX
 SG_ Objects_RightAnglePredicted_Obj6 : 0|1@1+ (1,0) [0|1] "bool" Vector__XXX
 SG_ Objects_LeftAnglePredicted_Obj6 : 0|1@1+ (1,0) [0|1] "bool" Vector__XXX
 SG_ Objects_Acceleration_Abs_Obj6 : 0|9@1+ (0.05,-12.8) [-12.8|12.75] "m/s2" Vector__XXX
 SG_ Objects_Turn_Indicator_Obj6 : 0|3@1+ (1,0) [0|4] "ENUM" Vector__XXX
 SG_ Objects_Angle_Right_Obj6 : 0|13@1+ (0.0002,-0.8192) [-0.8192|0.819] "rad" Vector__XXX
 SG_ Objects_Reserved4_Obj5 : 0|1@1+ (1,0) [0|0] "NA" Vector__XXX
 SG_ Objects_Width_Obj5 : 0|7@1+ (0.05,0) [0|6.35] "m" Vector__XXX
 SG_ Objects_Lane_Movement_Type_Obj5 : 0|2@1+ (1,0) [0|2] "ENUM" Vector__XXX
 SG_ Objects_Reserved3_Obj5 : 0|1@1+ (1,0) [0|0] "NA" Vector__XXX
 SG_ Objects_Brake_Light_Obj5 : 0|2@1+ (1,0) [0|2] "ENUM" Vector__XXX
 SG_ Objects_Relative_Velocity_Obj5 : 0|13@1+ (0.05,-128) [-128|128] "m/s" Vector__XXX
 SG_ Objects_Reserved2_Obj5 : 0|3@1+ (1,0) [0|0] "NA" Vector__XXX
 SG_ Objects_RightAnglePredicted_Obj5 : 0|1@1+ (1,0) [0|1] "bool" Vector__XXX
 SG_ Objects_LeftAnglePredicted_Obj5 : 0|1@1+ (1,0) [0|1] "bool" Vector__XXX
 SG_ Objects_Acceleration_Abs_Obj5 : 0|9@1+ (0.05,-12.8) [-12.8|12.75] "m/s2" Vector__XXX
 SG_ Objects_Turn_Indicator_Obj5 : 0|3@1+ (1,0) [0|4] "ENUM" Vector__XXX
 SG_ Objects_Angle_Right_Obj5 : 0|13@1+ (0.0002,-0.8192) [-0.8192|0.819] "rad" Vector__XXX
 SG_ Objects_Lane_Assignment_Obj8 : 0|3@1+ (1,0) [0|5] "ENUM" Vector__XXX
 SG_ Objects_Angle_Left_Obj8 : 0|13@1+ (0.0002,-0.8192) [-0.8192|0.819] "rad" Vector__XXX
 SG_ Objects_Motion_Status_Obj8 : 0|4@1+ (1,0) [0|8] "ENUM" Vector__XXX
 SG_ Objects_Longitudial_Dist_Obj8 : 0|12@1+ (0.05,0) [0|204.75] "m" Vector__XXX
 SG_ Objects_Reserved1_Obj8 : 0|1@1+ (1,0) [0|0] "NA" Vector__XXX
 SG_ Objects_ID_Obj8 : 0|7@1+ (1,0) [1|63] "counter" Vector__XXX
 SG_ Objects_Object_Class_Obj8 : 0|3@1+ (1,0) [0|6] "ENUM" Vector__XXX
 SG_ Objects_Object_Index_Obj8 : 0|5@1+ (1,0) [0|19] "counter" Vector__XXX
 SG_ Objects_Sync_Frame_Index_Obj8 : 0|8@1+ (1,0) [0|255] "counter" Vector__XXX
 SG_ Objects_Zero_byte_Obj8 : 0|8@1+ (1,0) [0|0] "NA" Vector__XXX
 SG_ Objects_Lane_Assignment_Obj9 : 0|3@1+ (1,0) [0|5] "ENUM" Vector__XXX
 SG_ Objects_Angle_Left_Obj9 : 0|13@1+ (0.0002,-0.8192) [-0.8192|0.819] "rad" Vector__XXX
 SG_ Objects_Motion_Status_Obj9 : 0|4@1+ (1,0) [0|8] "ENUM" Vector__XXX
 SG_ Objects_Longitudial_Dist_Obj9 : 0|12@1+ (0.05,0) [0|204.75] "m" Vector__XXX
 SG_ Objects_Reserved1_Obj9 : 0|1@1+ (1,0) [0|0] "NA" Vector__XXX
 SG_ Objects_ID_Obj9 : 0|7@1+ (1,0) [1|63] "counter" Vector__XXX
 SG_ Objects_Object_Class_Obj9 : 0|3@1+ (1,0) [0|6] "ENUM" Vector__XXX
 SG_ Objects_Object_Index_Obj9 : 0|5@1+ (1,0) [0|19] "counter" Vector__XXX
 SG_ Objects_Sync_Frame_Index_Obj9 : 0|8@1+ (1,0) [0|255] "counter" Vector__XXX
 SG_ Objects_Zero_byte_Obj9 : 0|8@1+ (1,0) [0|0] "NA" Vector__XXX
 SG_ Objects_Lane_Assignment_Obj7 : 0|3@1+ (1,0) [0|5] "ENUM" Vector__XXX
 SG_ Objects_Angle_Left_Obj7 : 0|13@1+ (0.0002,-0.8192) [-0.8192|0.819] "rad" Vector__XXX
 SG_ Objects_Motion_Status_Obj7 : 0|4@1+ (1,0) [0|8] "ENUM" Vector__XXX
 SG_ Objects_Longitudial_Dist_Obj7 : 0|12@1+ (0.05,0) [0|204.75] "m" Vector__XXX
 SG_ Objects_Reserved1_Obj7 : 0|1@1+ (1,0) [0|0] "NA" Vector__XXX
 SG_ Objects_ID_Obj7 : 0|7@1+ (1,0) [1|63] "counter" Vector__XXX
 SG_ Objects_Object_Class_Obj7 : 0|3@1+ (1,0) [0|6] "ENUM" Vector__XXX
 SG_ Objects_Object_Index_Obj7 : 0|5@1+ (1,0) [0|19] "counter" Vector__XXX
 SG_ Objects_Sync_Frame_Index_Obj7 : 0|8@1+ (1,0) [0|255] "counter" Vector__XXX
 SG_ Objects_Zero_byte_Obj7 : 0|8@1+ (1,0) [0|0] "NA" Vector__XXX
 SG_ Objects_Lane_Assignment_Obj6 : 0|3@1+ (1,0) [0|5] "ENUM" Vector__XXX
 SG_ Objects_Angle_Left_Obj6 : 0|13@1+ (0.0002,-0.8192) [-0.8192|0.819] "rad" Vector__XXX
 SG_ Objects_Motion_Status_Obj6 : 0|4@1+ (1,0) [0|8] "ENUM" Vector__XXX
 SG_ Objects_Longitudial_Dist_Obj6 : 0|12@1+ (0.05,0) [0|204.75] "m" Vector__XXX
 SG_ Objects_Reserved1_Obj6 : 0|1@1+ (1,0) [0|0] "NA" Vector__XXX
 SG_ Objects_ID_Obj6 : 0|7@1+ (1,0) [1|63] "counter" Vector__XXX
 SG_ Objects_Object_Class_Obj6 : 0|3@1+ (1,0) [0|6] "ENUM" Vector__XXX
 SG_ Objects_Object_Index_Obj6 : 0|5@1+ (1,0) [0|19] "counter" Vector__XXX
 SG_ Objects_Sync_Frame_Index_Obj6 : 0|8@1+ (1,0) [0|255] "counter" Vector__XXX
 SG_ Objects_Zero_byte_Obj6 : 0|8@1+ (1,0) [0|0] "NA" Vector__XXX
 SG_ Objects_Lane_Assignment_Obj5 : 0|3@1+ (1,0) [0|5] "ENUM" Vector__XXX
 SG_ Objects_Angle_Left_Obj5 : 0|13@1+ (0.0002,-0.8192) [-0.8192|0.819] "rad" Vector__XXX
 SG_ Objects_Motion_Status_Obj5 : 0|4@1+ (1,0) [0|8] "ENUM" Vector__XXX
 SG_ Objects_Longitudial_Dist_Obj5 : 0|12@1+ (0.05,0) [0|204.75] "m" Vector__XXX
 SG_ Objects_Reserved1_Obj5 : 0|1@1+ (1,0) [0|0] "NA" Vector__XXX
 SG_ Objects_ID_Obj5 : 0|7@1+ (1,0) [1|63] "counter" Vector__XXX
 SG_ Objects_Object_Class_Obj5 : 0|3@1+ (1,0) [0|6] "ENUM" Vector__XXX
 SG_ Objects_Object_Index_Obj5 : 0|5@1+ (1,0) [0|19] "counter" Vector__XXX
 SG_ Objects_Sync_Frame_Index_Obj5 : 0|8@1+ (1,0) [0|255] "counter" Vector__XXX
 SG_ Objects_Zero_byte_Obj5 : 0|8@1+ (1,0) [0|0] "NA" Vector__XXX
 SG_ TSR0_Confidence : 0|8@1+ (0.01,0) [0|1] "" Vector__XXX
 SG_ TSR1_Confidence : 0|8@1+ (0.01,0) [0|1] "" Vector__XXX
 SG_ TSR2_Confidence : 0|8@1+ (0.01,0) [0|1] "" Vector__XXX
 SG_ TSR3_Confidence : 0|8@1+ (0.01,0) [0|1] "" Vector__XXX
 SG_ TSR4_Confidence : 0|8@1+ (0.01,0) [0|1] "" Vector__XXX
 SG_ TSR5_Confidence : 0|8@1+ (0.01,0) [0|1] "" Vector__XXX
 SG_ TSR6_Confidence : 0|8@1+ (0.01,0) [0|1] "" Vector__XXX
 SG_ ALG_Sys_TSR_Speed_Limit_Memory : 0|32@0+ (1.5287890625E-005,0) [0|0] "" Vector__XXX
 SG_ ALG_Sys_ACC_Set_Speed_Memory : 0|32@0+ (1.5287890625E-005,0) [0|0] "" Vector__XXX
 SG_ ALG_ACC_Desired_AX : 0|16@0- (0.00390625,0) [0|0] "" Vector__XXX
 SG_ ALG_ACC_Mode : 0|8@0+ (1,0) [0|0] "" Vector__XXX
 SG_ ALG_Sys_ACC_Headway_Memory : 0|8@0+ (1,0) [0|0] "" Vector__XXX
 SG_ ALG_TSR_Quit_Indicator : 0|1@0+ (1,0) [0|0] "" Vector__XXX
 SG_ ALG_TSR_NRTA_Indicator : 0|1@0+ (1,0) [0|0] "" Vector__XXX
 SG_ ALG_LDW_Quit_Indicator : 0|1@0+ (1,0) [0|0] "" Vector__XXX
 SG_ ALG_LDW_NRTA_Indicator : 0|1@0+ (1,0) [0|0] "" Vector__XXX
 SG_ ALG_IHC_Quit_Indicator : 0|1@0+ (1,0) [0|0] "" Vector__XXX
 SG_ ALG_IHC_NRTA_Indicator : 0|1@0+ (1,0) [0|0] "" Vector__XXX
 SG_ ALG_FCW_Quit_Indicator : 0|1@0+ (1,0) [0|0] "" Vector__XXX
 SG_ ALG_FCW_NRTA_Indicator : 0|1@0+ (1,0) [0|0] "" Vector__XXX
 SG_ ALG_AEB_Quit_Indicator : 0|1@0+ (1,0) [0|0] "" Vector__XXX
 SG_ ALG_AEB_NRTA_Indicator : 0|1@0+ (1,0) [0|0] "" Vector__XXX
 SG_ ALG_ACC_ToqRequest_Status : 0|1@0+ (1,0) [0|0] "" Vector__XXX
 SG_ ALG_ACC_Quit_Indicator : 0|1@0+ (1,0) [0|0] "" Vector__XXX
 SG_ ALG_ACC_NRTA_Indicator : 0|1@0+ (1,0) [0|0] "" Vector__XXX
 SG_ ALG_ACC_DclRequest_Status : 0|1@0+ (1,0) [0|0] "" Vector__XXX
 SG_ ALG_TSR_NRTA_Reason : 0|64@0+ (1,0) [0|0] "" Vector__XXX
 SG_ ALG_TSR_Quit_Reason : 0|64@0+ (1,0) [0|0] "" Vector__XXX
 SG_ ALG_IHC_NRTA_Reason : 0|64@0+ (1,0) [0|0] "" Vector__XXX
 SG_ ALG_IHC_Quit_Reason : 0|64@0+ (1,0) [0|0] "" Vector__XXX
 SG_ ALG_ACC_NRTA_Reason : 0|64@0+ (1,0) [0|0] "" Vector__XXX
 SG_ ALG_ACC_Quit_Reason : 0|64@0+ (1,0) [0|0] "" Vector__XXX
 SG_ ALG_AEB_NRTA_Reason : 0|64@0+ (1,0) [0|0] "" Vector__XXX
 SG_ ALG_AEB_Quit_Reason : 0|64@0+ (1,0) [0|0] "" Vector__XXX
 SG_ ALG_FCW_Quit_Reason : 0|64@0+ (1,0) [0|0] "" Vector__XXX
 SG_ ALG_FCW_NRTA_Reason : 0|64@0+ (1,0) [0|0] "" Vector__XXX
 SG_ ALG_LDW_NRTA_Reason : 0|64@0+ (1,0) [0|0] "" Vector__XXX
 SG_ ALG_LDW_Quit_Reason : 0|64@0+ (1,0) [0|0] "" Vector__XXX
 SG_ DiagnosticFuncAddrReq_b0 : 0|8@0+ (1,0) [0|0] "" Vector__XXX
 SG_ DiagnosticFuncAddrReq_b1 : 0|8@0+ (1,0) [0|0] "" Vector__XXX
 SG_ DiagnosticFuncAddrReq_b2 : 0|8@0+ (1,0) [0|0] "" Vector__XXX
 SG_ DiagnosticFuncAddrReq_b3 : 0|8@0+ (1,0) [0|0] "" Vector__XXX
 SG_ DiagnosticFuncAddrReq_b4 : 0|8@0+ (1,0) [0|0] "" Vector__XXX
 SG_ DiagnosticFuncAddrReq_b5 : 0|8@0+ (1,0) [0|0] "" Vector__XXX
 SG_ DiagnosticFuncAddrReq_b6 : 0|8@0+ (1,0) [0|0] "" Vector__XXX
 SG_ DiagnosticFuncAddrReq_b7 : 0|8@0+ (1,0) [0|0] "" Vector__XXX
 SG_ FAS_DiagInfoResp : 0|64@1+ (1,0) [0|0] "" Vector__XXX
 SG_ FAS_DiagInfoReq : 0|64@1+ (1,0) [0|0] "" Vector__XXX
 SG_ GFHB_Ushape_syncFrameIndex : 0|8@1+ (1,0) [0|255] "" Vector__XXX
 SG_ GFHB_Ushape_Reserved2 : 0|6@1+ (1,0) [0|0] "" Vector__XXX
 SG_ BNDRY_DOM_RH_NGL_HLB : 0|9@1+ (0.1,-20) [-20|20] "degree" Vector__XXX
 SG_ BNDRY_DOM_LH_NGL_HLB : 0|9@1+ (0.1,-20) [-20|20] "degree" Vector__XXX
 SG_ BNDRY_DOM_BOT_NGL_HLB : 0|8@1+ (0.1,-10) [-10|10] "degree" Vector__XXX
 SG_ ST_BNDRY_DOM_RH_NGL_HLB : 0|4@1+ (1,0) [0|15] "ENUM" Vector__XXX
 SG_ ST_BNDRY_DOM_LH_NGL_HLB : 0|4@1+ (1,0) [0|15] "ENUM" Vector__XXX
 SG_ ST_BNDRY_DOM_BOT_NGL_HLB : 0|4@1+ (1,0) [0|15] "ENUM" Vector__XXX
 SG_ GFHB_Ushape_Num_Of_Objects : 0|4@1+ (1,0) [0|15] "int" Vector__XXX
 SG_ Obj0_HLB_COUPLED_WIDTH : 0|11@1+ (0.04,0) [0|52] "degree" Vector__XXX
 SG_ Obj0_HLB_OBJ_ANG : 0|11@1+ (0.04,-26) [-26|26] "degree" Vector__XXX
 SG_ Obj0_HLB_OBJ_DIST : 0|10@1+ (1,0) [0|1023] "meter" Vector__XXX
 SG_ Obj0_HLB_OBJ_TYPE : 0|4@1+ (1,0) [0|15] "int" Vector__XXX
 SG_ Obj0_HLB_OBJ_VALID : 0|1@1+ (1,0) [0|1] "bool" Vector__XXX
 SG_ Obj0_syncFrameIndex : 0|8@1+ (1,0) [0|255] "" Vector__XXX
 SG_ Obj0_Reserved1 : 0|3@1+ (1,0) [0|0] "" Vector__XXX
 SG_ Obj1_HLB_COUPLED_WIDTH : 0|11@1+ (0.04,0) [0|52] "degree" Vector__XXX
 SG_ Obj1_HLB_OBJ_ANG : 0|11@1+ (0.04,-26) [-26|26] "degree" Vector__XXX
 SG_ Obj1_HLB_OBJ_DIST : 0|10@1+ (1,0) [0|1023] "meter" Vector__XXX
 SG_ Obj1_HLB_OBJ_TYPE : 0|4@1+ (1,0) [0|15] "int" Vector__XXX
 SG_ Obj1_HLB_OBJ_VALID : 0|1@1+ (1,0) [0|1] "bool" Vector__XXX
 SG_ Obj1_syncFrameIndex : 0|8@1+ (1,0) [0|255] "" Vector__XXX
 SG_ Obj1_Reserved1 : 0|3@1+ (1,0) [0|0] "" Vector__XXX
 SG_ Obj2_syncFrameIndex : 0|8@1+ (1,0) [0|255] "" Vector__XXX
 SG_ Obj2_Reserved1 : 0|3@1+ (1,0) [0|0] "" Vector__XXX
 SG_ Obj2_HLB_OBJ_ANG : 0|11@1+ (0.04,-26) [-26|26] "degree" Vector__XXX
 SG_ Obj2_HLB_COUPLED_WIDTH : 0|11@1+ (0.04,0) [0|52] "degree" Vector__XXX
 SG_ Obj2_HLB_OBJ_DIST : 0|10@1+ (1,0) [0|1023] "meter" Vector__XXX
 SG_ Obj2_HLB_OBJ_TYPE : 0|4@1+ (1,0) [0|15] "int" Vector__XXX
 SG_ Obj2_HLB_OBJ_VALID : 0|1@1+ (1,0) [0|1] "bool" Vector__XXX
 SG_ Obj3_syncFrameIndex : 0|8@1+ (1,0) [0|255] "" Vector__XXX
 SG_ Obj3_Reserved1 : 0|3@1+ (1,0) [0|0] "" Vector__XXX
 SG_ Obj3_HLB_OBJ_ANG : 0|11@1+ (0.04,-26) [-26|26] "degree" Vector__XXX
 SG_ Obj3_HLB_COUPLED_WIDTH : 0|11@1+ (0.04,0) [0|52] "degree" Vector__XXX
 SG_ Obj3_HLB_OBJ_DIST : 0|10@1+ (1,0) [0|1023] "meter" Vector__XXX
 SG_ Obj3_HLB_OBJ_TYPE : 0|4@1+ (1,0) [0|15] "int" Vector__XXX
 SG_ Obj3_HLB_OBJ_VALID : 0|1@1+ (1,0) [0|1] "bool" Vector__XXX
 SG_ Obj4_syncFrameIndex : 0|8@1+ (1,0) [0|255] "" Vector__XXX
 SG_ Obj4_Reserved1 : 0|3@1+ (1,0) [0|0] "" Vector__XXX
 SG_ Obj4_HLB_OBJ_ANG : 0|11@1+ (0.04,-26) [-26|26] "degree" Vector__XXX
 SG_ Obj4_HLB_COUPLED_WIDTH : 0|11@1+ (0.04,0) [0|52] "degree" Vector__XXX
 SG_ Obj4_HLB_OBJ_DIST : 0|10@1+ (1,0) [0|1023] "meter" Vector__XXX
 SG_ Obj4_HLB_OBJ_TYPE : 0|4@1+ (1,0) [0|15] "int" Vector__XXX
 SG_ Obj4_HLB_OBJ_VALID : 0|1@1+ (1,0) [0|1] "bool" Vector__XXX
 SG_ Obj5_syncFrameIndex : 0|8@1+ (1,0) [0|255] "" Vector__XXX
 SG_ Obj5_Reserved1 : 0|3@1+ (1,0) [0|0] "" Vector__XXX
 SG_ Obj5_HLB_OBJ_ANG : 0|11@1+ (0.04,-26) [-26|26] "degree" Vector__XXX
 SG_ Obj5_HLB_COUPLED_WIDTH : 0|11@1+ (0.04,0) [0|52] "degree" Vector__XXX
 SG_ Obj5_HLB_OBJ_DIST : 0|10@1+ (1,0) [0|1023] "meter" Vector__XXX
 SG_ Obj5_HLB_OBJ_TYPE : 0|4@1+ (1,0) [0|15] "int" Vector__XXX
 SG_ Obj5_HLB_OBJ_VALID : 0|1@1+ (1,0) [0|1] "bool" Vector__XXX
 SG_ Obj6_syncFrameIndex : 0|8@1+ (1,0) [0|255] "" Vector__XXX
 SG_ Obj6_Reserved1 : 0|3@1+ (1,0) [0|0] "" Vector__XXX
 SG_ Obj6_HLB_OBJ_ANG : 0|11@1+ (0.04,-26) [-26|26] "degree" Vector__XXX
 SG_ Obj6_HLB_COUPLED_WIDTH : 0|11@1+ (0.04,0) [0|52] "degree" Vector__XXX
 SG_ Obj6_HLB_OBJ_DIST : 0|10@1+ (1,0) [0|1023] "meter" Vector__XXX
 SG_ Obj6_HLB_OBJ_TYPE : 0|4@1+ (1,0) [0|15] "int" Vector__XXX
 SG_ Obj6_HLB_OBJ_VALID : 0|1@1+ (1,0) [0|1] "bool" Vector__XXX
 SG_ Obj7_syncFrameIndex : 0|8@1+ (1,0) [0|255] "" Vector__XXX
 SG_ Obj7_Reserved1 : 0|3@1+ (1,0) [0|0] "" Vector__XXX
 SG_ Obj7_HLB_OBJ_ANG : 0|11@1+ (0.04,-26) [-26|26] "degree" Vector__XXX
 SG_ Obj7_HLB_COUPLED_WIDTH : 0|11@1+ (0.04,0) [0|52] "degree" Vector__XXX
 SG_ Obj7_HLB_OBJ_DIST : 0|10@1+ (1,0) [0|1023] "meter" Vector__XXX
 SG_ Obj7_HLB_OBJ_TYPE : 0|4@1+ (1,0) [0|15] "int" Vector__XXX
 SG_ Obj7_HLB_OBJ_VALID : 0|1@1+ (1,0) [0|1] "bool" Vector__XXX
 SG_ Obj8_syncFrameIndex : 0|8@1+ (1,0) [0|255] "" Vector__XXX
 SG_ Obj8_Reserved1 : 0|3@1+ (1,0) [0|0] "" Vector__XXX
 SG_ Obj8_HLB_OBJ_ANG : 0|11@1+ (0.04,-26) [-26|26] "degree" Vector__XXX
 SG_ Obj8_HLB_COUPLED_WIDTH : 0|11@1+ (0.04,0) [0|52] "degree" Vector__XXX
 SG_ Obj8_HLB_OBJ_DIST : 0|10@1+ (1,0) [0|1023] "meter" Vector__XXX
 SG_ Obj8_HLB_OBJ_TYPE : 0|4@1+ (1,0) [0|15] "int" Vector__XXX
 SG_ Obj8_HLB_OBJ_VALID : 0|1@1+ (1,0) [0|1] "bool" Vector__XXX
 SG_ Obj9_syncFrameIndex : 0|8@1+ (1,0) [0|255] "" Vector__XXX
 SG_ Obj9_Reserved1 : 0|3@1+ (1,0) [0|0] "" Vector__XXX
 SG_ Obj9_HLB_OBJ_ANG : 0|11@1+ (0.04,-26) [-26|26] "degree" Vector__XXX
 SG_ Obj9_HLB_COUPLED_WIDTH : 0|11@1+ (0.04,0) [0|52] "degree" Vector__XXX
 SG_ Obj9_HLB_OBJ_DIST : 0|10@1+ (1,0) [0|1023] "meter" Vector__XXX
 SG_ Obj9_HLB_OBJ_TYPE : 0|4@1+ (1,0) [0|15] "int" Vector__XXX
 SG_ Obj9_HLB_OBJ_VALID : 0|1@1+ (1,0) [0|1] "bool" Vector__XXX
 SG_ Obj10_syncFrameIndex : 0|8@1+ (1,0) [0|255] "" Vector__XXX
 SG_ Obj10_Reserved1 : 0|3@1+ (1,0) [0|0] "" Vector__XXX
 SG_ Obj10_HLB_OBJ_ANG : 0|11@1+ (0.04,-26) [-26|26] "degree" Vector__XXX
 SG_ Obj10_HLB_COUPLED_WIDTH : 0|11@1+ (0.04,0) [0|52] "degree" Vector__XXX
 SG_ Obj10_HLB_OBJ_DIST : 0|10@1+ (1,0) [0|1023] "meter" Vector__XXX
 SG_ Obj10_HLB_OBJ_TYPE : 0|4@1+ (1,0) [0|15] "int" Vector__XXX
 SG_ Obj10_HLB_OBJ_VALID : 0|1@1+ (1,0) [0|1] "bool" Vector__XXX
 SG_ Obj11_syncFrameIndex : 0|8@1+ (1,0) [0|255] "" Vector__XXX
 SG_ Obj11_Reserved1 : 0|3@1+ (1,0) [0|0] "" Vector__XXX
 SG_ Obj11_HLB_OBJ_ANG : 0|11@1+ (0.04,-26) [-26|26] "degree" Vector__XXX
 SG_ Obj11_HLB_COUPLED_WIDTH : 0|11@1+ (0.04,0) [0|52] "degree" Vector__XXX
 SG_ Obj11_HLB_OBJ_DIST : 0|10@1+ (1,0) [0|1023] "meter" Vector__XXX
 SG_ Obj11_HLB_OBJ_TYPE : 0|4@1+ (1,0) [0|15] "int" Vector__XXX
 SG_ Obj11_HLB_OBJ_VALID : 0|1@1+ (1,0) [0|1] "bool" Vector__XXX
 SG_ fvcm_debug_uint16_reserved : 0|16@1+ (1,0) [0|0] "" Vector__XXX
 SG_ fvcm_debug_uint8_reserved5 : 0|8@1+ (1,0) [0|0] "" Vector__XXX
 SG_ fvcm_debug_uint8_reserved4 : 0|8@1+ (1,0) [0|0] "" Vector__XXX
 SG_ fvcm_debug_uint8_reserved3 : 0|8@1+ (1,0) [0|0] "" Vector__XXX
 SG_ fvcm_debug_uint8_reserved2 : 0|8@1+ (1,0) [0|0] "" Vector__XXX
 SG_ fvcm_debug_uint8_reserved1 : 0|8@1+ (1,0) [0|0] "" Vector__XXX
 SG_ fvcm_debug_uint8_reserved : 0|8@1+ (1,0) [0|0] "" Vector__XXX
 SG_ fvcm_max_cpu_load : 0|8@1+ (1,0) [0|0] "" Vector__XXX
 SG_ fvcm_current_cpu_load : 0|8@1+ (1,0) [0|0] "" Vector__XXX
 SG_ singal_validation_rc : 0|16@1+ (1,0) [0|0] "" Vector__XXX
 SG_ singal_validation_pv : 0|16@1+ (1,0) [0|0] "" Vector__XXX
 SG_ singal_validation_chksm : 0|16@1+ (1,0) [0|0] "" Vector__XXX
 SG_ TAC2_Reserved_1 : 0|16@1+ (1,0) [0|0] "" Vector__XXX
 SG_ TAC2_Roll_Angle : 0|8@1+ (0.001,-0.055) [-0.055|0.055] "Radians" Vector__XXX
 SG_ TAC2_Horizon : 0|16@1+ (1,-40) [-40|62] "Pixel" Vector__XXX
 SG_ TAC2_Status : 0|8@1+ (1,0) [0|11] "ENUM" Vector__XXX
 SG_ TAC2_Yaw : 0|16@1+ (1,-47) [-47|47] "Pixel" Vector__XXX
 SG_ SPC_HorizonFull : 0|16@1+ (1,-160) [-160|248] "Pixels" Vector__XXX
 SG_ SPC_YawFull : 0|16@1+ (1,-188) [-188|188] "Pixels" Vector__XXX
 SG_ SPC_RollAngle : 0|16@1+ (0.001,-0.055) [-0.055|0.055] "radians" Vector__XXX
 SG_ SPC_Status : 0|8@1+ (1,0) [0|255] "ENUM" Vector__XXX
 SG_ SPC_Horizon : 0|8@1+ (1,-40) [-40|62] "Pixels" Vector__XXX
 SG_ SPC_Yaw : 0|8@1+ (1,-47) [-47|47] "Pixels" Vector__XXX
 SG_ SPC_Progress : 0|8@1+ (1,0) [0|100] "%" Vector__XXX
 SG_ SPC_Sync_Frame_Index : 0|8@1+ (1,0) [0|255] "counter" Vector__XXX
 SG_ SPC_Zero_byte : 0|8@1+ (1,0) [0|0] "NA" Vector__XXX
 SG_ App_Reserved5 : 0|48@1+ (1,0) [0|0] "" Vector__XXX
 SG_ App_Minor_Error : 0|16@1+ (1,0) [0|0] "" Vector__XXX
 SG_ App_Reserved4 : 0|8@1+ (1,0) [0|0] "" Vector__XXX
 SG_ Temperture_DDR : 0|8@1+ (1,0) [0|0] "" Vector__XXX
 SG_ Temperature_VPM : 0|16@1- (1,0) [-40|105] "" Vector__XXX
 SG_ Temperature_MISP : 0|16@1- (1,0) [-40|105] "" Vector__XXX
 SG_ Current_Temperature : 0|16@1- (1,0) [-40|105] "" Vector__XXX
 SG_ EyeQ_Current_Timestamp : 0|32@1+ (1,0) [0|0] "" Vector__XXX
 SG_ EyeQ_Timestamp : 0|32@1+ (1,0) [0|0] "" Vector__XXX
 SG_ TSR6_sign_ID : 0|4@1+ (1,0) [0|12] "" Vector__XXX
 SG_ TSR6_Reserved1 : 0|1@1+ (1,0) [0|0] "" Vector__XXX
 SG_ TSR6_Sign_Width : 0|8@1+ (1,0) [0|63] "pixel" Vector__XXX
 SG_ TSR6_VO_supplementarySignType : 0|8@1+ (1,0) [0|255] "ENUM" Vector__XXX
 SG_ TSR6_VO_signType : 0|8@1+ (1,0) [0|255] "ENUM" Vector__XXX
 SG_ TSR6_Sign_Position_Z : 0|7@1+ (0.5,-16) [-16|16] "meters" Vector__XXX
 SG_ TSR6_Sign_Position_Y : 0|7@1+ (0.5,-32) [-32|31] "meters" Vector__XXX
 SG_ TSR6_Sign_Position_X : 0|8@1+ (0.5,0) [0|122] "meters" Vector__XXX
 SG_ TSR6_Sign_Height : 0|5@1+ (1,0) [0|31] "?pixel" Vector__XXX
 SG_ TSR6_No_Entry_Vision_Status : 0|3@1+ (1,0) [0|5] "ENUM" Vector__XXX
 SG_ TSR6_Filter_type : 0|4@1+ (1,0) [0|15] "ENUM" Vector__XXX
 SG_ TSR6_Approved_Flag : 0|1@1+ (1,0) [0|1] "bool" Vector__XXX
 SG_ TSR5_sign_ID : 0|4@1+ (1,0) [0|12] "" Vector__XXX
 SG_ TSR5_Reserved1 : 0|1@1+ (1,0) [0|0] "" Vector__XXX
 SG_ TSR5_Sign_Width : 0|8@1+ (1,0) [0|63] "pixel" Vector__XXX
 SG_ TSR5_VO_supplementarySignType : 0|8@1+ (1,0) [0|255] "ENUM" Vector__XXX
 SG_ TSR5_VO_signType : 0|8@1+ (1,0) [0|255] "ENUM" Vector__XXX
 SG_ TSR5_Sign_Position_Z : 0|7@1+ (0.5,-16) [-16|16] "meters" Vector__XXX
 SG_ TSR5_Sign_Position_Y : 0|7@1+ (0.5,-32) [-32|31] "meters" Vector__XXX
 SG_ TSR5_Sign_Position_X : 0|8@1+ (0.5,0) [0|122] "meters" Vector__XXX
 SG_ TSR5_Sign_Height : 0|5@1+ (1,0) [0|31] "?pixel" Vector__XXX
 SG_ TSR5_No_Entry_Vision_Status : 0|3@1+ (1,0) [0|5] "ENUM" Vector__XXX
 SG_ TSR5_Filter_type : 0|4@1+ (1,0) [0|15] "ENUM" Vector__XXX
 SG_ TSR5_Approved_Flag : 0|1@1+ (1,0) [0|1] "bool" Vector__XXX
 SG_ TSR4_sign_ID : 0|4@1+ (1,0) [0|12] "" Vector__XXX
 SG_ TSR4_Reserved1 : 0|1@1+ (1,0) [0|0] "" Vector__XXX
 SG_ TSR4_Sign_Width : 0|8@1+ (1,0) [0|63] "pixel" Vector__XXX
 SG_ TSR4_VO_supplementarySignType : 0|8@1+ (1,0) [0|255] "ENUM" Vector__XXX
 SG_ TSR4_VO_signType : 0|8@1+ (1,0) [0|255] "ENUM" Vector__XXX
 SG_ TSR4_Sign_Position_Z : 0|7@1+ (0.5,-16) [-16|16] "meters" Vector__XXX
 SG_ TSR4_Sign_Position_Y : 0|7@1+ (0.5,-32) [-32|31] "meters" Vector__XXX
 SG_ TSR4_Sign_Position_X : 0|8@1+ (0.5,0) [0|122] "meters" Vector__XXX
 SG_ TSR4_Sign_Height : 0|5@1+ (1,0) [0|31] "?pixel" Vector__XXX
 SG_ TSR4_No_Entry_Vision_Status : 0|3@1+ (1,0) [0|5] "ENUM" Vector__XXX
 SG_ TSR4_Filter_type : 0|4@1+ (1,0) [0|15] "ENUM" Vector__XXX
 SG_ TSR4_Approved_Flag : 0|1@1+ (1,0) [0|1] "bool" Vector__XXX
 SG_ TSR3_sign_ID : 0|4@1+ (1,0) [0|12] "" Vector__XXX
 SG_ TSR3_Reserved1 : 0|1@1+ (1,0) [0|0] "" Vector__XXX
 SG_ TSR3_Sign_Width : 0|8@1+ (1,0) [0|63] "pixel" Vector__XXX
 SG_ TSR3_VO_supplementarySignType : 0|8@1+ (1,0) [0|255] "ENUM" Vector__XXX
 SG_ TSR3_VO_signType : 0|8@1+ (1,0) [0|255] "ENUM" Vector__XXX
 SG_ TSR3_Sign_Position_Z : 0|7@1+ (0.5,-16) [-16|16] "meters" Vector__XXX
 SG_ TSR3_Sign_Position_Y : 0|7@1+ (0.5,-32) [-32|31] "meters" Vector__XXX
 SG_ TSR3_Sign_Position_X : 0|8@1+ (0.5,0) [0|122] "meters" Vector__XXX
 SG_ TSR3_Sign_Height : 0|5@1+ (1,0) [0|31] "?pixel" Vector__XXX
 SG_ TSR3_No_Entry_Vision_Status : 0|3@1+ (1,0) [0|5] "ENUM" Vector__XXX
 SG_ TSR3_Filter_type : 0|4@1+ (1,0) [0|15] "ENUM" Vector__XXX
 SG_ TSR3_Approved_Flag : 0|1@1+ (1,0) [0|1] "bool" Vector__XXX
 SG_ TSR2_sign_ID : 0|4@1+ (1,0) [0|12] "" Vector__XXX
 SG_ TSR2_Reserved1 : 0|1@1+ (1,0) [0|0] "" Vector__XXX
 SG_ TSR2_Sign_Width : 0|8@1+ (1,0) [0|63] "pixel" Vector__XXX
 SG_ TSR2_VO_supplementarySignType : 0|8@1+ (1,0) [0|255] "ENUM" Vector__XXX
 SG_ TSR2_VO_signType : 0|8@1+ (1,0) [0|255] "ENUM" Vector__XXX
 SG_ TSR2_Sign_Position_Z : 0|7@1+ (0.5,-16) [-16|16] "meters" Vector__XXX
 SG_ TSR2_Sign_Position_Y : 0|7@1+ (0.5,-32) [-32|31] "meters" Vector__XXX
 SG_ TSR2_Sign_Position_X : 0|8@1+ (0.5,0) [0|122] "meters" Vector__XXX
 SG_ TSR2_Sign_Height : 0|5@1+ (1,0) [0|31] "?pixel" Vector__XXX
 SG_ TSR2_No_Entry_Vision_Status : 0|3@1+ (1,0) [0|5] "ENUM" Vector__XXX
 SG_ TSR2_Filter_type : 0|4@1+ (1,0) [0|15] "ENUM" Vector__XXX
 SG_ TSR2_Approved_Flag : 0|1@1+ (1,0) [0|1] "bool" Vector__XXX
 SG_ TSR1_sign_ID : 0|4@1+ (1,0) [0|12] "" Vector__XXX
 SG_ TSR1_Reserved1 : 0|1@1+ (1,0) [0|0] "" Vector__XXX
 SG_ TSR1_Sign_Width : 0|8@1+ (1,0) [0|63] "pixel" Vector__XXX
 SG_ TSR1_VO_supplementarySignType : 0|8@1+ (1,0) [0|255] "ENUM" Vector__XXX
 SG_ TSR1_VO_signType : 0|8@1+ (1,0) [0|255] "ENUM" Vector__XXX
 SG_ TSR1_Sign_Position_Z : 0|7@1+ (0.5,-16) [-16|16] "meters" Vector__XXX
 SG_ TSR1_Sign_Position_Y : 0|7@1+ (0.5,-32) [-32|31] "meters" Vector__XXX
 SG_ TSR1_Sign_Position_X : 0|8@1+ (0.5,0) [0|122] "meters" Vector__XXX
 SG_ TSR1_Sign_Height : 0|5@1+ (1,0) [0|31] "?pixel" Vector__XXX
 SG_ TSR1_No_Entry_Vision_Status : 0|3@1+ (1,0) [0|5] "ENUM" Vector__XXX
 SG_ TSR1_Filter_type : 0|4@1+ (1,0) [0|15] "ENUM" Vector__XXX
 SG_ TSR1_Approved_Flag : 0|1@1+ (1,0) [0|1] "bool" Vector__XXX
 SG_ TSR0_sign_ID : 0|4@1+ (1,0) [0|12] "" Vector__XXX
 SG_ TSR0_Reserved1 : 0|1@1+ (1,0) [0|0] "" Vector__XXX
 SG_ TSR0_Sign_Width : 0|8@1+ (1,0) [0|63] "pixel" Vector__XXX
 SG_ TSR0_VO_supplementarySignType : 0|8@1+ (1,0) [0|255] "ENUM" Vector__XXX
 SG_ TSR0_VO_signType : 0|8@1+ (1,0) [0|255] "ENUM" Vector__XXX
 SG_ TSR0_Sign_Position_Z : 0|7@1+ (0.5,-16) [-16|16] "meters" Vector__XXX
 SG_ TSR0_Sign_Position_Y : 0|7@1+ (0.5,-32) [-32|31] "meters" Vector__XXX
 SG_ TSR0_Sign_Position_X : 0|8@1+ (0.5,0) [0|122] "meters" Vector__XXX
 SG_ TSR0_Sign_Height : 0|5@1+ (1,0) [0|31] "?pixel" Vector__XXX
 SG_ TSR0_No_Entry_Vision_Status : 0|3@1+ (1,0) [0|5] "ENUM" Vector__XXX
 SG_ TSR0_Filter_type : 0|4@1+ (1,0) [0|15] "ENUM" Vector__XXX
 SG_ TSR0_Approved_Flag : 0|1@1+ (1,0) [0|1] "bool" Vector__XXX
 SG_ Boot_Test_Results : 0|16@1+ (1,0) [0|0] "" Vector__XXX
 SG_ Boot_LPDDR2_Temperature_Status : 0|8@1- (1,0) [0|0] "" Vector__XXX
 SG_ Boot_EyeQ_Temperature_VMP : 0|8@1- (1,0) [0|0] "" Vector__XXX
 SG_ Boot_EyeQ_Temperature_CPU : 0|8@1- (1,0) [0|0] "" Vector__XXX
 SG_ Boot_EyeQ_ST_TEST : 0|32@1+ (1,0) [0|0] "" Vector__XXX
 SG_ Boot_EyeQ_Lot_number : 0|32@1+ (1,0) [0|0] "" Vector__XXX
 SG_ Boot_Boot_Version : 0|32@1+ (1,0) [0|0] "" Vector__XXX
 SG_ Boot_Application_Version : 0|32@1+ (1,0) [0|0] "" Vector__XXX
 SG_ CS_syncFrameIndex : 0|8@1+ (1,0) [0|0] "" Vector__XXX
 SG_ TSM3_VO_supplementarySignType : 0|8@1+ (1,0) [0|255] "ENUM" Vector__XXX
 SG_ TSM3_VO_signType : 0|8@1+ (1,0) [0|255] "ENUM" Vector__XXX
 SG_ TSM3_syncFrameIndex : 0|8@1+ (1,0) [0|255] "" Vector__XXX
 SG_ TSM3_UART_zero : 0|8@1+ (1,0) [0|0] "" Vector__XXX
 SG_ TSM2_VO_supplementarySignType : 0|8@1+ (1,0) [0|255] "ENUM" Vector__XXX
 SG_ TSM2_VO_signType : 0|8@1+ (1,0) [0|255] "ENUM" Vector__XXX
 SG_ TSM2_syncFrameIndex : 0|8@1+ (1,0) [0|255] "" Vector__XXX
 SG_ TSM2_UART_zero : 0|8@1+ (1,0) [0|0] "" Vector__XXX
 SG_ TSM1_VO_supplementarySignType : 0|8@1+ (1,0) [0|255] "ENUM" Vector__XXX
 SG_ TSM1_VO_signType : 0|8@1+ (1,0) [0|255] "ENUM" Vector__XXX
 SG_ TSM1_syncFrameIndex : 0|8@1+ (1,0) [0|255] "" Vector__XXX
 SG_ TSM1_UART_zero : 0|8@1+ (1,0) [0|0] "" Vector__XXX
 SG_ TSM0_VO_supplementarySignType : 0|8@1+ (1,0) [0|255] "ENUM" Vector__XXX
 SG_ TSM0_VO_signType : 0|8@1+ (1,0) [0|255] "ENUM" Vector__XXX
 SG_ TSM0_syncFrameIndex : 0|8@1+ (1,0) [0|255] "" Vector__XXX
 SG_ TSM0_UART_zero : 0|8@1+ (1,0) [0|0] "" Vector__XXX
 SG_ CS_PCW_Sensitivity_Valid : 0|1@1+ (1,0) [0|1] "bool" Vector__XXX
 SG_ CS_LDW_Sensitivity_Valid : 0|1@1+ (1,0) [0|1] "bool" Vector__XXX
 SG_ CS_FCW_Sensitivity_Valid : 0|1@1+ (1,0) [0|1] "bool" Vector__XXX
 SG_ CS_PCW_Sensitivity : 0|3@1+ (1,0) [0|7] "ENUM" Vector__XXX
 SG_ CS_CRC16 : 0|16@1+ (1,0) [0|65535] "" Vector__XXX
 SG_ CS_FCW_Sensitivity : 0|3@1+ (1,0) [0|7] "" Vector__XXX
 SG_ CS_LDW_Sensitivity : 0|3@1+ (1,0) [0|7] "" Vector__XXX
 SG_ CS_AccelerDecelerationRate : 0|8@1+ (0.1,-10) [-10|10] "m/s2" Vector__XXX
 SG_ CS_BrkPosInitTravelAchVald : 0|1@1+ (1,0) [0|1] "bool" Vector__XXX
 SG_ CS_BrakePosInitTravelAch : 0|1@1+ (1,0) [0|1] "bool" Vector__XXX
 SG_ CS_BrakePosModTravelAch : 0|1@1+ (1,0) [0|1] "bool" Vector__XXX
 SG_ CS_sensor_version : 0|6@1+ (1,0) [0|0] "NA" Vector__XXX
 SG_ CS_ReverseIndicatorValid : 0|1@1+ (1,0) [0|1] "bool" Vector__XXX
 SG_ CS_ReverseIndicator : 0|1@1+ (1,0) [0|1] "NA" Vector__XXX
 SG_ CS_AcceleratorPedalValue : 0|8@1+ (0.392,0) [0|100] "%" Vector__XXX
 SG_ CS_AcceleratorPedalValid : 0|1@1+ (1,0) [0|1] "bool" Vector__XXX
 SG_ FS_spotHalos : 0|7@1+ (1,0) [0|100] "ratio" Vector__XXX
 SG_ FS_spotHalos_bool : 0|1@1+ (1,0) [0|1] "bool" Vector__XXX
 SG_ Common_reserved2 : 0|4@1+ (1,0) [0|0] "" Vector__XXX
 SG_ FS_TSR_OOC_severe_Yaw : 0|1@1+ (1,0) [0|1] "bool" Vector__XXX
 SG_ FS_TSR_OOC_severe_Horizon : 0|1@1+ (1,0) [0|1] "bool" Vector__XXX
 SG_ FS_TSR_OOC_Horizon : 0|1@1+ (1,0) [0|1] "bool" Vector__XXX
 SG_ FS_TSR_OOC_Yaw : 0|1@1+ (1,0) [0|1] "bool" Vector__XXX
 SG_ Common_Global_Index : 0|32@1+ (1,0) [0|4294967295] "counter" Vector__XXX
 SG_ Common_Frame_TimeStamp : 0|32@1+ (1,0) [0|4294967295] "millisec" Vector__XXX
 SG_ Common_Frame_Index : 0|32@1+ (1,0) [0|4294967295] "counter" Vector__XXX
 SG_ OutOfCalibSignsNum_Horizon : 0|8@1+ (1,0) [0|255] "counter" Vector__XXX
 SG_ OutOfCalibOffset_Horizon : 0|8@1+ (1,-100) [-100|100] "pixels" Vector__XXX
 SG_ OutOfCalibSignsNum_Yaw : 0|8@1+ (1,0) [0|255] "counter" Vector__XXX
 SG_ OutOfCalibOffset_Yaw : 0|8@1+ (1,-100) [-100|155] "pixels" Vector__XXX
 SG_ Autofix_Yaw : 0|8@1+ (1,-40) [-40|40] "pixels" Vector__XXX
 SG_ Autofix_Horizon : 0|8@1+ (1,-40) [-40|40] "pixels" Vector__XXX
 SG_ Common_reserved1 : 0|2@1+ (1,0) [0|0] "" Vector__XXX
 SG_ currentCalibrationIsOK_yaw : 0|1@1+ (1,0) [0|1] "bool" Vector__XXX
 SG_ FS_Autofix_Out_Of_Calib_Yaw : 0|1@1+ (1,0) [0|1] "bool" Vector__XXX
 SG_ FS_Autofix_Out_Of_Calib_Horizon : 0|1@1+ (1,0) [0|1] "bool" Vector__XXX
 SG_ FS_Autofix_Out_Of_Calib : 0|1@1+ (1,0) [0|1] "bool" Vector__XXX
 SG_ Exposure_Type : 0|2@1+ (1,0) [0|1] "ENUM" Vector__XXX
 SG_ FS_OutOfFocusStatus : 0|2@1+ (1,0) [0|1] "ENUM" Vector__XXX
 SG_ DayTimeIndicator : 0|2@1+ (1,0) [0|2] "ENUM" Vector__XXX
 SG_ Autofix_Convergence_Status : 0|2@1+ (1,0) [0|3] "NA" Vector__XXX
 SG_ Driving_Side : 0|2@1+ (1,0) [0|2] "ENUM" Vector__XXX
 SG_ FS_Foggy_Spots_bool : 0|1@1+ (1,0) [0|1] "bool" Vector__XXX
 SG_ FS_Foggy_Spots : 0|7@1+ (1,0) [0|99] "ratio" Vector__XXX
 SG_ FS_Frozen_Windshield_bool : 0|1@1+ (1,0) [0|1] "bool" Vector__XXX
 SG_ FS_Frozen_Windshield : 0|7@1+ (1,0) [0|99] "ratio" Vector__XXX
 SG_ FS_Full_Blockage_bool : 0|1@1+ (1,0) [0|1] "bool" Vector__XXX
 SG_ FS_Full_Blockage : 0|7@1+ (1,0) [0|99] "ratio" Vector__XXX
 SG_ FS_Partial_Blockage_bool : 0|1@1+ (1,0) [0|1] "bool" Vector__XXX
 SG_ FS_Partial_Blockage : 0|7@1+ (1,0) [0|99] "ratio" Vector__XXX
 SG_ FS_Smeared_Spots_bool : 0|1@1+ (1,0) [0|1] "bool" Vector__XXX
 SG_ FS_Smeared_Spots : 0|7@1+ (1,0) [0|99] "ratio" Vector__XXX
 SG_ FS_Low_Sun_bool : 0|1@1+ (1,0) [0|1] "bool" Vector__XXX
 SG_ FS_Low_Sun : 0|7@1+ (1,0) [0|99] "ratio" Vector__XXX
 SG_ FS_Blurred_Image_bool : 0|1@1+ (1,0) [0|1] "bool" Vector__XXX
 SG_ FS_Blurred_Image : 0|7@1+ (1,0) [0|99] "ratio" Vector__XXX
 SG_ FS_Road_Spray_bool : 0|1@1+ (1,0) [0|1] "bool" Vector__XXX
 SG_ FS_Road_Spray : 0|7@1+ (1,0) [0|99] "ratio" Vector__XXX
 SG_ FS_Sun_Ray_bool : 0|1@1+ (1,0) [0|1] "bool" Vector__XXX
 SG_ FS_Sun_Ray : 0|7@1+ (1,0) [0|99] "ratio" Vector__XXX
 SG_ FS_Self_Glare_bool : 0|1@1+ (1,0) [0|1] "bool" Vector__XXX
 SG_ FS_Self_Glare : 0|7@1+ (1,0) [0|99] "ratio" Vector__XXX
 SG_ Common_Protocol_Version : 0|8@1+ (1,0) [0|255] "counter" Vector__XXX
 SG_ Common_Sync_Frame_Index : 0|8@1+ (1,0) [0|255] "counter" Vector__XXX
 SG_ Common_Zero_byte : 0|8@1+ (1,0) [0|0] "NA" Vector__XXX
 SG_ FCW_CRC : 0|16@1+ (1,0) [0|0] "" Vector__XXX
 SG_ FCW_SafetySuppress : 0|4@1+ (1,0) [0|15] "enum" Vector__XXX
 SG_ FCW_reserved3 : 0|2@1+ (1,0) [0|0] "" Vector__XXX
 SG_ SPI_VIS_OBS_TTC_WITH_ACC : 0|10@1+ (0.01,0) [0|7] "sec" Vector__XXX
 SG_ FCW_reserved1 : 0|2@1+ (1,0) [0|0] "" Vector__XXX
 SG_ FCW_VO_FCW_SUPPRESSIONS_SETB : 0|18@1+ (1,0) [0|262143] "BIT MAP" Vector__XXX
 SG_ FCW_VO_AEB_SUPPRESSIONS_SETC : 0|16@1+ (1,0) [0|255] "BIT MAP" Vector__XXX
 SG_ Day_Night_Decision : 0|2@1+ (1,0) [0|3] "ENUM" Vector__XXX
 SG_ FCW_reserved2 : 0|1@1+ (1,0) [0|0] "" Vector__XXX
 SG_ FCW_Headway_Time : 0|5@1+ (0.1,0) [0|2.6] "" Vector__XXX
 SG_ FCW_VO_FCW_SUPPRESSIONS_SETA : 0|18@1+ (1,0) [0|262143] "BIT MAP" Vector__XXX
 SG_ FCW_VO_FCW_SETB : 0|1@1+ (1,0) [0|1] "bool" Vector__XXX
 SG_ FCW_VO_AEB_SETC_pattern : 0|16@1+ (1,0) [39270|43605] "enum" Vector__XXX
 SG_ FCW_VO_FCW_SETA : 0|1@1+ (1,0) [0|1] "Bool" Vector__XXX
 SG_ FCW_syncFrameIndex : 0|8@1+ (1,0) [0|255] "" Vector__XXX
 SG_ FCW_Zero_byte : 0|8@1+ (1,0) [0|0] "" Vector__XXX
 SG_ HLB_reserved_1 : 0|9@1+ (1,0) [0|0] "NA" Vector__XXX
 SG_ LBD_Reason_Load_Balance : 0|1@1+ (1,0) [0|1] "bool" Vector__XXX
 SG_ LBD_Reason_Sharp_Curve : 0|1@1+ (1,0) [0|1] "bool" Vector__XXX
 SG_ LBD_Reason_Bright_Scene : 0|1@1+ (1,0) [0|1] "bool" Vector__XXX
 SG_ LBD_Reason_Low_speed : 0|1@1+ (1,0) [0|1] "bool" Vector__XXX
 SG_ LBD_Reason_Lit_Night : 0|1@1+ (1,0) [0|1] "bool" Vector__XXX
 SG_ LBD_Reason_Street_Light_Grace : 0|1@1+ (1,0) [0|1] "bool" Vector__XXX
 SG_ LBD_Reason_Street_Light : 0|1@1+ (1,0) [0|1] "bool" Vector__XXX
 SG_ LBD_Reason_Oncoming_Grace : 0|1@1+ (1,0) [0|1] "bool" Vector__XXX
 SG_ LBD_Reason_Oncoming : 0|1@1+ (1,0) [0|1] "bool" Vector__XXX
 SG_ LBD_Reason_Preceding_Grace : 0|1@1+ (1,0) [0|1] "bool" Vector__XXX
 SG_ LBD_Reason_preceding : 0|1@1+ (1,0) [0|1] "bool" Vector__XXX
 SG_ HLB_Running_Mode : 0|2@1+ (1,-1) [-1|2] "ENUM" Vector__XXX
 SG_ HLB_Decision : 0|2@1+ (1,0) [0|2] "bool" Vector__XXX
 SG_ HLB_Protocol_Version : 0|8@1+ (1,0) [0|255] "counter" Vector__XXX
 SG_ HLB_Sync_Frame_Index : 0|8@1+ (1,0) [0|255] "counter" Vector__XXX
 SG_ HLB_Zero_byte : 0|8@1+ (1,0) [0|0] "NA" Vector__XXX
 SG_ HWE : 0|2@1+ (1,0) [0|3] "NA" Vector__XXX
 SG_ LDW : 0|2@1+ (1,0) [0|3] "NA" Vector__XXX
 SG_ Prediction : 0|3@1+ (1,0) [0|4] "NA" Vector__XXX
 SG_ LDW_Inhibit_Reasons_generic : 0|1@1+ (1,0) [0|1] "ENUM" Vector__XXX
 SG_ LDW_Inhibit_Reasons_accel : 0|1@1+ (1,0) [0|1] "ENUM" Vector__XXX
 SG_ LDW_Inhibit_Reasons_brake : 0|1@1+ (1,0) [0|1] "ENUM" Vector__XXX
 SG_ LDW_Inhibit_Reasons_left : 0|1@1+ (1,0) [0|1] "ENUM" Vector__XXX
 SG_ LDW_Inhibit_Reasons_right : 0|1@1+ (1,0) [0|1] "ENUM" Vector__XXX
 SG_ LDW_Inhibit_Reasons_steering : 0|1@1+ (1,0) [0|1] "ENUM" Vector__XXX
 SG_ LaneSigHead_Reserved1 : 0|5@1+ (1,0) [0|0] "NA" Vector__XXX
 SG_ LDW_NRTA_Reasons_narrow : 0|1@1+ (1,0) [0|1] "ENUM" Vector__XXX
 SG_ LDW_NRTA_Reasons_single : 0|1@1+ (1,0) [0|1] "ENUM" Vector__XXX
 SG_ LDW_NRTA_Reasons_right : 0|1@1+ (1,0) [0|1] "ENUM" Vector__XXX
 SG_ LDW_NRTA_Reasons_left : 0|1@1+ (1,0) [0|1] "ENUM" Vector__XXX
 SG_ LDW_NRTA_Reasons_speed : 0|1@1+ (1,0) [0|1] "ENUM" Vector__XXX
 SG_ LDW_RTA : 0|1@1+ (1,0) [0|1] "ENUM" Vector__XXX
 SG_ Number_Of_Lanes : 0|3@1+ (1,0) [0|4] "counter" Vector__XXX
 SG_ Construction_Area : 0|2@1+ (1,0) [0|3] "ENUM" Vector__XXX
 SG_ Road_Type : 0|2@1+ (1,0) [0|2] "ENUM" Vector__XXX
 SG_ Lane_Model_Valid : 0|1@1+ (1,0) [0|1] "ENUM" Vector__XXX
 SG_ Lanes_Protocol_Version : 0|8@1+ (1,0) [0|255] "counter" Vector__XXX
 SG_ Lane_HD_Sync_Frame_Index : 0|8@1+ (1,0) [0|255] "counter" Vector__XXX
 SG_ Probability_Of_Right_Lane : 0|7@1+ (0.01,0) [0|1] "probability" Vector__XXX
 SG_ Probability_Of_Left_Lane : 0|7@1+ (0.01,0) [0|1] "probability" Vector__XXX
 SG_ PD_SafetySuppress : 0|4@1+ (1,0) [0|15] "" Vector__XXX
 SG_ FCW_Reserved2 : 0|1@1+ (1,0) [0|0] "" Vector__XXX
 SG_ PD_alert_L1_pattern : 0|16@1+ (1,0) [39270|43605] "enum" Vector__XXX
 SG_ PD_alert_L2 : 0|1@1+ (1,0) [0|1] "enum" Vector__XXX
 SG_ PD_alert_L3 : 0|1@1+ (1,0) [0|1] "enum" Vector__XXX
 SG_ PD_alert_AEB_supp_Reasons_L1 : 0|16@1+ (1,0) [0|15] "bitmap" Vector__XXX
 SG_ PD_alert_AEB_supp_Reasons_L2 : 0|4@1+ (1,0) [0|15] "bitmap" Vector__XXX
 SG_ PD_alert_AEB_supp_Reasons_L3 : 0|4@1+ (1,0) [0|15] "bitmap" Vector__XXX
 SG_ PD_alert_pedsExist : 0|1@1+ (1,0) [0|1] "ENUM" Vector__XXX
 SG_ PCW_syncFrameIndex : 0|8@1+ (1,0) [0|255] "Frame" Vector__XXX
 SG_ PCW_Zero_byte : 0|8@1+ (1,0) [0|0] "" Vector__XXX
 SG_ PD_CRC : 0|16@1+ (1,0) [0|65535] "" Vector__XXX
 SG_ PCW_Reserved1 : 0|6@1+ (1,0) [0|0] "" Vector__XXX
 SG_ SPI_VIS_OBS_TTC_WITHOUT_ACC : 0|10@1+ (0.01,0) [0|7] "sec" Vector__XXX
 SG_ TSM_numSigns : 0|4@1+ (1,0) [0|4] "" Vector__XXX
 SG_ TSR_numSigns : 0|4@1+ (1,0) [0|12] "" Vector__XXX
 SG_ TSR_TSM_reserved : 0|6@1+ (1,0) [0|0] "" Vector__XXX
 SG_ TSR_TSM_DND_decision : 0|2@1+ (1,0) [0|3] "ENUM" Vector__XXX
 SG_ TSR_TSM_region_code : 0|8@1+ (1,0) [0|10] "ENUM" Vector__XXX
 SG_ TSR_TSM_syncFrameIndex : 0|8@1+ (1,0) [0|255] "" Vector__XXX
 SG_ TSR_TSM_UART_magic : 0|8@1+ (1,0) [0|0] "" Vector__XXX
 SG_ App_Reserved3 : 0|8@1+ (1,0) [0|0] "" Vector__XXX
 SG_ App_data2 : 0|8@1+ (1,0) [0|0] "" Vector__XXX
 SG_ App_data1 : 0|8@1+ (1,0) [0|0] "" Vector__XXX
 SG_ App_Fatal_Error : 0|8@1+ (1,0) [0|0] "" Vector__XXX
 SG_ Application_Diagnostics_part_2 : 0|16@1+ (1,0) [0|0] "" Vector__XXX
 SG_ Application_Diagnostics_part_1 : 0|16@1+ (1,0) [0|0] "" Vector__XXX
 SG_ App_EyeQ_Process_Index : 0|32@1+ (1,0) [0|0] "" Vector__XXX
 SG_ App_Sub_State : 0|8@1+ (1,0) [0|0] "" Vector__XXX
 SG_ App_Main_State : 0|8@1+ (1,0) [0|0] "" Vector__XXX
 SG_ App_Reserved2 : 0|8@1+ (1,0) [0|0] "" Vector__XXX
 SG_ App_Reserved1 : 0|8@1+ (1,0) [0|0] "" Vector__XXX
 SG_ CS_reserved1 : 0|1@1+ (1,0) [0|0] "NA" Vector__XXX
 SG_ CS_VehicleSpeedValid : 0|1@1+ (1,0) [0|1] "bool" Vector__XXX
 SG_ CS_VehicleYawValid : 0|1@1+ (1,0) [0|1] "bool" Vector__XXX
 SG_ CS_Wiper : 0|1@1+ (1,0) [0|1] "bool" Vector__XXX
 SG_ CS_TurnSwitchStatus : 0|2@1+ (1,0) [0|3] "n/a" Vector__XXX
 SG_ CS_SteeringWheelAngVal : 0|1@1+ (1,0) [0|1] "bool" Vector__XXX
 SG_ CS_ClutchStartSwitchAct : 0|1@1+ (1,0) [0|1] "bool" Vector__XXX
 SG_ CS_TopTrvlClutchSwitchAct : 0|1@1+ (1,0) [0|1] "bool" Vector__XXX
 SG_ CS_HighBeamStatus : 0|1@1+ (1,0) [0|1] "bool" Vector__XXX
 SG_ CS_FogLightActivation : 0|1@1+ (1,0) [0|1] "bool" Vector__XXX
 SG_ CS_AmbientLightLevel : 0|2@1+ (1,0) [0|2] "n/a" Vector__XXX
 SG_ CS_AmbientLightLevelValid : 0|1@1+ (1,0) [0|1] "bool" Vector__XXX

BO_ 513 Location: 5 Vector__XXX
 SG_ location_Y : 22|17@0- (0.1,0) [-6553.6|6553.5] "m" Vector__XXX
 SG_ location_X : 7|17@0- (0.1,0) [-6553.6|6553.5] "m" Vector__XXX

CM_ BO_ 3221225472 "This is a message for not used signals, created by Vector CANdb++ DBC OLE DB Provider.";
CM_ SG_ 3221225472 FCW_VO_FCW_SUPPRESSIONS_SETB "0-VEHICLE_ACCELERATION
1-VEHICLE_ACCELERATION_GRACE
2-VEHICLE_BRAKE
3-VEHICLE_BRAKE_GRACE
9-VEH_VEH_OPENING_SCENARIO
12-FCALIA_TIME_GRACE
15-NRTA_STATE
16-NRTA_STATE_SPEED_UNDER_THRESH
17-NRTA_STATE_SPEED_ABOVE_THRESH0-VEHICLE_ACCELERATION
1-VEHICLE_ACCELERATION_GRACE
2-VEHICLE_BRAKE
3-VEHICLE_BRAKE_GRACE
9-VEH_VEH_OPENING_SCENARIO
12-FCALIA_TIME_GRACE
15-NRTA_STATE
16-NRTA_STATE_SPEED_UNDER_THRESH
17-NRTA_STATE_SPEED_ABOVE_THRESH";
CM_ SG_ 3221225472 FCW_VO_AEB_SUPPRESSIONS_SETC "0-SUPP_FCW_VALIDATION
1-SUPP_MIN_TIME_FOR_AEB_AFTER_AEB
2-SUPP_MAX_YAW_RATE
3-SUPP_MAX_STEERING_ANGLE
4-SUPP_MAX_DISTANCE
5-SUPP_MAX_WARN_LEGNTH
6-SUPP_MAX_SPEED
7-SUPP_MIN_SPEED
8-SUPP_SDM_ON0-SUPP_FCW_VALIDATION
1-SUPP_MIN_TIME_FOR_AEB_AFTER_AEB
2-SUPP_MAX_YAW_RATE
3-SUPP_MAX_STEERING_ANGLE
4-SUPP_MAX_DISTANCE
5-SUPP_MAX_WARN_LEGNTH
6-SUPP_MAX_SPEED
7-SUPP_MIN_SPEED
8-SUPP_SDM_ON";
CM_ SG_ 3221225472 tac2_top "SD1: key=tac2_top sec=[TAC2_CONF] file=etc/TAC2.conf sep=: type=intSD1: key=tac2_top sec=[TAC2_CONF] file=etc/TAC2.conf sep=: type=intSD1: key=tac2_top sec=[TAC2_CONF] file=etc/TAC2.conf sep=: type=intSD1: key=tac2_top sec=[TAC2_CONF] file=etc/TAC2.conf sep=: type=int";
CM_ SG_ 3221225472 tac2_bottom "SD1: key=tac2_bottom sec=[TAC2_CONF] file=etc/TAC2.conf sep=: type=intSD1: key=tac2_bottom sec=[TAC2_CONF] file=etc/TAC2.conf sep=: type=intSD1: key=tac2_bottom sec=[TAC2_CONF] file=etc/TAC2.conf sep=: type=intSD1: key=tac2_bottom sec=[TAC2_CONF] file=etc/TAC2.conf sep=: type=int";
CM_ SG_ 3221225472 tac2_squareSideSize "SD1: key=tac2_squareSideSize sec=[TAC2_CONF] file=etc/TAC2.conf sep=: type=floatSD1: key=tac2_squareSideSize sec=[TAC2_CONF] file=etc/TAC2.conf sep=: type=floatSD1: key=tac2_squareSideSize sec=[TAC2_CONF] file=etc/TAC2.conf sep=: type=floatSD1: key=tac2_squareSideSize sec=[TAC2_CONF] file=etc/TAC2.conf sep=: type=float";
CM_ SG_ 3221225472 tac2_max_rollAngle "SD1: key=tac2_max_roll_angle sec=[TAC2_CONF] file=etc/TAC2.conf sep=: type=floatSD1: key=tac2_max_roll_angle sec=[TAC2_CONF] file=etc/TAC2.conf sep=: type=floatSD1: key=tac2_max_roll_angle sec=[TAC2_CONF] file=etc/TAC2.conf sep=: type=floatSD1: key=tac2_max_roll_angle sec=[TAC2_CONF] file=etc/TAC2.conf sep=: type=float";
CM_ SG_ 3221225472 tac2_min_yaw "SD1: key=tac2_min_yaw sec=[TAC2_CONF] file=etc/TAC2.conf sep=: type=intSD1: key=tac2_min_yaw sec=[TAC2_CONF] file=etc/TAC2.conf sep=: type=intSD1: key=tac2_min_yaw sec=[TAC2_CONF] file=etc/TAC2.conf sep=: type=intSD1: key=tac2_min_yaw sec=[TAC2_CONF] file=etc/TAC2.conf sep=: type=int";
CM_ SG_ 3221225472 tac2_max_yaw "SD1: key=tac2_max_yaw sec=[TAC2_CONF] file=etc/TAC2.conf sep=: type=intSD1: key=tac2_max_yaw sec=[TAC2_CONF] file=etc/TAC2.conf sep=: type=intSD1: key=tac2_max_yaw sec=[TAC2_CONF] file=etc/TAC2.conf sep=: type=intSD1: key=tac2_max_yaw sec=[TAC2_CONF] file=etc/TAC2.conf sep=: type=int";
CM_ SG_ 3221225472 tac2_min_horizon "SD1: key=tac2_min_horizon sec=[TAC2_CONF] file=etc/TAC2.conf sep=: type=intSD1: key=tac2_min_horizon sec=[TAC2_CONF] file=etc/TAC2.conf sep=: type=intSD1: key=tac2_min_horizon sec=[TAC2_CONF] file=etc/TAC2.conf sep=: type=intSD1: key=tac2_min_horizon sec=[TAC2_CONF] file=etc/TAC2.conf sep=: type=int";
CM_ SG_ 3221225472 tac2_max_horizon "SD1: key=tac2_max_horizon sec=[TAC2_CONF] file=etc/TAC2.conf sep=: type=intSD1: key=tac2_max_horizon sec=[TAC2_CONF] file=etc/TAC2.conf sep=: type=intSD1: key=tac2_max_horizon sec=[TAC2_CONF] file=etc/TAC2.conf sep=: type=intSD1: key=tac2_max_horizon sec=[TAC2_CONF] file=etc/TAC2.conf sep=: type=int";
CM_ SG_ 3221225472 cameraInfo_tac2_Z "SD1: key=cameraInfo_tac2_Z sec=[TAC2_CONF] file=etc/TAC2.conf sep=: type=floatSD1: key=cameraInfo_tac2_Z sec=[TAC2_CONF] file=etc/TAC2.conf sep=: type=floatSD1: key=cameraInfo_tac2_Z sec=[TAC2_CONF] file=etc/TAC2.conf sep=: type=floatSD1: key=cameraInfo_tac2_Z sec=[TAC2_CONF] file=etc/TAC2.conf sep=: type=float";
CM_ SG_ 3221225472 cameraInfo_tac2_height "SD1: key=cameraInfo_tac2_height sec=[TAC2_CONF] file=etc/TAC2.conf sep=: type=floatSD1: key=cameraInfo_tac2_height sec=[TAC2_CONF] file=etc/TAC2.conf sep=: type=floatSD1: key=cameraInfo_tac2_height sec=[TAC2_CONF] file=etc/TAC2.conf sep=: type=floatSD1: key=cameraInfo_tac2_height sec=[TAC2_CONF] file=etc/TAC2.conf sep=: type=float";
CM_ SG_ 3221225472 cameraInfo_tac2_focal_length "SD1: key=cameraInfo_tac2_focal_length sec=[TAC2_CONF] file=etc/TAC2.conf sep=: type=intSD1: key=cameraInfo_tac2_focal_length sec=[TAC2_CONF] file=etc/TAC2.conf sep=: type=intSD1: key=cameraInfo_tac2_focal_length sec=[TAC2_CONF] file=etc/TAC2.conf sep=: type=intSD1: key=cameraInfo_tac2_focal_length sec=[TAC2_CONF] file=etc/TAC2.conf sep=: type=int";
CM_ SG_ 3221225472 tac2_right_wheel "SD1: key=tac2_right_wheel sec=[TAC2_CONF] file=etc/TAC2.conf sep=: type=floatSD1: key=tac2_right_wheel sec=[TAC2_CONF] file=etc/TAC2.conf sep=: type=floatSD1: key=tac2_right_wheel sec=[TAC2_CONF] file=etc/TAC2.conf sep=: type=floatSD1: key=tac2_right_wheel sec=[TAC2_CONF] file=etc/TAC2.conf sep=: type=float";
CM_ SG_ 3221225472 tac2_left_wheel "SD1: key=tac2_left_wheel sec=[TAC2_CONF] file=etc/TAC2.conf sep=: type=floatSD1: key=tac2_left_wheel sec=[TAC2_CONF] file=etc/TAC2.conf sep=: type=floatSD1: key=tac2_left_wheel sec=[TAC2_CONF] file=etc/TAC2.conf sep=: type=floatSD1: key=tac2_left_wheel sec=[TAC2_CONF] file=etc/TAC2.conf sep=: type=float";
CM_ SG_ 3221225472 targetInfo_tac2_height_1 "SD1: key=targetInfo_tac2_height sec=[TAC2_CONF] file=etc/TAC2.conf sep=: type=float seq=3 ind=1 last=true";
CM_ SG_ 3221225472 InitV_horizonFull "SD1: key=horizonFull sec=[main] file=etc/camera.conf sep== type=int";
CM_ SG_ 3221225472 InitV_yawFull "SD1: key=yawFull sec=[main] file=etc/camera.conf sep== type=int";
CM_ SG_ 3221225472 InitV_autofix_horizon "SD1: key=autofix_horizon sec=[main] file=etc/camera.conf sep== type=int";
CM_ SG_ 3221225472 InitV_autofix_yaw "SD1: key=autofix_yaw sec=[main] file=etc/camera.conf sep== type=int";
CM_ SG_ 3221225472 InitV_bottom "SD1: key=bottom sec=[main] file=etc/camera.conf sep== type=int";
CM_ SG_ 3221225472 InitV_top "SD1: key=top sec=[main] file=etc/camera.conf sep== type=int";
CM_ SG_ 3221225472 InitV_rollAngle "SD1: key=rollAngle sec=[main] file=etc/camera.conf sep== type=float";
CM_ SG_ 3221225472 InitV_minYaw "SD1: key=minYaw sec=[main] file=etc/camera.conf sep== type=int";
CM_ SG_ 3221225472 InitV_regionCode "SD1: key=regionCode sec= file=etc/default.calib sep=: type=int";
CM_ SG_ 3221225472 InitV_drivingSide "SD1: key=drivingSide sec= file=etc/default.calib sep=: type=int";
CM_ SG_ 3221225472 InitV_maxHorizon "SD1: key=maxHorizon sec=[main] file=etc/camera.conf sep== type=int";
CM_ SG_ 3221225472 InitV_minHorizon "SD1: key=minHorizon sec=[main] file=etc/camera.conf sep== type=int";
CM_ SG_ 3221225472 InitV_maxYaw "SD1: key=maxYaw sec=[main] file=etc/camera.conf sep== type=int";
CM_ SG_ 3221225472 InitV_rightWheel "SD1: key=rightWheel sec=[main] file=etc/camera.conf sep== type=float";
CM_ SG_ 3221225472 InitV_cameraHeight "SD1: key=cameraHeight sec=[main] file=etc/camera.conf sep== type=float";
CM_ SG_ 3221225472 InitParamSPC_minYaw "SD1: key=minYaw sec=[main] file=etc/camera.conf sep== type=int";
CM_ SG_ 3221225472 InitParamSPC_top "SD1: key=top sec=[main] file=etc/camera.conf sep== type=int";
CM_ SG_ 3221225472 InitParamSPC_maxYaw "SD1: key=maxYaw sec=[main] file=etc/camera.conf sep== type=int";
CM_ SG_ 3221225472 InitParamSPC_bottom "SD1: key=bottom sec=[main] file=etc/camera.conf sep== type=int";
CM_ SG_ 3221225472 InitParamSPC_minHorizon "SD1: key=minHorizon sec=[main] file=etc/camera.conf sep== type=int";
CM_ SG_ 3221225472 InitParamSPC_maxHorizon "SD1: key=maxHorizon sec=[main] file=etc/camera.conf sep== type=int";
CM_ SG_ 3221225472 InitParamSPC_rollAngle "SD1: key=rollAngle sec=[main] file=etc/camera.conf sep== type=float";
CM_ SG_ 3221225472 InitParamSPC_cameraHeight "SD1: key=cameraHeight sec=[main] file=etc/camera.conf sep== type=float";
CM_ SG_ 3221225472 InitParamSPC_drivingSide "SD1: key=drivingSide sec= file=etc/default.calib sep=: type=int";
CM_ SG_ 3221225472 InitParamSPC_regionCode "SD1: key=regionCode sec= file=etc/default.calib sep=: type=int";
CM_ SG_ 3221225472 InitParamSPC_autofix_yaw "SD1: key=autofix_yaw sec=[main] file=etc/camera.conf sep== type=int";
CM_ SG_ 3221225472 InitParamSPC_autofix_horizon "SD1: key=autofix_horizon sec=[main] file=etc/camera.conf sep== type=int";
CM_ SG_ 3221225472 InitParamSPC_yawFull "SD1: key=yawFull sec=[main] file=etc/camera.conf sep== type=int";
CM_ SG_ 3221225472 InitParamSPC_horizonFull "SD1: key=horizonFull sec=[main] file=etc/camera.conf sep== type=int";
CM_ SG_ 3221225472 Event_Request3 "Requested Event3 - use 1 to activate";
CM_ SG_ 3221225472 Event_Request2 "Requested Event2 - use 1 to activate";
CM_ SG_ 3221225472 Event_Request1 "Requested Event1 - use 1 to activate";
CM_ SG_ 3221225472 clearTSMSecondaryCond "Cleary Secondary Conditional TSM";
CM_ SG_ 3221225472 clearTSMSecondary "Clear Secondary TSM";
CM_ SG_ 3221225472 clearTSMPrimaryCond "Cleary Primary Conditional TSM";
CM_ SG_ 3221225472 clearTSMPrimary "Clear Primary TSM";
CM_ SG_ 3221225472 clearTSMall "Clear all TSM Displays";
CM_ SG_ 3221225472 ldwSensitivity "Tailorable settings to modify feel of LDW";
CM_ SG_ 3221225472 ldwSensitivityValid "If the LDW Sensitivity value is valid";
CM_ SG_ 3221225472 gpsCountryCode_SecondChar "Country Code List to the right";
CM_ SG_ 3221225472 hbaReducedSensitivity "Sets High Beam Assist reduced sensitivity";
CM_ SG_ 3221225472 hbaReducedSensitivityValid "If the HBA reduced sensitivity is valid";
CM_ SG_ 3221225472 gpsCountryCode_FirstChar "Country Code List to the right";
CM_ SG_ 3221225472 DriverSensitivity "bool. when enabled, assumption is that driver is less sensitive";
CM_ SG_ 3221225472 DriverSensitivityValid "bool";
CM_ SG_ 3221225472 pcwGapSensitivity "3 level setting used to tailor the non braking component of forward collision for pedestrians.";
CM_ SG_ 3221225472 pcwGapSensitivityValid "If the PCW gap sensitivity is valid";
CM_ SG_ 3221225472 fcaGapSensitivity "3 level setting used to tailor the non braking component of forward collision for vehicles. ";
CM_ SG_ 3221225472 fcaGapSensitivityValid "If the FCA Gap sensitivity is valid";
CM_ SG_ 3221225472 ss_Sync_Frame_Index "synchronizes between the messages in the same frame";
CM_ SG_ 3221225472 ss_Sensor_Version "Update value and range according to sensor version";
CM_ SG_ 3221225472 RGM_DES_R "RGM.DES.R";
CM_ SG_ 3221225472 RGM_FES_R "RGM.FES.R";
CM_ SG_ 3221225472 AEB_Safety_syncFrameIndex "synchronizes between the messages in the same frame";
CM_ SG_ 3221225472 Safety_Diagnostic_Manager7 "This is a safety diagnostic manager";
CM_ SG_ 3221225472 Safety_Diagnostic_Manager6 "This is a safety diagnostic manager";
CM_ SG_ 3221225472 Safety_Diagnostic_Manager5 "This is a safety diagnostic manager";
CM_ SG_ 3221225472 Safety_Diagnostic_Manager4 "This is a safety diagnostic manager";
CM_ SG_ 3221225472 Safety_Diagnostic_Manager3 "This is a safety diagnostic manager";
CM_ SG_ 3221225472 Safety_Diagnostic_Manager2 "This is a safety diagnostic manager";
CM_ SG_ 3221225472 Safety_Diagnostic_Manager1 "This is a safety diagnostic manager";
CM_ SG_ 3221225472 Safety_Diagnostic_Manager0 "This is a safety diagnostic manager";
CM_ SG_ 3221225472 Safety_Diagnostic_Manager15 "This is a safety diagnostic manager";
CM_ SG_ 3221225472 Safety_Diagnostic_Manager14 "This is a safety diagnostic manager";
CM_ SG_ 3221225472 Safety_Diagnostic_Manager13 "This is a safety diagnostic manager";
CM_ SG_ 3221225472 Safety_Diagnostic_Manager12 "This is a safety diagnostic manager";
CM_ SG_ 3221225472 Safety_Diagnostic_Manager11 "This is a safety diagnostic manager";
CM_ SG_ 3221225472 Safety_Diagnostic_Manager10 "This is a safety diagnostic manager";
CM_ SG_ 3221225472 Safety_Diagnostic_Manager9 "This is a safety diagnostic manager";
CM_ SG_ 3221225472 Safety_Diagnostic_Manager8 "This is a safety diagnostic manager";
CM_ SG_ 3221225472 Safety_Diagnostic_Manager23 "This is a safety diagnostic manager";
CM_ SG_ 3221225472 Safety_Diagnostic_Manager22 "This is a safety diagnostic manager";
CM_ SG_ 3221225472 Safety_Diagnostic_Manager21 "This is a safety diagnostic manager";
CM_ SG_ 3221225472 Safety_Diagnostic_Manager20 "This is a safety diagnostic manager";
CM_ SG_ 3221225472 Safety_Diagnostic_Manager19 "This is a safety diagnostic manager";
CM_ SG_ 3221225472 Safety_Diagnostic_Manager18 "This is a safety diagnostic manager";
CM_ SG_ 3221225472 Safety_Diagnostic_Manager17 "This is a safety diagnostic manager";
CM_ SG_ 3221225472 Safety_Diagnostic_Manager16 "This is a safety diagnostic manager";
CM_ SG_ 3221225472 Safety_Diagnostic_Manager31 "This is a safety diagnostic manager";
CM_ SG_ 3221225472 Safety_Diagnostic_Manager30 "This is a safety diagnostic manager";
CM_ SG_ 3221225472 Safety_Diagnostic_Manager29 "This is a safety diagnostic manager";
CM_ SG_ 3221225472 Safety_Diagnostic_Manager28 "This is a safety diagnostic manager";
CM_ SG_ 3221225472 Safety_Diagnostic_Manager27 "This is a safety diagnostic manager";
CM_ SG_ 3221225472 Safety_Diagnostic_Manager26 "This is a safety diagnostic manager";
CM_ SG_ 3221225472 Safety_Diagnostic_Manager25 "This is a safety diagnostic manager";
CM_ SG_ 3221225472 Safety_Diagnostic_Manager24 "This is a safety diagnostic manager";
CM_ SG_ 3221225472 AEB_Safety_CRC "16bit CRC for ASIL";
CM_ SG_ 3221225472 SPTAC_Output_Horizon "Vertical offset from image center, measured in reduced coordinates (320x240 image).";
CM_ SG_ 3221225472 SPTAC_Output_Yaw "Horizontal offset from image center, measured in reduced coordinates (320x240 image).";
CM_ SG_ 3221225472 Objects_Top_Obj9 "coordinate position in image (relative to FOE coordinate in image) Assumed image size (and coordinate resolution) -  240X320 pixels (level 0)";
CM_ SG_ 3221225472 Objects_Bottom_Obj9 "coordinate position in image (relative to FOE coordinate in image) Assumed image size (and coordinate resolution) -  240X320 pixels (level 0)";
CM_ SG_ 3221225472 Objects_Lateral_Distance_Obj9 "positive to the right! In protocol called TRW_Objects aligned to refPoint_Y. The code subtracts the refPoint_Y from the lateral distance. If the camera islocated to the left of the refPoint_Y the value is poisitive.   ";
CM_ SG_ 3221225472 Objects_Extended_ID_Obj9 "Raw ME ID for objects";
CM_ SG_ 3221225472 Objects_Angle_Rate_Mean_Obj9 "proportional to speed of object mid-point in pixel coordinates in left-right direction, positive for motion to the right!";
CM_ SG_ 3221225472 Objects_Cut_In_Cut_Out_Obj9 "Inferences can be drawn from the Cut_In_Cut_Out enum regarding Lane_Assignment and Lane_Movement_Type eg 0x1 ?Host Cut In Left -Lane_Assignment = Next Lane right   -Lane_Movement_Type = Moving Left  For full details see Mobileye comment in UART excel doc";
CM_ SG_ 3221225472 Objects_Top_Obj8 "coordinate position in image (relative to FOE coordinate in image) Assumed image size (and coordinate resolution) -  240X320 pixels (level 0)";
CM_ SG_ 3221225472 Objects_Bottom_Obj8 "coordinate position in image (relative to FOE coordinate in image) Assumed image size (and coordinate resolution) -  240X320 pixels (level 0)";
CM_ SG_ 3221225472 Objects_Lateral_Distance_Obj8 "positive to the right! In protocol called TRW_Objects aligned to refPoint_Y. The code subtracts the refPoint_Y from the lateral distance. If the camera islocated to the left of the refPoint_Y the value is poisitive.   ";
CM_ SG_ 3221225472 Objects_Extended_ID_Obj8 "Raw ME ID for objects";
CM_ SG_ 3221225472 Objects_Angle_Rate_Mean_Obj8 "proportional to speed of object mid-point in pixel coordinates in left-right direction, positive for motion to the right!";
CM_ SG_ 3221225472 Objects_Cut_In_Cut_Out_Obj8 "Inferences can be drawn from the Cut_In_Cut_Out enum regarding Lane_Assignment and Lane_Movement_Type eg 0x1 ?Host Cut In Left -Lane_Assignment = Next Lane right   -Lane_Movement_Type = Moving Left  For full details see Mobileye comment in UART excel doc";
CM_ SG_ 3221225472 Objects_Top_Obj7 "coordinate position in image (relative to FOE coordinate in image) Assumed image size (and coordinate resolution) -  240X320 pixels (level 0)";
CM_ SG_ 3221225472 Objects_Bottom_Obj7 "coordinate position in image (relative to FOE coordinate in image) Assumed image size (and coordinate resolution) -  240X320 pixels (level 0)";
CM_ SG_ 3221225472 Objects_Lateral_Distance_Obj7 "positive to the right! In protocol called TRW_Objects aligned to refPoint_Y. The code subtracts the refPoint_Y from the lateral distance. If the camera islocated to the left of the refPoint_Y the value is poisitive.   ";
CM_ SG_ 3221225472 Objects_Extended_ID_Obj7 "Raw ME ID for objects";
CM_ SG_ 3221225472 Objects_Angle_Rate_Mean_Obj7 "proportional to speed of object mid-point in pixel coordinates in left-right direction, positive for motion to the right!";
CM_ SG_ 3221225472 Objects_Cut_In_Cut_Out_Obj7 "Inferences can be drawn from the Cut_In_Cut_Out enum regarding Lane_Assignment and Lane_Movement_Type eg 0x1 ?Host Cut In Left -Lane_Assignment = Next Lane right   -Lane_Movement_Type = Moving Left  For full details see Mobileye comment in UART excel doc";
CM_ SG_ 3221225472 Objects_Top_Obj6 "coordinate position in image (relative to FOE coordinate in image) Assumed image size (and coordinate resolution) -  240X320 pixels (level 0)";
CM_ SG_ 3221225472 Objects_Bottom_Obj6 "coordinate position in image (relative to FOE coordinate in image) Assumed image size (and coordinate resolution) -  240X320 pixels (level 0)";
CM_ SG_ 3221225472 Objects_Lateral_Distance_Obj6 "positive to the right! In protocol called TRW_Objects aligned to refPoint_Y. The code subtracts the refPoint_Y from the lateral distance. If the camera islocated to the left of the refPoint_Y the value is poisitive.   ";
CM_ SG_ 3221225472 Objects_Extended_ID_Obj6 "Raw ME ID for objects";
CM_ SG_ 3221225472 Objects_Angle_Rate_Mean_Obj6 "proportional to speed of object mid-point in pixel coordinates in left-right direction, positive for motion to the right!";
CM_ SG_ 3221225472 Objects_Cut_In_Cut_Out_Obj6 "Inferences can be drawn from the Cut_In_Cut_Out enum regarding Lane_Assignment and Lane_Movement_Type eg 0x1 ?Host Cut In Left -Lane_Assignment = Next Lane right   -Lane_Movement_Type = Moving Left  For full details see Mobileye comment in UART excel doc";
CM_ SG_ 3221225472 Objects_Top_Obj5 "coordinate position in image (relative to FOE coordinate in image) Assumed image size (and coordinate resolution) -  240X320 pixels (level 0)";
CM_ SG_ 3221225472 Objects_Bottom_Obj5 "coordinate position in image (relative to FOE coordinate in image) Assumed image size (and coordinate resolution) -  240X320 pixels (level 0)";
CM_ SG_ 3221225472 Objects_Lateral_Distance_Obj5 "positive to the right! In protocol called TRW_Objects aligned to refPoint_Y. The code subtracts the refPoint_Y from the lateral distance. If the camera islocated to the left of the refPoint_Y the value is poisitive.   ";
CM_ SG_ 3221225472 Objects_Extended_ID_Obj5 "Raw ME ID for objects";
CM_ SG_ 3221225472 Objects_Angle_Rate_Mean_Obj5 "proportional to speed of object mid-point in pixel coordinates in left-right direction, positive for motion to the right!";
CM_ SG_ 3221225472 Objects_Cut_In_Cut_Out_Obj5 "Inferences can be drawn from the Cut_In_Cut_Out enum regarding Lane_Assignment and Lane_Movement_Type eg 0x1 ?Host Cut In Left -Lane_Assignment = Next Lane right   -Lane_Movement_Type = Moving Left  For full details see Mobileye comment in UART excel doc";
CM_ SG_ 3221225472 Objects_Phi_Line_Right_Obj9 "angle between left object edge and right host lane in radians (if over 15 degrees, the signal is transmitted at the max value of 15 degrees (0.261799387799149 radians) and the Valid flag will be showing invalid";
CM_ SG_ 3221225472 Objects_PhiLineRightValid_Obj9 "Either we do not have an angle or the angle is above 15 degrees (or below -15 degrees)";
CM_ SG_ 3221225472 Objects_Object_Age_Obj9 "A counter that indicates how many frames the object has been active for. When an object is first detected, this signal shall be initialised to 0 and incremented each succesive frame.";
CM_ SG_ 3221225472 Objects_Phi_Line_Left_Obj9 "angle between right object edge and left host lane in radians (if over 15 degrees, the signal is transmitted at the max value of 15 degrees (0.261799387799149 radians) and the Valid flag will be showing invalid";
CM_ SG_ 3221225472 Objects_Phi_Line_Left_Valid_Obj9 "Either we do not have an angle or the angle is above 15 degrees (or below -15 degrees)";
CM_ SG_ 3221225472 Objects_Lateral_Velocity_Obj9 "positive to the right! ";
CM_ SG_ 3221225472 Objects_Phi_Line_Right_Obj8 "angle between left object edge and right host lane in radians (if over 15 degrees, the signal is transmitted at the max value of 15 degrees (0.261799387799149 radians) and the Valid flag will be showing invalid";
CM_ SG_ 3221225472 Objects_PhiLineRightValid_Obj8 "Either we do not have an angle or the angle is above 15 degrees (or below -15 degrees)";
CM_ SG_ 3221225472 Objects_Object_Age_Obj8 "A counter that indicates how many frames the object has been active for. When an object is first detected, this signal shall be initialised to 0 and incremented each succesive frame.";
CM_ SG_ 3221225472 Objects_Phi_Line_Left_Obj8 "angle between right object edge and left host lane in radians (if over 15 degrees, the signal is transmitted at the max value of 15 degrees (0.261799387799149 radians) and the Valid flag will be showing invalid";
CM_ SG_ 3221225472 Objects_Phi_Line_Left_Valid_Obj8 "Either we do not have an angle or the angle is above 15 degrees (or below -15 degrees)";
CM_ SG_ 3221225472 Objects_Lateral_Velocity_Obj8 "positive to the right! ";
CM_ SG_ 3221225472 Objects_Phi_Line_Right_Obj7 "angle between left object edge and right host lane in radians (if over 15 degrees, the signal is transmitted at the max value of 15 degrees (0.261799387799149 radians) and the Valid flag will be showing invalid";
CM_ SG_ 3221225472 Objects_PhiLineRightValid_Obj7 "Either we do not have an angle or the angle is above 15 degrees (or below -15 degrees)";
CM_ SG_ 3221225472 Objects_Object_Age_Obj7 "A counter that indicates how many frames the object has been active for. When an object is first detected, this signal shall be initialised to 0 and incremented each succesive frame.";
CM_ SG_ 3221225472 Objects_Phi_Line_Left_Obj7 "angle between right object edge and left host lane in radians (if over 15 degrees, the signal is transmitted at the max value of 15 degrees (0.261799387799149 radians) and the Valid flag will be showing invalid";
CM_ SG_ 3221225472 Objects_Phi_Line_Left_Valid_Obj7 "Either we do not have an angle or the angle is above 15 degrees (or below -15 degrees)";
CM_ SG_ 3221225472 Objects_Lateral_Velocity_Obj7 "positive to the right! ";
CM_ SG_ 3221225472 Objects_Phi_Line_Right_Obj6 "angle between left object edge and right host lane in radians (if over 15 degrees, the signal is transmitted at the max value of 15 degrees (0.261799387799149 radians) and the Valid flag will be showing invalid";
CM_ SG_ 3221225472 Objects_PhiLineRightValid_Obj6 "Either we do not have an angle or the angle is above 15 degrees (or below -15 degrees)";
CM_ SG_ 3221225472 Objects_Object_Age_Obj6 "A counter that indicates how many frames the object has been active for. When an object is first detected, this signal shall be initialised to 0 and incremented each succesive frame.";
CM_ SG_ 3221225472 Objects_Phi_Line_Left_Obj6 "angle between right object edge and left host lane in radians (if over 15 degrees, the signal is transmitted at the max value of 15 degrees (0.261799387799149 radians) and the Valid flag will be showing invalid";
CM_ SG_ 3221225472 Objects_Phi_Line_Left_Valid_Obj6 "Either we do not have an angle or the angle is above 15 degrees (or below -15 degrees)";
CM_ SG_ 3221225472 Objects_Lateral_Velocity_Obj6 "positive to the right! ";
CM_ SG_ 3221225472 Objects_Phi_Line_Right_Obj5 "angle between left object edge and right host lane in radians (if over 15 degrees, the signal is transmitted at the max value of 15 degrees (0.261799387799149 radians) and the Valid flag will be showing invalid";
CM_ SG_ 3221225472 Objects_PhiLineRightValid_Obj5 "Either we do not have an angle or the angle is above 15 degrees (or below -15 degrees)";
CM_ SG_ 3221225472 Objects_Object_Age_Obj5 "A counter that indicates how many frames the object has been active for. When an object is first detected, this signal shall be initialised to 0 and incremented each succesive frame.";
CM_ SG_ 3221225472 Objects_Phi_Line_Left_Obj5 "angle between right object edge and left host lane in radians (if over 15 degrees, the signal is transmitted at the max value of 15 degrees (0.261799387799149 radians) and the Valid flag will be showing invalid";
CM_ SG_ 3221225472 Objects_Phi_Line_Left_Valid_Obj5 "Either we do not have an angle or the angle is above 15 degrees (or below -15 degrees)";
CM_ SG_ 3221225472 Objects_Lateral_Velocity_Obj5 "positive to the right! ";
CM_ SG_ 3221225472 Objects_FOE_Y_Obj9 "Level 0";
CM_ SG_ 3221225472 Objects_FOE_X_Obj9 "Level 0";
CM_ SG_ 3221225472 Objects_Right_Obj9 "coordinate position in image (relative to FOE coordinate in image) Assumed image size (and coordinate resolution) -  240X320 pixels (level 0)";
CM_ SG_ 3221225472 Objects_Left_Obj9 "coordinate position in image (relative to FOE coordinate in image) Assumed image size (and coordinate resolution) -  240X320 pixels (level 0)";
CM_ SG_ 3221225472 Objects_FOE_Y_Obj8 "Level 0";
CM_ SG_ 3221225472 Objects_FOE_X_Obj8 "Level 0";
CM_ SG_ 3221225472 Objects_Right_Obj8 "coordinate position in image (relative to FOE coordinate in image) Assumed image size (and coordinate resolution) -  240X320 pixels (level 0)";
CM_ SG_ 3221225472 Objects_Left_Obj8 "coordinate position in image (relative to FOE coordinate in image) Assumed image size (and coordinate resolution) -  240X320 pixels (level 0)";
CM_ SG_ 3221225472 Objects_FOE_Y_Obj7 "Level 0";
CM_ SG_ 3221225472 Objects_FOE_X_Obj7 "Level 0";
CM_ SG_ 3221225472 Objects_Right_Obj7 "coordinate position in image (relative to FOE coordinate in image) Assumed image size (and coordinate resolution) -  240X320 pixels (level 0)";
CM_ SG_ 3221225472 Objects_Left_Obj7 "coordinate position in image (relative to FOE coordinate in image) Assumed image size (and coordinate resolution) -  240X320 pixels (level 0)";
CM_ SG_ 3221225472 Objects_FOE_Y_Obj6 "Level 0";
CM_ SG_ 3221225472 Objects_FOE_X_Obj6 "Level 0";
CM_ SG_ 3221225472 Objects_Right_Obj6 "coordinate position in image (relative to FOE coordinate in image) Assumed image size (and coordinate resolution) -  240X320 pixels (level 0)";
CM_ SG_ 3221225472 Objects_Left_Obj6 "coordinate position in image (relative to FOE coordinate in image) Assumed image size (and coordinate resolution) -  240X320 pixels (level 0)";
CM_ SG_ 3221225472 Objects_FOE_Y_Obj5 "Level 0";
CM_ SG_ 3221225472 Objects_FOE_X_Obj5 "Level 0";
CM_ SG_ 3221225472 Objects_Right_Obj5 "coordinate position in image (relative to FOE coordinate in image) Assumed image size (and coordinate resolution) -  240X320 pixels (level 0)";
CM_ SG_ 3221225472 Objects_Left_Obj5 "coordinate position in image (relative to FOE coordinate in image) Assumed image size (and coordinate resolution) -  240X320 pixels (level 0)";
CM_ SG_ 3221225472 Objects_Width_Obj9 "Object width";
CM_ SG_ 3221225472 Objects_Lane_Movement_Type_Obj9 "the movement of a vehicle";
CM_ SG_ 3221225472 Objects_Brake_Light_Obj9 "This signal will only be valid when the object is the CIPV";
CM_ SG_ 3221225472 Objects_Relative_Velocity_Obj9 "positive for receding, negative for closing in";
CM_ SG_ 3221225472 Objects_RightAnglePredicted_Obj9 "Angle Value predicted using previously determined width when right edge of vhilce is outside of the image";
CM_ SG_ 3221225472 Objects_LeftAnglePredicted_Obj9 "Angle Value predicted using previously determined width when left edge of vhilce is outside of the image";
CM_ SG_ 3221225472 Objects_Acceleration_Abs_Obj9 "absolute acceleration, positive for moving away from the host";
CM_ SG_ 3221225472 Objects_Turn_Indicator_Obj9 "This signal will only be valid when the object is the CIPV";
CM_ SG_ 3221225472 Objects_Angle_Right_Obj9 "in camera coords, this is directly proportional to the pixel values, so no small angle approximation, positive to the right!";
CM_ SG_ 3221225472 Objects_Width_Obj8 "Object width";
CM_ SG_ 3221225472 Objects_Lane_Movement_Type_Obj8 "the movement of a vehicle";
CM_ SG_ 3221225472 Objects_Brake_Light_Obj8 "This signal will only be valid when the object is the CIPV";
CM_ SG_ 3221225472 Objects_Relative_Velocity_Obj8 "positive for receding, negative for closing in";
CM_ SG_ 3221225472 Objects_RightAnglePredicted_Obj8 "Angle Value predicted using previously determined width when right edge of vhilce is outside of the image";
CM_ SG_ 3221225472 Objects_LeftAnglePredicted_Obj8 "Angle Value predicted using previously determined width when left edge of vhilce is outside of the image";
CM_ SG_ 3221225472 Objects_Acceleration_Abs_Obj8 "absolute acceleration, positive for moving away from the host";
CM_ SG_ 3221225472 Objects_Turn_Indicator_Obj8 "This signal will only be valid when the object is the CIPV";
CM_ SG_ 3221225472 Objects_Angle_Right_Obj8 "in camera coords, this is directly proportional to the pixel values, so no small angle approximation, positive to the right!";
CM_ SG_ 3221225472 Objects_Width_Obj7 "Object width";
CM_ SG_ 3221225472 Objects_Lane_Movement_Type_Obj7 "the movement of a vehicle";
CM_ SG_ 3221225472 Objects_Brake_Light_Obj7 "This signal will only be valid when the object is the CIPV";
CM_ SG_ 3221225472 Objects_Relative_Velocity_Obj7 "positive for receding, negative for closing in";
CM_ SG_ 3221225472 Objects_RightAnglePredicted_Obj7 "Angle Value predicted using previously determined width when right edge of vhilce is outside of the image";
CM_ SG_ 3221225472 Objects_LeftAnglePredicted_Obj7 "Angle Value predicted using previously determined width when left edge of vhilce is outside of the image";
CM_ SG_ 3221225472 Objects_Acceleration_Abs_Obj7 "absolute acceleration, positive for moving away from the host";
CM_ SG_ 3221225472 Objects_Turn_Indicator_Obj7 "This signal will only be valid when the object is the CIPV";
CM_ SG_ 3221225472 Objects_Angle_Right_Obj7 "in camera coords, this is directly proportional to the pixel values, so no small angle approximation, positive to the right!";
CM_ SG_ 3221225472 Objects_Width_Obj6 "Object width";
CM_ SG_ 3221225472 Objects_Lane_Movement_Type_Obj6 "the movement of a vehicle";
CM_ SG_ 3221225472 Objects_Brake_Light_Obj6 "This signal will only be valid when the object is the CIPV";
CM_ SG_ 3221225472 Objects_Relative_Velocity_Obj6 "positive for receding, negative for closing in";
CM_ SG_ 3221225472 Objects_RightAnglePredicted_Obj6 "Angle Value predicted using previously determined width when right edge of vhilce is outside of the image";
CM_ SG_ 3221225472 Objects_LeftAnglePredicted_Obj6 "Angle Value predicted using previously determined width when left edge of vhilce is outside of the image";
CM_ SG_ 3221225472 Objects_Acceleration_Abs_Obj6 "absolute acceleration, positive for moving away from the host";
CM_ SG_ 3221225472 Objects_Turn_Indicator_Obj6 "This signal will only be valid when the object is the CIPV";
CM_ SG_ 3221225472 Objects_Angle_Right_Obj6 "in camera coords, this is directly proportional to the pixel values, so no small angle approximation, positive to the right!";
CM_ SG_ 3221225472 Objects_Width_Obj5 "Object width";
CM_ SG_ 3221225472 Objects_Lane_Movement_Type_Obj5 "the movement of a vehicle";
CM_ SG_ 3221225472 Objects_Brake_Light_Obj5 "This signal will only be valid when the object is the CIPV";
CM_ SG_ 3221225472 Objects_Relative_Velocity_Obj5 "positive for receding, negative for closing in";
CM_ SG_ 3221225472 Objects_RightAnglePredicted_Obj5 "Angle Value predicted using previously determined width when right edge of vhilce is outside of the image";
CM_ SG_ 3221225472 Objects_LeftAnglePredicted_Obj5 "Angle Value predicted using previously determined width when left edge of vhilce is outside of the image";
CM_ SG_ 3221225472 Objects_Acceleration_Abs_Obj5 "absolute acceleration, positive for moving away from the host";
CM_ SG_ 3221225472 Objects_Turn_Indicator_Obj5 "This signal will only be valid when the object is the CIPV";
CM_ SG_ 3221225472 Objects_Angle_Right_Obj5 "in camera coords, this is directly proportional to the pixel values, so no small angle approximation, positive to the right!";
CM_ SG_ 3221225472 Objects_Lane_Assignment_Obj8 "Which lane a vehicle belongs to";
CM_ SG_ 3221225472 Objects_Angle_Left_Obj8 "in camera coords, this is directly proportional to the pixel values, so no small angle approximation, positive to the right!";
CM_ SG_ 3221225472 Objects_Motion_Status_Obj8 "Defines motion status of detected vehicle";
CM_ SG_ 3221225472 Objects_Longitudial_Dist_Obj8 "in protocol called TRW_Objects alligned to ref_point_x";
CM_ SG_ 3221225472 Objects_ID_Obj8 "ValidObject = 1 to 63";
CM_ SG_ 3221225472 Objects_Object_Class_Obj8 "0x6 (undecided) represents when no decision yet has been made about class - car or truck 0x0 represents unknown object";
CM_ SG_ 3221225472 Objects_Object_Index_Obj8 "If we send 20 objects, the index will be 0 - 19";
CM_ SG_ 3221225472 Objects_Sync_Frame_Index_Obj8 "synchronizes between the messages in the same frame";
CM_ SG_ 3221225472 Objects_Lane_Assignment_Obj9 "Which lane a vehicle belongs to";
CM_ SG_ 3221225472 Objects_Angle_Left_Obj9 "in camera coords, this is directly proportional to the pixel values, so no small angle approximation, positive to the right!";
CM_ SG_ 3221225472 Objects_Motion_Status_Obj9 "Defines motion status of detected vehicle";
CM_ SG_ 3221225472 Objects_Longitudial_Dist_Obj9 "in protocol called TRW_Objects alligned to ref_point_x";
CM_ SG_ 3221225472 Objects_ID_Obj9 "ValidObject = 1 to 63";
CM_ SG_ 3221225472 Objects_Object_Class_Obj9 "0x6 (undecided) represents when no decision yet has been made about class - car or truck 0x0 represents unknown object";
CM_ SG_ 3221225472 Objects_Object_Index_Obj9 "If we send 20 objects, the index will be 0 - 19";
CM_ SG_ 3221225472 Objects_Sync_Frame_Index_Obj9 "synchronizes between the messages in the same frame";
CM_ SG_ 3221225472 Objects_Lane_Assignment_Obj7 "Which lane a vehicle belongs to";
CM_ SG_ 3221225472 Objects_Angle_Left_Obj7 "in camera coords, this is directly proportional to the pixel values, so no small angle approximation, positive to the right!";
CM_ SG_ 3221225472 Objects_Motion_Status_Obj7 "Defines motion status of detected vehicle";
CM_ SG_ 3221225472 Objects_Longitudial_Dist_Obj7 "in protocol called TRW_Objects alligned to ref_point_x";
CM_ SG_ 3221225472 Objects_ID_Obj7 "ValidObject = 1 to 63";
CM_ SG_ 3221225472 Objects_Object_Class_Obj7 "0x6 (undecided) represents when no decision yet has been made about class - car or truck 0x0 represents unknown object";
CM_ SG_ 3221225472 Objects_Object_Index_Obj7 "If we send 20 objects, the index will be 0 - 19";
CM_ SG_ 3221225472 Objects_Sync_Frame_Index_Obj7 "synchronizes between the messages in the same frame";
CM_ SG_ 3221225472 Objects_Lane_Assignment_Obj6 "Which lane a vehicle belongs to";
CM_ SG_ 3221225472 Objects_Angle_Left_Obj6 "in camera coords, this is directly proportional to the pixel values, so no small angle approximation, positive to the right!";
CM_ SG_ 3221225472 Objects_Motion_Status_Obj6 "Defines motion status of detected vehicle";
CM_ SG_ 3221225472 Objects_Longitudial_Dist_Obj6 "in protocol called TRW_Objects alligned to ref_point_x";
CM_ SG_ 3221225472 Objects_ID_Obj6 "ValidObject = 1 to 63";
CM_ SG_ 3221225472 Objects_Object_Class_Obj6 "0x6 (undecided) represents when no decision yet has been made about class - car or truck 0x0 represents unknown object";
CM_ SG_ 3221225472 Objects_Object_Index_Obj6 "If we send 20 objects, the index will be 0 - 19";
CM_ SG_ 3221225472 Objects_Sync_Frame_Index_Obj6 "synchronizes between the messages in the same frame";
CM_ SG_ 3221225472 Objects_Lane_Assignment_Obj5 "Which lane a vehicle belongs to";
CM_ SG_ 3221225472 Objects_Angle_Left_Obj5 "in camera coords, this is directly proportional to the pixel values, so no small angle approximation, positive to the right!";
CM_ SG_ 3221225472 Objects_Motion_Status_Obj5 "Defines motion status of detected vehicle";
CM_ SG_ 3221225472 Objects_Longitudial_Dist_Obj5 "in protocol called TRW_Objects alligned to ref_point_x";
CM_ SG_ 3221225472 Objects_ID_Obj5 "ValidObject = 1 to 63";
CM_ SG_ 3221225472 Objects_Object_Class_Obj5 "0x6 (undecided) represents when no decision yet has been made about class - car or truck 0x0 represents unknown object";
CM_ SG_ 3221225472 Objects_Object_Index_Obj5 "If we send 20 objects, the index will be 0 - 19";
CM_ SG_ 3221225472 Objects_Sync_Frame_Index_Obj5 "synchronizes between the messages in the same frame";
CM_ SG_ 3221225472 TAC2_Horizon "Vertical offset from image center, measured in reduced coordinates (320x240 image).";
CM_ SG_ 3221225472 TAC2_Yaw "Horizontal offset from image center, measured in reduced coordinates (320x240 image).";
CM_ SG_ 3221225472 SPC_HorizonFull "Vertical offset from image center, measured in full resolution coordinates (level -2)";
CM_ SG_ 3221225472 SPC_YawFull "Horizontal offset from image center, measured in full resolution coordinates (level -2).  Negative to left";
CM_ SG_ 3221225472 SPC_Status "SPC state";
CM_ SG_ 3221225472 SPC_Horizon "Vertical offset from image center, measured in reduced resolution coordinates (level 0)";
CM_ SG_ 3221225472 SPC_Yaw "Horizontal offset from image center, measured in reduced resolution coordinates (level 0). Negative to left";
CM_ SG_ 3221225472 SPC_Progress "Convergence percentage.";
CM_ SG_ 3221225472 SPC_Sync_Frame_Index "synchronizes between the messages in the same frame";
CM_ SG_ 3221225472 TSM0_syncFrameIndex "Synchronizes between the messages in the same frame";
CM_ SG_ 3221225472 CS_AccelerDecelerationRate "Longitudinal Acceleration / Deceleration Rate";
CM_ SG_ 3221225472 CS_BrkPosInitTravelAchVald "Validity of BrakePosInitTravelAch signal";
CM_ SG_ 3221225472 CS_BrakePosInitTravelAch "Indicates whether the pedal is pressed ";
CM_ SG_ 3221225472 CS_BrakePosModTravelAch "When set, LDW is supressed. You should decide on what level of brake you want to suppress the LDW hence to set this bit";
CM_ SG_ 3221225472 CS_ReverseIndicatorValid "Validity of reverse indicator";
CM_ SG_ 3221225472 CS_ReverseIndicator "Indicates negative speed";
CM_ SG_ 3221225472 CS_AcceleratorPedalValue "Validity of the accelerator pedal value";
CM_ SG_ 3221225472 CS_AcceleratorPedalValid "Provides the value of the accelerator pedal";
CM_ SG_ 3221225472 Common_Global_Index "counter based on exposure index -  useful for resim synchronisationcounter based on exposure index -  useful for resim synchronisation";
CM_ SG_ 3221225472 Common_Frame_TimeStamp "timestamp of General exposuretimestamp of General exposure";
CM_ SG_ 3221225472 Common_Frame_Index "For synchronization purposesFor synchronization purposes";
CM_ SG_ 3221225472 OutOfCalibSignsNum_Horizon "number of signs used to calculate the offset in Horizonnumber of signs used to calculate the offset in Horizon";
CM_ SG_ 3221225472 OutOfCalibOffset_Horizon "The vision offset detectedfrom TSR signes indicating that the Horizoncalibration is wrong. Units are in reduced image.The vision offset detectedfrom TSR signes indicating that the Horizoncalibration is wrong. Units are in reduced image.";
CM_ SG_ 3221225472 OutOfCalibSignsNum_Yaw "number of signs used to calculate the offset in YAWnumber of signs used to calculate the offset in YAW";
CM_ SG_ 3221225472 OutOfCalibOffset_Yaw "The vision offset detectedfrom TSR signes indicating that the YAW calibration is wrong. Units are in reduced imageThe vision offset detectedfrom TSR signes indicating that the YAW calibration is wrong. Units are in reduced image";
CM_ SG_ 3221225472 Autofix_Yaw "In reducedIn reduced";
CM_ SG_ 3221225472 Autofix_Horizon "In reducedIn reduced";
CM_ SG_ 3221225472 currentCalibrationIsOK_yaw "the signal is 0 after ignition. if Autofix detect yaw fix less then -+ 3 pixels ()  it will turn to 1 in ~25 sec if autofix detect that Yaw fix is equal or more then -+ pixels it will turn on after autofix first event the signal is 0 after ignition. if Autofix detect yaw fix less then -+ 3 pixels ()  it will turn to 1 in ~25 sec if autofix detect that Yaw fix is equal or more then -+ pixels it will turn on after autofix first event ";
CM_ SG_ 3221225472 FS_Autofix_Out_Of_Calib_Yaw "Indicates that the Failsafe has been activatedIndicates that the Failsafe has been activated";
CM_ SG_ 3221225472 FS_Autofix_Out_Of_Calib_Horizon "Indicates that the Failsafe has been activatedIndicates that the Failsafe has been activated";
CM_ SG_ 3221225472 FS_Autofix_Out_Of_Calib "Indicates that the Failsafe has been activatedIndicates that the Failsafe has been activated";
CM_ SG_ 3221225472 Exposure_Type "Which exposure this isWhich exposure this is";
CM_ SG_ 3221225472 FS_OutOfFocusStatus "The vision detected that the Horizon calibration is wrongThe vision detected that the Horizon calibration is wrong";
CM_ SG_ 3221225472 DayTimeIndicator "Check Enum Values Check Enum Values ";
CM_ SG_ 3221225472 Autofix_Convergence_Status " 0 - initial value before first convergency, 1,2,3,1,... cyclic  0 - initial value before first convergency, 1,2,3,1,... cyclic ";
CM_ SG_ 3221225472 Driving_Side "Calculated by ratio of oncomming left and rightCalculated by ratio of oncomming left and right";
CM_ SG_ 3221225472 FS_Foggy_Spots_bool "Indicates that the Failsafe has been activatedIndicates that the Failsafe has been activated";
CM_ SG_ 3221225472 FS_Foggy_Spots "based on the shape of spots, detects foggy scenarios, and sometimes also detects condensation on windshield. When using high beam - fog is detected by image analysis, and not only by spots analysis. based on the shape of spots, detects foggy scenarios, and sometimes also detects condensation on windshield. When using high beam - fog is detected by image analysis, and not only by spots analysis. ";
CM_ SG_ 3221225472 FS_Frozen_Windshield_bool "Indicates that the Failsafe has been activatedIndicates that the Failsafe has been activated";
CM_ SG_ 3221225472 FS_Frozen_Windshield "Detects light sources that have vertical rays, usually due to a frozen windshield. Convergence is depended on the amount of light sources (more lights -> quicker convergence). Frozen windshield makes spots look narrow and tallDetects light sources that have vertical rays, usually due to a frozen windshield. Convergence is depended on the amount of light sources (more lights -> quicker convergence). Frozen windshield makes spots look narrow and tall";
CM_ SG_ 3221225472 FS_Full_Blockage_bool "Indicates that the Failsafe has been activatedIndicates that the Failsafe has been activated";
CM_ SG_ 3221225472 FS_Full_Blockage "Takes 50 frames with no edges. Recovery is very quick (max 50 frames). Will be on when standing at night with no headlights.Takes 50 frames with no edges. Recovery is very quick (max 50 frames). Will be on when standing at night with no headlights.";
CM_ SG_ 3221225472 FS_Partial_Blockage_bool "Indicates that the Failsafe has been activatedIndicates that the Failsafe has been activated";
CM_ SG_ 3221225472 FS_Partial_Blockage "Low visibility due to partially covered lensLow visibility due to partially covered lens";
CM_ SG_ 3221225472 FS_Smeared_Spots_bool "Indicates that the Failsafe has been activatedIndicates that the Failsafe has been activated";
CM_ SG_ 3221225472 FS_Smeared_Spots "Detects scenarios with pouring rain, that causes taillights and headlamps to look very smeared in the image. Convergence is depended on the amount of light sources (more lights -> quicker convergence). Detects scenarios with pouring rain, that causes taillights and headlamps to look very smeared in the image. Convergence is depended on the amount of light sources (more lights -> quicker convergence). ";
CM_ SG_ 3221225472 FS_Low_Sun_bool "Indicates that the Failsafe has been activatedIndicates that the Failsafe has been activated";
CM_ SG_ 3221225472 FS_Low_Sun "Sun glare which disrupts the image. The sun appears over the FOESun glare which disrupts the image. The sun appears over the FOE";
CM_ SG_ 3221225472 FS_Blurred_Image_bool "Indicates that the Failsafe has been activatedIndicates that the Failsafe has been activated";
CM_ SG_ 3221225472 FS_Blurred_Image "Issued when visibility on the image is lowered such that detection of objects inside the Danger Zone (in-path and next lanes up-to some level) can't be fully performed.Issued when visibility on the image is lowered such that detection of objects inside the Danger Zone (in-path and next lanes up-to some level) can't be fully performed.";
CM_ SG_ 3221225472 FS_Road_Spray_bool "Indicates that the Failsafe has been activatedIndicates that the Failsafe has been activated";
CM_ SG_ 3221225472 FS_Road_Spray "We can not detect the lower edges of vhicles due to water spray aka splashesWe can not detect the lower edges of vhicles due to water spray aka splashes";
CM_ SG_ 3221225472 FS_Sun_Ray_bool "Indicates that the Failsafe has been activatedIndicates that the Failsafe has been activated";
CM_ SG_ 3221225472 FS_Sun_Ray "A strong glare due to micro scratches on the windshieldA strong glare due to micro scratches on the windshield";
CM_ SG_ 3221225472 FS_Self_Glare_bool "Indicates that the Failsafe has been activatedIndicates that the Failsafe has been activated";
CM_ SG_ 3221225472 FS_Self_Glare "Detection of foggy scenes when high beams are on. The FS looks for uniform texture and high brightness in the center of the imageDetection of foggy scenes when high beams are on. The FS looks for uniform texture and high brightness in the center of the image";
CM_ SG_ 3221225472 Common_Protocol_Version "What version of this protocol we are up toWhat version of this protocol we are up to";
CM_ SG_ 3221225472 Common_Sync_Frame_Index "synchronizes between the messages in the same framesynchronizes between the messages in the same frame";
CM_ SG_ 3221225472 FCW_Headway_Time "Describes the time to contact if the preceding vehicle stops.
This values is equal to:
(distanceToPreceding/egoSpeed)";
CM_ SG_ 3221225472 FCW_VO_FCW_SUPPRESSIONS_SETA "0-VEHICLE_ACCELERATION
1-VEHICLE_ACCELERATION_GRACE
2-VEHICLE_BRAKE
3-VEHICLE_BRAKE_GRACE
9-VEH_VEH_OPENING_SCENARIO
12-FCALIA_TIME_GRACE
15-NRTA_STATE
16-NRTA_STATE_SPEED_UNDER_THRESH
17-NRTA_STATE_SPEED_ABOVE_THRESH0-VEHICLE_ACCELERATION
1-VEHICLE_ACCELERATION_GRACE
2-VEHICLE_BRAKE
3-VEHICLE_BRAKE_GRACE
9-VEH_VEH_OPENING_SCENARIO
12-FCALIA_TIME_GRACE
15-NRTA_STATE
16-NRTA_STATE_SPEED_UNDER_THRESH
17-NRTA_STATE_SPEED_ABOVE_THRESH";
CM_ SG_ 3221225472 LBD_Reason_preceding "Reasons to switch to low beamReasons to switch to low beam";
CM_ SG_ 3221225472 HLB_Running_Mode "The system's HLB running mode: HLB_Day - system inactive HLB_Inactive - bright scene detected, system in low beam HLB_Full - all HLB modules are workingThe system's HLB running mode: HLB_Day - system inactive HLB_Inactive - bright scene detected, system in low beam HLB_Full - all HLB modules are working";
CM_ SG_ 3221225472 HLB_Decision "High beam status recommnedationHigh beam status recommnedation";
CM_ SG_ 3221225472 HLB_Protocol_Version "Tracks the version of the protocolTracks the version of the protocol";
CM_ SG_ 3221225472 HLB_Sync_Frame_Index "Used to ensure frames are synchronised to messagesUsed to ensure frames are synchronised to messages";
CM_ SG_ 3221225472 HWE "Highway exit can only be detected on one side at a time";
CM_ SG_ 3221225472 LDW "If and where we have a Lane Departure Warning activatedIf and where we have a Lane Departure Warning activated";
CM_ SG_ 3221225472 Prediction "Reports if we used a predication for the lane left/right reporting. In case of a predication, the LDW will be inactiveReports if we used a predication for the lane left/right reporting. In case of a predication, the LDW will be inactive";
CM_ SG_ 3221225472 LDW_Inhibit_Reasons_generic "LDW - warning suppression reasonsLDW - warning suppression reasons";
CM_ SG_ 3221225472 LDW_Inhibit_Reasons_accel "LDW - warning suppression reasonsLDW - warning suppression reasons";
CM_ SG_ 3221225472 LDW_Inhibit_Reasons_brake "LDW - warning suppression reasonsLDW - warning suppression reasons";
CM_ SG_ 3221225472 LDW_Inhibit_Reasons_left "LDW - warning suppression reasonsLDW - warning suppression reasons";
CM_ SG_ 3221225472 LDW_Inhibit_Reasons_right "LDW - warning suppression reasonsLDW - warning suppression reasons";
CM_ SG_ 3221225472 LDW_Inhibit_Reasons_steering "LDW - warning suppression reasonsLDW - warning suppression reasons";
CM_ SG_ 3221225472 LDW_NRTA_Reasons_narrow "LDW Not ready to assist reasonsLDW Not ready to assist reasons";
CM_ SG_ 3221225472 LDW_NRTA_Reasons_single "LDW Not ready to assist reasonsLDW Not ready to assist reasons";
CM_ SG_ 3221225472 LDW_NRTA_Reasons_right "LDW Not ready to assist reasonsLDW Not ready to assist reasons";
CM_ SG_ 3221225472 LDW_NRTA_Reasons_left "LDW Not ready to assist reasonsLDW Not ready to assist reasons";
CM_ SG_ 3221225472 LDW_NRTA_Reasons_speed "LDW Not ready to assist reasonsLDW Not ready to assist reasons";
CM_ SG_ 3221225472 LDW_RTA "Lane departure warning - ready to assistLane departure warning - ready to assist";
CM_ SG_ 3221225472 Number_Of_Lanes "How many lane messages are reported. How many lane messages are reported. ";
CM_ SG_ 3221225472 Construction_Area "Construction area is detected when we have ambigious lane markings on one or both sidesConstruction area is detected when we have ambigious lane markings on one or both sides";
CM_ SG_ 3221225472 Road_Type "What road type we are currently onWhat road type we are currently on";
CM_ SG_ 3221225472 Lane_Model_Valid "If the lane model is valid or notIf the lane model is valid or not";
CM_ SG_ 3221225472 Lanes_Protocol_Version "What version of this protocol we are up toWhat version of this protocol we are up to";
CM_ SG_ 3221225472 Lane_HD_Sync_Frame_Index "synchronizes between the messages in the same framesynchronizes between the messages in the same frame";
CM_ SG_ 3221225472 PD_alert_L1_pattern "Describes the time to contact if the preceding vehicle stops.
This values is equal to:
(distanceToPreceding/egoSpeed)Describes the time to contact if the preceding vehicle stops.
This values is equal to:
(distanceToPreceding/egoSpeed)";
CM_ SG_ 3221225472 PD_alert_L2 "Describes the time to contact if the preceding vehicle stops.
This values is equal to:
(distanceToPreceding/egoSpeed)Describes the time to contact if the preceding vehicle stops.
This values is equal to:
(distanceToPreceding/egoSpeed)";
CM_ SG_ 3221225472 PD_alert_AEB_supp_Reasons_L1 "Bit0=Braking
Bit1=_Speed
Bit2=Yaw
Bit3=Time [Internal]Bit0=Braking
Bit1=_Speed
Bit2=Yaw
Bit3=Time [Internal]";
CM_ SG_ 3221225472 PD_alert_AEB_supp_Reasons_L2 "Bit0=Braking
Bit1=_Speed
Bit2=Yaw
Bit3=Time [Internal]Bit0=Braking
Bit1=_Speed
Bit2=Yaw
Bit3=Time [Internal]";
CM_ SG_ 3221225472 PD_alert_AEB_supp_Reasons_L3 "Bit0=Braking
Bit1=_Speed
Bit2=Yaw
Bit3=Time [Internal]Bit0=Braking
Bit1=_Speed
Bit2=Yaw
Bit3=Time [Internal]";
CM_ SG_ 3221225472 TSR_TSM_syncFrameIndex "Synchronizes between the messages in the same frame";
CM_ SG_ 3221225472 CS_VehicleSpeedValid "Validity of speed";
CM_ SG_ 3221225472 CS_VehicleYawValid "Validity of yaw";
CM_ SG_ 3221225472 CS_Wiper "How fast wiper is moving (speed not fully implemented - at the moment, 0 is off and everything else is read as on)";
CM_ SG_ 3221225472 CS_TurnSwitchStatus "Status of left/right indicator";
CM_ SG_ 3221225472 CS_SteeringWheelAngVal "Validity of sterring wheel angle";
CM_ SG_ 3221225472 CS_ClutchStartSwitchAct "Has the clutch started to be activated";
CM_ SG_ 3221225472 CS_TopTrvlClutchSwitchAct "Used to indicate if top travel clucth switch is active";
CM_ SG_ 3221225472 CS_HighBeamStatus "Indicates the status of the High Beam lights";
CM_ SG_ 3221225472 CS_FogLightActivation "Are fog lights active";
CM_ SG_ 3221225472 CS_AmbientLightLevel "Used to communicate the level of ambient light using external sensors";
CM_ SG_ 3221225472 CS_AmbientLightLevelValid "Validity of the ambient light level signal";
BA_DEF_ BO_  "NmMessage" ENUM  "Not","Yes";
BA_DEF_ BU_  "NmNode" ENUM  "Not","Yes";
BA_DEF_  "NmMessageCount" INT 0 255;
BA_DEF_  "NmBaseAddress" HEX 0 2047;
BA_DEF_  "NmType" STRING ;
BA_DEF_ BO_  "DiagResponse" ENUM  "Not","Yes";
BA_DEF_ BO_  "DiagRequest" ENUM  "Not","Yes";
BA_DEF_ BU_  "TpCanBus" INT 1 2;
BA_DEF_  "VersionNumber" INT 0 0;
BA_DEF_  "VersionDay" INT 0 31;
BA_DEF_  "VersionWeek" INT 0 52;
BA_DEF_  "VersionMonth" INT 0 12;
BA_DEF_  "VersionYear" INT 0 99;
BA_DEF_  "Manufacturer" STRING ;
BA_DEF_ SG_  "GenSigEnvVarType" ENUM  "int","float","undef";
BA_DEF_  "GenEnvVarPrefix" STRING ;
BA_DEF_  "GenEnvVarEndingSnd" STRING ;
BA_DEF_  "GenEnvVarEndingDsp" STRING ;
BA_DEF_ SG_  "GenSigStartValue" FLOAT 0 1215752192;
BA_DEF_ BO_  "GenMsgILSupport" ENUM  "No","Yes";
BA_DEF_ SG_  "GenSigSendType" ENUM  "Cyclic","OnWrite","OnWriteWithRepetition","OnChange","OnChangeWithRepetition","IfActive","IfActiveWithRepetition","NoSigSendType";
BA_DEF_ BO_  "GenMsgCycleTime" INT 0 0;
BA_DEF_ BO_  "GenMsgSendType" ENUM  "Cyclic","not_used","not_used","not_used","not_used","Cyclic","not_used","IfActive","NoMsgSendType","On Event";
BA_DEF_  "DBName" STRING ;
BA_DEF_  "BusType" STRING ;
BA_DEF_DEF_  "NmMessage" "Not";
BA_DEF_DEF_  "NmNode" "Not";
BA_DEF_DEF_  "NmMessageCount" 128;
BA_DEF_DEF_  "NmBaseAddress" 1024;
BA_DEF_DEF_  "NmType" "";
BA_DEF_DEF_  "DiagResponse" "Not";
BA_DEF_DEF_  "DiagRequest" "Not";
BA_DEF_DEF_  "TpCanBus" 1;
BA_DEF_DEF_  "VersionNumber" 0;
BA_DEF_DEF_  "VersionDay" 0;
BA_DEF_DEF_  "VersionWeek" 0;
BA_DEF_DEF_  "VersionMonth" 0;
BA_DEF_DEF_  "VersionYear" 0;
BA_DEF_DEF_  "Manufacturer" "FAW-OSEK";
BA_DEF_DEF_  "GenSigEnvVarType" "undef";
BA_DEF_DEF_  "GenEnvVarPrefix" "Env";
BA_DEF_DEF_  "GenEnvVarEndingSnd" "_";
BA_DEF_DEF_  "GenEnvVarEndingDsp" "Dsp_";
BA_DEF_DEF_  "GenSigStartValue" 0;
BA_DEF_DEF_  "GenMsgILSupport" "No";
BA_DEF_DEF_  "GenSigSendType" "Cyclic";
BA_DEF_DEF_  "GenMsgCycleTime" 0;
BA_DEF_DEF_  "GenMsgSendType" "NoMsgSendType";
BA_DEF_DEF_  "DBName" "";
BA_DEF_DEF_  "BusType" "CAN";
BA_ "VersionNumber" 8;
BA_ "VersionDay" 17;
BA_ "VersionWeek" 23;
BA_ "VersionMonth" 6;
BA_ "VersionYear" 8;
BA_ "Manufacturer" "FAW";
BA_ "NmType" "FAW-OSEK";
BA_ "DBName" "HMI260";
BA_ "GenSigStartValue" SG_ 3221225472 DSM_Fatigue_Index 5;
VAL_ 3221225472 Day_Night_Decision 3 "DUSK" 2 "NIGHT" 1 "DAY" 0 "UNKNOWN" ;
VAL_ 3221225472 Event_Request3 1 "true" 0 "false" ;
VAL_ 3221225472 Event_Request2 1 "true" 0 "false" ;
VAL_ 3221225472 Event_Request1 1 "true" 0 "false" ;
VAL_ 3221225472 clearTSMSecondaryCond 1 "Clear" 0 "false" ;
VAL_ 3221225472 clearTSMSecondary 1 "Clear" 0 "false" ;
VAL_ 3221225472 clearTSMPrimaryCond 1 "Clear" 0 "false" ;
VAL_ 3221225472 clearTSMPrimary 1 "Clear" 0 "false" ;
VAL_ 3221225472 clearTSMall 1 "Clear" 0 "false" ;
VAL_ 3221225472 ldwSensitivity 2 "EARLY" 1 "MIDDLE" 0 "LATE" ;
VAL_ 3221225472 ldwSensitivityValid 1 "true" 0 "false" ;
VAL_ 3221225472 gpsCountryCode_SecondChar 26 "Z" 25 "Y" 24 "X" 23 "W" 22 "V" 21 "U" 20 "T" 19 "S" 18 "R" 17 "Q" 16 "P" 15 "O" 14 "N" 13 "M" 12 "L" 11 "K" 10 "J" 9 "I" 8 "H" 7 "G" 6 "F" 5 "E" 4 "D" 3 "C" 2 "B" 1 "A" 0 "None" ;
VAL_ 3221225472 hbaReducedSensitivity 1 "true" 0 "false" ;
VAL_ 3221225472 hbaReducedSensitivityValid 1 "true" 0 "false" ;
VAL_ 3221225472 gpsCountryCode_FirstChar 26 "Z" 25 "Y" 24 "X" 23 "W" 22 "V" 21 "U" 20 "T" 19 "S" 18 "R" 17 "Q" 16 "P" 15 "O" 14 "N" 13 "M" 12 "L" 11 "K" 10 "J" 9 "I" 8 "H" 7 "G" 6 "F" 5 "E" 4 "D" 3 "C" 2 "B" 1 "A" 0 "None" ;
VAL_ 3221225472 DriverSensitivity 1 "on" 0 "off" ;
VAL_ 3221225472 DriverSensitivityValid 1 "valid" 0 "invalid" ;
VAL_ 3221225472 pcwGapSensitivity 3 "FAR" 2 "MEDIUM" 1 "NEAR" 0 "OFF" ;
VAL_ 3221225472 pcwGapSensitivityValid 1 "true" 0 "false" ;
VAL_ 3221225472 fcaGapSensitivity 3 "FAR" 2 "MEDIUM" 1 "NEAR" 0 "OFF" ;
VAL_ 3221225472 fcaGapSensitivityValid 1 "true" 0 "false" ;
VAL_ 3221225472 Safety_Diagnostic_Manager7 1 "POS_DIFF_KALMAN_VAL" 0 "OK" ;
VAL_ 3221225472 Safety_Diagnostic_Manager6 1 "FCV_FCW_TTC" 0 "OK" ;
VAL_ 3221225472 Safety_Diagnostic_Manager4 1 "YAW_HORIZON_DEVIATION" 0 "OK" ;
VAL_ 3221225472 Safety_Diagnostic_Manager13 1 "OLD_EGODATA_LAT" 0 "OK" ;
VAL_ 3221225472 Safety_Diagnostic_Manager12 1 "OUTPUT_CRC_MISMATCH" 0 "OK" ;
VAL_ 3221225472 Safety_Diagnostic_Manager11 1 "INPUT_CRC_MISMATCH" 0 "OK" ;
VAL_ 3221225472 Safety_Diagnostic_Manager9 1 "ROI_DIFF_VC_FCV" 0 "OK" ;
VAL_ 3221225472 Safety_Diagnostic_Manager8 1 "POS_DIFF_KALMAN_TRI" 0 "OK" ;
VAL_ 3221225472 Safety_Diagnostic_Manager22 1 "TEMPERATURE_OUT_OF_RANGE" 0 "OK" ;
VAL_ 3221225472 Safety_Diagnostic_Manager19 1 "IMAGE_GRAB_MISS" 0 "OK" ;
VAL_ 3221225472 Safety_Diagnostic_Manager18 1 "IMAGER_DATA_ROWS_COLS " 0 "OK" ;
VAL_ 3221225472 Safety_Diagnostic_Manager31 1 "AEB_PARAM_FFI" 0 "OK" ;
VAL_ 3221225472 Safety_Diagnostic_Manager30 1 "DT_ERR" 0 "OK" ;
VAL_ 3221225472 Safety_Diagnostic_Manager29 1 "RFC_ERR" 0 "OK" ;
VAL_ 3221225472 Safety_Diagnostic_Manager28 1 "Safe state indicator " 0 "OK" ;
VAL_ 3221225472 Safety_Diagnostic_Manager27 1 "FCV_SIG_FFI" 0 "OK" ;
VAL_ 3221225472 Safety_Diagnostic_Manager26 1 "CODE_CRC" 0 "OK" ;
VAL_ 3221225472 Safety_Diagnostic_Manager25 1 "CO_FOF_DIFF" 0 "OK" ;
VAL_ 3221225472 Safety_Diagnostic_Manager32 1 "CORR_VEHICLE_INFO_INPUT_SIGNALS" 0 "ok" ;
VAL_ 3221225472 SPTAC_Output_SPTAC_Status 10 "FOE_OUT_OF_RANGE" 9 "ROLL_OUT_OF_RANGE" 8 "WRONG_STAGE_ERROR" 7 "BAD_IMAGE_SPTAC_ERROR" 6 "LINE_NOT_FOUND_SPTAC_ERROR" 5 "FAR_CLOSE_ROLL_SPTAC_ERROR" 4 "LINE_MISMATCH_SPTAC_ERROR" 3 "SAME_CLOSE_FAR_SPTAC_ERROR" 2 "SWITCH_CLOSE_FAR_SPTAC_ERROR" 1 "UNKOWN_SPTAC_ERROR" 0 "NO_SPTAC_ERROR" ;
VAL_ 3221225472 Objects_Cut_In_Cut_Out_Obj9 8 "Next Cut Out Right" 7 "Next Cut Out Left" 6 "Next Cut In Right" 5 "Next Cut In Left" 4 "Host Cut Out Right" 3 "Host Cut Out Left" 2 "Host Cut In Right" 1 "Host Cut In Left" 0 "Unknown" ;
VAL_ 3221225472 Objects_Cut_In_Cut_Out_Obj8 8 "Next Cut Out Right" 7 "Next Cut Out Left" 6 "Next Cut In Right" 5 "Next Cut In Left" 4 "Host Cut Out Right" 3 "Host Cut Out Left" 2 "Host Cut In Right" 1 "Host Cut In Left" 0 "Unknown" ;
VAL_ 3221225472 Objects_Cut_In_Cut_Out_Obj7 8 "Next Cut Out Right" 7 "Next Cut Out Left" 6 "Next Cut In Right" 5 "Next Cut In Left" 4 "Host Cut Out Right" 3 "Host Cut Out Left" 2 "Host Cut In Right" 1 "Host Cut In Left" 0 "Unknown" ;
VAL_ 3221225472 Objects_Cut_In_Cut_Out_Obj6 8 "Next Cut Out Right" 7 "Next Cut Out Left" 6 "Next Cut In Right" 5 "Next Cut In Left" 4 "Host Cut Out Right" 3 "Host Cut Out Left" 2 "Host Cut In Right" 1 "Host Cut In Left" 0 "Unknown" ;
VAL_ 3221225472 Objects_Cut_In_Cut_Out_Obj5 8 "Next Cut Out Right" 7 "Next Cut Out Left" 6 "Next Cut In Right" 5 "Next Cut In Left" 4 "Host Cut Out Right" 3 "Host Cut Out Left" 2 "Host Cut In Right" 1 "Host Cut In Left" 0 "Unknown" ;
VAL_ 3221225472 Objects_PhiLineRightValid_Obj9 1 "Valid" 0 "Invalid" ;
VAL_ 3221225472 Objects_Phi_Line_Left_Valid_Obj9 1 "Valid" 0 "Invalid" ;
VAL_ 3221225472 Objects_PhiLineRightValid_Obj8 1 "Valid" 0 "Invalid" ;
VAL_ 3221225472 Objects_Phi_Line_Left_Valid_Obj8 1 "Valid" 0 "Invalid" ;
VAL_ 3221225472 Objects_PhiLineRightValid_Obj7 1 "Valid" 0 "Invalid" ;
VAL_ 3221225472 Objects_Phi_Line_Left_Valid_Obj7 1 "Valid" 0 "Invalid" ;
VAL_ 3221225472 Objects_PhiLineRightValid_Obj6 1 "Valid" 0 "Invalid" ;
VAL_ 3221225472 Objects_Phi_Line_Left_Valid_Obj6 1 "Valid" 0 "Invalid" ;
VAL_ 3221225472 Objects_PhiLineRightValid_Obj5 1 "Valid" 0 "Invalid" ;
VAL_ 3221225472 Objects_Phi_Line_Left_Valid_Obj5 1 "Valid" 0 "Invalid" ;
VAL_ 3221225472 Objects_Lane_Movement_Type_Obj9 2 "Moving Right" 1 "Moving Left" 0 "Unknown" ;
VAL_ 3221225472 Objects_Brake_Light_Obj9 2 "Off" 1 "On" 0 "Not available" ;
VAL_ 3221225472 Objects_RightAnglePredicted_Obj9 1 "True" 0 "False" ;
VAL_ 3221225472 Objects_LeftAnglePredicted_Obj9 1 "True" 0 "False" ;
VAL_ 3221225472 Objects_Lane_Movement_Type_Obj8 2 "Moving Right" 1 "Moving Left" 0 "Unknown" ;
VAL_ 3221225472 Objects_Brake_Light_Obj8 2 "Off" 1 "On" 0 "Not available" ;
VAL_ 3221225472 Objects_RightAnglePredicted_Obj8 1 "True" 0 "False" ;
VAL_ 3221225472 Objects_LeftAnglePredicted_Obj8 1 "True" 0 "False" ;
VAL_ 3221225472 Objects_Lane_Movement_Type_Obj7 2 "Moving Right" 1 "Moving Left" 0 "Unknown" ;
VAL_ 3221225472 Objects_Brake_Light_Obj7 2 "Off" 1 "On" 0 "Not available" ;
VAL_ 3221225472 Objects_RightAnglePredicted_Obj7 1 "True" 0 "False" ;
VAL_ 3221225472 Objects_LeftAnglePredicted_Obj7 1 "True" 0 "False" ;
VAL_ 3221225472 Objects_Lane_Movement_Type_Obj6 2 "Moving Right" 1 "Moving Left" 0 "Unknown" ;
VAL_ 3221225472 Objects_Brake_Light_Obj6 2 "Off" 1 "On" 0 "Not available" ;
VAL_ 3221225472 Objects_RightAnglePredicted_Obj6 1 "True" 0 "False" ;
VAL_ 3221225472 Objects_LeftAnglePredicted_Obj6 1 "True" 0 "False" ;
VAL_ 3221225472 Objects_Lane_Movement_Type_Obj5 2 "Moving Right" 1 "Moving Left" 0 "Unknown" ;
VAL_ 3221225472 Objects_Brake_Light_Obj5 2 "Off" 1 "On" 0 "Not available" ;
VAL_ 3221225472 Objects_RightAnglePredicted_Obj5 1 "True" 0 "False" ;
VAL_ 3221225472 Objects_LeftAnglePredicted_Obj5 1 "True" 0 "False" ;
VAL_ 3221225472 Objects_Lane_Assignment_Obj8 5 "Next next Lane right" 4 "Next next Lane left" 3 "Next Lane right" 2 "Next Lane left" 1 "Ego Lane" 0 "Not assigned" ;
VAL_ 3221225472 Objects_Motion_Status_Obj8 8 "Moving (Oncoming )" 7 "Unknown (Oncoming )" 6 "Stopped (Oncoming )" 5 "Moving (movable)" 4 "Unknown (movable)" 3 "Stopped (movable)" 2 "Parked (never moved, back lights are off)" 1 "Standing (never moved back lights are on)" 0 "Not Defined" ;
VAL_ 3221225472 Objects_Object_Class_Obj8 6 "Undecided" 5 "Pedestrian" 4 "Bicycle" 3 "MotorBike" 2 "Car" 1 "Truck" 0 "Unknown" ;
VAL_ 3221225472 Objects_Lane_Assignment_Obj9 5 "Next next Lane right" 4 "Next next Lane left" 3 "Next Lane right" 2 "Next Lane left" 1 "Ego Lane" 0 "Not assigned" ;
VAL_ 3221225472 Objects_Motion_Status_Obj9 8 "Moving (Oncoming )" 7 "Unknown (Oncoming )" 6 "Stopped (Oncoming )" 5 "Moving (movable)" 4 "Unknown (movable)" 3 "Stopped (movable)" 2 "Parked (never moved, back lights are off)" 1 "Standing (never moved back lights are on)" 0 "Not Defined" ;
VAL_ 3221225472 Objects_Object_Class_Obj9 6 "Undecided" 5 "Pedestrian" 4 "Bicycle" 3 "MotorBike" 2 "Car" 1 "Truck" 0 "Unknown" ;
VAL_ 3221225472 Objects_Lane_Assignment_Obj7 5 "Next next Lane right" 4 "Next next Lane left" 3 "Next Lane right" 2 "Next Lane left" 1 "Ego Lane" 0 "Not assigned" ;
VAL_ 3221225472 Objects_Motion_Status_Obj7 8 "Moving (Oncoming )" 7 "Unknown (Oncoming )" 6 "Stopped (Oncoming )" 5 "Moving (movable)" 4 "Unknown (movable)" 3 "Stopped (movable)" 2 "Parked (never moved, back lights are off)" 1 "Standing (never moved back lights are on)" 0 "Not Defined" ;
VAL_ 3221225472 Objects_Object_Class_Obj7 6 "Undecided" 5 "Pedestrian" 4 "Bicycle" 3 "MotorBike" 2 "Car" 1 "Truck" 0 "Unknown" ;
VAL_ 3221225472 Objects_Lane_Assignment_Obj6 5 "Next next Lane right" 4 "Next next Lane left" 3 "Next Lane right" 2 "Next Lane left" 1 "Ego Lane" 0 "Not assigned" ;
VAL_ 3221225472 Objects_Motion_Status_Obj6 8 "Moving (Oncoming )" 7 "Unknown (Oncoming )" 6 "Stopped (Oncoming )" 5 "Moving (movable)" 4 "Unknown (movable)" 3 "Stopped (movable)" 2 "Parked (never moved, back lights are off)" 1 "Standing (never moved back lights are on)" 0 "Not Defined" ;
VAL_ 3221225472 Objects_Object_Class_Obj6 6 "Undecided" 5 "Pedestrian" 4 "Bicycle" 3 "MotorBike" 2 "Car" 1 "Truck" 0 "Unknown" ;
VAL_ 3221225472 Objects_Lane_Assignment_Obj5 5 "Next next Lane right" 4 "Next next Lane left" 3 "Next Lane right" 2 "Next Lane left" 1 "Ego Lane" 0 "Not assigned" ;
VAL_ 3221225472 Objects_Motion_Status_Obj5 8 "Moving (Oncoming )" 7 "Unknown (Oncoming )" 6 "Stopped (Oncoming )" 5 "Moving (movable)" 4 "Unknown (movable)" 3 "Stopped (movable)" 2 "Parked (never moved, back lights are off)" 1 "Standing (never moved back lights are on)" 0 "Not Defined" ;
VAL_ 3221225472 Objects_Object_Class_Obj5 6 "Undecided" 5 "Pedestrian" 4 "Bicycle" 3 "MotorBike" 2 "Car" 1 "Truck" 0 "Unknown" ;
VAL_ 3221225472 Obj0_HLB_OBJ_TYPE 15 "invalid" 6 "cluster" 5 "street light

" 4 "couple of OC upper truck lights" 3 "couple of preceding

" 2 "preceding" 1 "couple of oncoming

" 0 "oncoming" ;
VAL_ 3221225472 Obj1_HLB_OBJ_TYPE 15 "invalid" 6 "cluster" 5 "street light

" 4 "couple of OC upper truck lights" 3 "couple of preceding

" 2 "preceding" 1 "couple of oncoming

" 0 "oncoming" ;
VAL_ 3221225472 Obj2_HLB_OBJ_TYPE 15 "invalid" 6 "cluster" 5 "street light

" 4 "couple of OC upper truck lights" 3 "couple of preceding

" 2 "preceding" 1 "couple of oncoming

" 0 "oncoming" ;
VAL_ 3221225472 Obj3_HLB_OBJ_DIST 15 "invalid" 6 "cluster" 5 "street light

" 4 "couple of OC upper truck lights" 3 "couple of preceding

" 2 "preceding" 1 "couple of oncoming

" 0 "oncoming" ;
VAL_ 3221225472 Obj4_HLB_OBJ_TYPE 15 "invalid" 6 "cluster" 5 "street light

" 4 "couple of OC upper truck lights" 3 "couple of preceding

" 2 "preceding" 1 "couple of oncoming

" 0 "oncoming" ;
VAL_ 3221225472 Obj5_HLB_OBJ_DIST 15 "invalid" 6 "cluster" 5 "street light

" 4 "couple of OC upper truck lights" 3 "couple of preceding

" 2 "preceding" 1 "couple of oncoming

" 0 "oncoming" ;
VAL_ 3221225472 Obj6_HLB_OBJ_TYPE 15 "invalid" 6 "cluster" 5 "street light

" 4 "couple of OC upper truck lights" 3 "couple of preceding

" 2 "preceding" 1 "couple of oncoming

" 0 "oncoming" ;
VAL_ 3221225472 Obj7_HLB_OBJ_TYPE 15 "invalid" 6 "cluster" 5 "street light

" 4 "couple of OC upper truck lights" 3 "couple of preceding

" 2 "preceding" 1 "couple of oncoming

" 0 "oncoming" ;
VAL_ 3221225472 Obj8_HLB_OBJ_TYPE 15 "invalid" 6 "cluster" 5 "street light

" 4 "couple of OC upper truck lights" 3 "couple of preceding

" 2 "preceding" 1 "couple of oncoming

" 0 "oncoming" ;
VAL_ 3221225472 Obj9_HLB_OBJ_TYPE 15 "invalid" 6 "cluster" 5 "street light

" 4 "couple of OC upper truck lights" 3 "couple of preceding

" 2 "preceding" 1 "couple of oncoming

" 0 "oncoming" ;
VAL_ 3221225472 Obj10_HLB_OBJ_TYPE 15 "invalid" 6 "cluster" 5 "street light

" 4 "couple of OC upper truck lights" 3 "couple of preceding

" 2 "preceding" 1 "couple of oncoming

" 0 "oncoming" ;
VAL_ 3221225472 Obj11_HLB_OBJ_TYPE 15 "invalid" 6 "cluster" 5 "street light

" 4 "couple of OC upper truck lights" 3 "couple of preceding

" 2 "preceding" 1 "couple of oncoming

" 0 "oncoming" ;
VAL_ 3221225472 TAC2_Status 11 "RUN_ERROR" 10 "TOO_MANY_TARGETS" 9 "BAD_PARAMS_TARGET_HORIZON" 8 "BAD_PARAMS_TARGET_YAW" 7 "BAD_PARAMS_SQUARE_SIDE_SIZE" 6 "BAD_PARAMS_DISTANCE" 5 "PARAMS_LOAD_FAILED" 4 "FOE_OUT_OF_TOLERANCE" 3 "ROLL_ANGLE_TOO_LARGE" 2 "TARGET_NOT_FOUND" 1 "NO_ERROR" 0 "UNDEFINED" ;
VAL_ 3221225472 SPC_Status 6 "SPC_ROLL_ERROR" 5 "SPC_PAUSED" 4 "SPC_TIMEOUT" 3 "SPC_CAL" 2 "SPC_OK" 1 "SPC_ERROR" 0 "SPC_NOT_INIT" ;
VAL_ 3221225472 App_Minor_Error 5013 "BM_EM_FAILED_CHECK_REG_VERSIONS" 5012 "BM_EM_ERR_FAILED_INIT_IL" 5011 "BM_EM_FAILED_INIT_CREATE_LOGGER" 5010 "BM_EM_ERR_FAILED_POST_INIT_EP" 5009 "BM_EM_ERR_FAILED_INIT_EP" 5008 "BM_EM_ERR_FAILED_OPEN_BLACKBOX" 5007 "BM_EM_ERR_FAILED_INIT_BB_REG" 5006 "BM_EM_ERR_FAILED_INIT_BB " 5005 "BM_EM_ERR_FAILED_INIT" 5004 "BM_EM_ERR_FAILED_INIT_REGISTRY" 5003 "BM_EM_ERR_FAILED_LOAD_REGISTRY" 5002 "BM_EM_ERR_FAILED_LOAD_SETTING" 5001 "BM_EM_ERROR" 1 "BM_ERROR" 0 "BM_OK" ;
VAL_ 3221225472 Temperture_DDR 3 "ABOVE_85C" 2 "ABOVE_SPEC" 1 "BELOW_SPEC" 0 " RANGE_OK" ;
VAL_ 3221225472 TSR6_VO_supplementarySignType 255 "Invalid_supp" 23 "e_ramp" 22 "e_zone" 21 "e_rappel" 20 "Supp_sign_generic" 19 "Night" 18 "Hazerdous_materials" 17 "Fog" 16 "Rain_cloud" 15 "School" 14 "Snow_rain" 13 "Tractor" 12 "Distance_in" 11 "Weight" 10 "Distance_arrow" 9 "Truck" 8 "BendArrow_right" 7 "BendArrow_left" 6 "Arrow_right" 5 "Arrow_left" 4 "Time" 3 "Trailer" 2 "Snow" 1 "Rain" 0 "None" ;
VAL_ 3221225472 TSR6_VO_signType 255 "Invalid sign" 254 "No_sign_detected" 249 "arrow_eitherSide" 248 "arrow_keepRight" 247 "arrow_keepLeft" 246 "arrow_noRight" 245 "arrow_noLeft" 244 "arrow_leftAhead" 243 "arrow_rightAhead" 242 "arrow_left" 241 "arrow_right" 240 "arrow_straight" 237 "trafficLightsRedArrowRight" 236 "trafficLightsRedArrowLeft" 235 "trafficLightsRed" 234 "trafficLightsRedOrange" 233 "trafficLightsOrange" 232 "trafficLightsGreenArrowRight" 231 "trafficLightsGreenArrowLeft" 230 "trafficLightsGreen" 226 "Electronic NoPassingTruckEnd" 225 "Electronic NoPassingTruckStart" 224 "Standard regular Roundabout" 221 "Std electronic no passing end" 220 "Std electronic no passing start" 211 "Standard regular Truck limit" 210 "Standard regular stop sign " 209 "Standard regular stop sign alert" 203 "Std regular No Pass Truck end" 202 "Std regular No Pass Truck Start" 201 "Std regular end of no passing" 200 "Std regular no passiing start " 199 "Standard regular No Entrance" 198 "Std regular No entrance Alert" 179 "Standard regular Tunnel" 178 "Std reg City Entrance Combined" 177 "Standard regular City Entrance" 176 "Std regular Playground end" 175 "Std regular Playground begin" 174 "Standard regular express end" 173 "Standard regular express begin" 172 "Standard regular motorWay end" 171 "Standard regular motorWay begin" 168 "triangular_yield" 167 "triangular_wildAnimalCrossing" 166 "triangular_unguardedRailwayCross" 165 "triangular_twoWayTraffic" 164 "triangular_trafficSignals" 163 "triangular_strongCrossWind" 162 "triangular_steepUpgrade" 161 "triangular_steepDowngrade" 160 "triangular_slipperyWhenWet" 159 "triangular_roundabout" 158 "triangular_roughRoad" 157 "triangular_roadWork" 156 "triangular_roadNarrowsRight" 155 "triangular_roadNarrowsLeft" 154 "triangular_roadNarrows" 153 "triangular_riverBank" 152 "triangular_rightMerge" 151 "triangular_priority" 150 "triangular_pedestrainsCrossing" 149 "triangular_pedestrains" 148 "triangular_lowFlyingAircraft" 147 "triangular_looseGravel" 146 "triangular_leftMerge" 145 "triangular_intersection" 144 "triangular_guardedRailwayCross" 143 "triangular_generalDanger" 142 "triangular_fallingRocks" 141 "triangular_drawBrige" 140 "triangular_doubleCurveRight" 139 "triangular_doubleCurveLeft" 138 "triangular_domesticAnimalCross" 137 "triangular_curveRight" 136 "triangular_curveLeft" 135 "triangular_congestionHazard" 134 "triangular_children" 133 "triangular_buses" 132 "triangular_bicycleCrossing" 131 "triangular_bewareOfSnow" 129 "Standard electronic 145" 128 "Standard electronic 135" 127 "Standard electronic 125" 126 "Standard electronic 115" 125 "Standard electrinic 105" 124 "Standard electronic 95 " 123 "Standard electronic 85" 122 "Standard electronic 75" 121 "Standard electronic 65" 120 "Standard electronic 55" 119 "Standard electronic 45" 118 "Standard electronic 35" 117 "Standard electronic 25" 116 "Standard electronic 15" 115 "Standard electronic 5" 114 "Standard regular 145" 113 "Standard regular 135" 112 "Standard regular 125" 111 "Standard regular 115" 110 "Standard regular 105" 109 "Standard regular 95" 108 "Standard regular 85" 107 "Standard regular 75" 106 "Standard regular 65" 105 "Standard regular 55" 104 "Standard regular 45" 103 "Standard regular 35" 102 "Standard regular 25" 101 "Standard regular 15" 100 "Standard regular 5" 70 "Unknown traffic sign" 65 "Standard electronic general end" 64 "Standard regular general end" 50 "Standard electronic end of num" 41 "Standard electronic 140" 40 "Standard electronic 130" 39 "Standard electronic 120" 38 "Standard electronic 110" 37 "Standard electronic 100" 36 "Standard electronic 90" 35 "Standard electronic 80" 34 "Standard electronic 70" 33 "Standard electronic 60" 32 "Standard electronic 50" 31 "Standard electronic 40" 30 "Standard electronic 30" 29 "Standard electronic 20" 28 "Standard electronic 10" 20 "Standard regular end of number" 13 "Standard regular 140" 12 "Standard regular 130 " 11 "Standard regular 120" 10 "Standard regular 110" 9 "Standard regular 100" 8 "Standard regular 90" 7 "Standard regular 80" 6 "Standard regular 70" 5 "Standard regular 60" 4 "Standard regular 50" 3 "Standard regular 40" 2 "Standard regular 30" 1 "Standard regular 20" 0 "Standard regular 10" ;
VAL_ 3221225472 TSR6_No_Entry_Vision_Status 5 "Default" 4 "Reserved" 3 "Alert" 2 "Reject_Vision_Only" 1 "Delay" 0 "Notification" ;
VAL_ 3221225472 TSR5_VO_supplementarySignType 255 "Invalid_supp" 23 "e_ramp" 22 "e_zone" 21 "e_rappel" 20 "Supp_sign_generic" 19 "Night" 18 "Hazerdous_materials" 17 "Fog" 16 "Rain_cloud" 15 "School" 14 "Snow_rain" 13 "Tractor" 12 "Distance_in" 11 "Weight" 10 "Distance_arrow" 9 "Truck" 8 "BendArrow_right" 7 "BendArrow_left" 6 "Arrow_right" 5 "Arrow_left" 4 "Time" 3 "Trailer" 2 "Snow" 1 "Rain" 0 "None" ;
VAL_ 3221225472 TSR5_VO_signType 255 "Invalid sign" 254 "No_sign_detected" 249 "arrow_eitherSide" 248 "arrow_keepRight" 247 "arrow_keepLeft" 246 "arrow_noRight" 245 "arrow_noLeft" 244 "arrow_leftAhead" 243 "arrow_rightAhead" 242 "arrow_left" 241 "arrow_right" 240 "arrow_straight" 237 "trafficLightsRedArrowRight" 236 "trafficLightsRedArrowLeft" 235 "trafficLightsRed" 234 "trafficLightsRedOrange" 233 "trafficLightsOrange" 232 "trafficLightsGreenArrowRight" 231 "trafficLightsGreenArrowLeft" 230 "trafficLightsGreen" 226 "Electronic NoPassingTruckEnd" 225 "Electronic NoPassingTruckStart" 224 "Standard regular Roundabout" 221 "Std electronic no passing end" 220 "Std electronic no passing start" 211 "Standard regular Truck limit" 210 "Standard regular stop sign " 209 "Standard regular stop sign alert" 203 "Std regular No Pass Truck end" 202 "Std regular No Pass Truck Start" 201 "Std regular end of no passing" 200 "Std regular no passiing start " 199 "Standard regular No Entrance" 198 "Std regular No entrance Alert" 179 "Standard regular Tunnel" 178 "Std reg City Entrance Combined" 177 "Standard regular City Entrance" 176 "Std regular Playground end" 175 "Std regular Playground begin" 174 "Standard regular express end" 173 "Standard regular express begin" 172 "Standard regular motorWay end" 171 "Standard regular motorWay begin" 168 "triangular_yield" 167 "triangular_wildAnimalCrossing" 166 "triangular_unguardedRailwayCross" 165 "triangular_twoWayTraffic" 164 "triangular_trafficSignals" 163 "triangular_strongCrossWind" 162 "triangular_steepUpgrade" 161 "triangular_steepDowngrade" 160 "triangular_slipperyWhenWet" 159 "triangular_roundabout" 158 "triangular_roughRoad" 157 "triangular_roadWork" 156 "triangular_roadNarrowsRight" 155 "triangular_roadNarrowsLeft" 154 "triangular_roadNarrows" 153 "triangular_riverBank" 152 "triangular_rightMerge" 151 "triangular_priority" 150 "triangular_pedestrainsCrossing" 149 "triangular_pedestrains" 148 "triangular_lowFlyingAircraft" 147 "triangular_looseGravel" 146 "triangular_leftMerge" 145 "triangular_intersection" 144 "triangular_guardedRailwayCross" 143 "triangular_generalDanger" 142 "triangular_fallingRocks" 141 "triangular_drawBrige" 140 "triangular_doubleCurveRight" 139 "triangular_doubleCurveLeft" 138 "triangular_domesticAnimalCross" 137 "triangular_curveRight" 136 "triangular_curveLeft" 135 "triangular_congestionHazard" 134 "triangular_children" 133 "triangular_buses" 132 "triangular_bicycleCrossing" 131 "triangular_bewareOfSnow" 129 "Standard electronic 145" 128 "Standard electronic 135" 127 "Standard electronic 125" 126 "Standard electronic 115" 125 "Standard electrinic 105" 124 "Standard electronic 95 " 123 "Standard electronic 85" 122 "Standard electronic 75" 121 "Standard electronic 65" 120 "Standard electronic 55" 119 "Standard electronic 45" 118 "Standard electronic 35" 117 "Standard electronic 25" 116 "Standard electronic 15" 115 "Standard electronic 5" 114 "Standard regular 145" 113 "Standard regular 135" 112 "Standard regular 125" 111 "Standard regular 115" 110 "Standard regular 105" 109 "Standard regular 95" 108 "Standard regular 85" 107 "Standard regular 75" 106 "Standard regular 65" 105 "Standard regular 55" 104 "Standard regular 45" 103 "Standard regular 35" 102 "Standard regular 25" 101 "Standard regular 15" 100 "Standard regular 5" 70 "Unknown traffic sign" 65 "Standard electronic general end" 64 "Standard regular general end" 50 "Standard electronic end of num" 41 "Standard electronic 140" 40 "Standard electronic 130" 39 "Standard electronic 120" 38 "Standard electronic 110" 37 "Standard electronic 100" 36 "Standard electronic 90" 35 "Standard electronic 80" 34 "Standard electronic 70" 33 "Standard electronic 60" 32 "Standard electronic 50" 31 "Standard electronic 40" 30 "Standard electronic 30" 29 "Standard electronic 20" 28 "Standard electronic 10" 20 "Standard regular end of number" 13 "Standard regular 140" 12 "Standard regular 130 " 11 "Standard regular 120" 10 "Standard regular 110" 9 "Standard regular 100" 8 "Standard regular 90" 7 "Standard regular 80" 6 "Standard regular 70" 5 "Standard regular 60" 4 "Standard regular 50" 3 "Standard regular 40" 2 "Standard regular 30" 1 "Standard regular 20" 0 "Standard regular 10" ;
VAL_ 3221225472 TSR5_No_Entry_Vision_Status 5 "Default" 4 "Reserved" 3 "Alert" 2 "Reject_Vision_Only" 1 "Delay" 0 "Notification" ;
VAL_ 3221225472 TSR4_VO_supplementarySignType 255 "Invalid_supp" 23 "e_ramp" 22 "e_zone" 21 "e_rappel" 20 "Supp_sign_generic" 19 "Night" 18 "Hazerdous_materials" 17 "Fog" 16 "Rain_cloud" 15 "School" 14 "Snow_rain" 13 "Tractor" 12 "Distance_in" 11 "Weight" 10 "Distance_arrow" 9 "Truck" 8 "BendArrow_right" 7 "BendArrow_left" 6 "Arrow_right" 5 "Arrow_left" 4 "Time" 3 "Trailer" 2 "Snow" 1 "Rain" 0 "None" ;
VAL_ 3221225472 TSR4_VO_signType 255 "Invalid sign" 254 "No_sign_detected" 249 "arrow_eitherSide" 248 "arrow_keepRight" 247 "arrow_keepLeft" 246 "arrow_noRight" 245 "arrow_noLeft" 244 "arrow_leftAhead" 243 "arrow_rightAhead" 242 "arrow_left" 241 "arrow_right" 240 "arrow_straight" 237 "trafficLightsRedArrowRight" 236 "trafficLightsRedArrowLeft" 235 "trafficLightsRed" 234 "trafficLightsRedOrange" 233 "trafficLightsOrange" 232 "trafficLightsGreenArrowRight" 231 "trafficLightsGreenArrowLeft" 230 "trafficLightsGreen" 226 "Electronic NoPassingTruckEnd" 225 "Electronic NoPassingTruckStart" 224 "Standard regular Roundabout" 221 "Std electronic no passing end" 220 "Std electronic no passing start" 211 "Standard regular Truck limit" 210 "Standard regular stop sign " 209 "Standard regular stop sign alert" 203 "Std regular No Pass Truck end" 202 "Std regular No Pass Truck Start" 201 "Std regular end of no passing" 200 "Std regular no passiing start " 199 "Standard regular No Entrance" 198 "Std regular No entrance Alert" 179 "Standard regular Tunnel" 178 "Std reg City Entrance Combined" 177 "Standard regular City Entrance" 176 "Std regular Playground end" 175 "Std regular Playground begin" 174 "Standard regular express end" 173 "Standard regular express begin" 172 "Standard regular motorWay end" 171 "Standard regular motorWay begin" 168 "triangular_yield" 167 "triangular_wildAnimalCrossing" 166 "triangular_unguardedRailwayCross" 165 "triangular_twoWayTraffic" 164 "triangular_trafficSignals" 163 "triangular_strongCrossWind" 162 "triangular_steepUpgrade" 161 "triangular_steepDowngrade" 160 "triangular_slipperyWhenWet" 159 "triangular_roundabout" 158 "triangular_roughRoad" 157 "triangular_roadWork" 156 "triangular_roadNarrowsRight" 155 "triangular_roadNarrowsLeft" 154 "triangular_roadNarrows" 153 "triangular_riverBank" 152 "triangular_rightMerge" 151 "triangular_priority" 150 "triangular_pedestrainsCrossing" 149 "triangular_pedestrains" 148 "triangular_lowFlyingAircraft" 147 "triangular_looseGravel" 146 "triangular_leftMerge" 145 "triangular_intersection" 144 "triangular_guardedRailwayCross" 143 "triangular_generalDanger" 142 "triangular_fallingRocks" 141 "triangular_drawBrige" 140 "triangular_doubleCurveRight" 139 "triangular_doubleCurveLeft" 138 "triangular_domesticAnimalCross" 137 "triangular_curveRight" 136 "triangular_curveLeft" 135 "triangular_congestionHazard" 134 "triangular_children" 133 "triangular_buses" 132 "triangular_bicycleCrossing" 131 "triangular_bewareOfSnow" 129 "Standard electronic 145" 128 "Standard electronic 135" 127 "Standard electronic 125" 126 "Standard electronic 115" 125 "Standard electrinic 105" 124 "Standard electronic 95 " 123 "Standard electronic 85" 122 "Standard electronic 75" 121 "Standard electronic 65" 120 "Standard electronic 55" 119 "Standard electronic 45" 118 "Standard electronic 35" 117 "Standard electronic 25" 116 "Standard electronic 15" 115 "Standard electronic 5" 114 "Standard regular 145" 113 "Standard regular 135" 112 "Standard regular 125" 111 "Standard regular 115" 110 "Standard regular 105" 109 "Standard regular 95" 108 "Standard regular 85" 107 "Standard regular 75" 106 "Standard regular 65" 105 "Standard regular 55" 104 "Standard regular 45" 103 "Standard regular 35" 102 "Standard regular 25" 101 "Standard regular 15" 100 "Standard regular 5" 70 "Unknown traffic sign" 65 "Standard electronic general end" 64 "Standard regular general end" 50 "Standard electronic end of num" 41 "Standard electronic 140" 40 "Standard electronic 130" 39 "Standard electronic 120" 38 "Standard electronic 110" 37 "Standard electronic 100" 36 "Standard electronic 90" 35 "Standard electronic 80" 34 "Standard electronic 70" 33 "Standard electronic 60" 32 "Standard electronic 50" 31 "Standard electronic 40" 30 "Standard electronic 30" 29 "Standard electronic 20" 28 "Standard electronic 10" 20 "Standard regular end of number" 13 "Standard regular 140" 12 "Standard regular 130 " 11 "Standard regular 120" 10 "Standard regular 110" 9 "Standard regular 100" 8 "Standard regular 90" 7 "Standard regular 80" 6 "Standard regular 70" 5 "Standard regular 60" 4 "Standard regular 50" 3 "Standard regular 40" 2 "Standard regular 30" 1 "Standard regular 20" 0 "Standard regular 10" ;
VAL_ 3221225472 TSR4_No_Entry_Vision_Status 5 "Default" 4 "Reserved" 3 "Alert" 2 "Reject_Vision_Only" 1 "Delay" 0 "Notification" ;
VAL_ 3221225472 TSR3_VO_supplementarySignType 255 "Invalid_supp" 23 "e_ramp" 22 "e_zone" 21 "e_rappel" 20 "Supp_sign_generic" 19 "Night" 18 "Hazerdous_materials" 17 "Fog" 16 "Rain_cloud" 15 "School" 14 "Snow_rain" 13 "Tractor" 12 "Distance_in" 11 "Weight" 10 "Distance_arrow" 9 "Truck" 8 "BendArrow_right" 7 "BendArrow_left" 6 "Arrow_right" 5 "Arrow_left" 4 "Time" 3 "Trailer" 2 "Snow" 1 "Rain" 0 "None" ;
VAL_ 3221225472 TSR3_VO_signType 255 "Invalid sign" 254 "No_sign_detected" 249 "arrow_eitherSide" 248 "arrow_keepRight" 247 "arrow_keepLeft" 246 "arrow_noRight" 245 "arrow_noLeft" 244 "arrow_leftAhead" 243 "arrow_rightAhead" 242 "arrow_left" 241 "arrow_right" 240 "arrow_straight" 237 "trafficLightsRedArrowRight" 236 "trafficLightsRedArrowLeft" 235 "trafficLightsRed" 234 "trafficLightsRedOrange" 233 "trafficLightsOrange" 232 "trafficLightsGreenArrowRight" 231 "trafficLightsGreenArrowLeft" 230 "trafficLightsGreen" 226 "Electronic NoPassingTruckEnd" 225 "Electronic NoPassingTruckStart" 224 "Standard regular Roundabout" 221 "Std electronic no passing end" 220 "Std electronic no passing start" 211 "Standard regular Truck limit" 210 "Standard regular stop sign " 209 "Standard regular stop sign alert" 203 "Std regular No Pass Truck end" 202 "Std regular No Pass Truck Start" 201 "Std regular end of no passing" 200 "Std regular no passiing start " 199 "Standard regular No Entrance" 198 "Std regular No entrance Alert" 179 "Standard regular Tunnel" 178 "Std reg City Entrance Combined" 177 "Standard regular City Entrance" 176 "Std regular Playground end" 175 "Std regular Playground begin" 174 "Standard regular express end" 173 "Standard regular express begin" 172 "Standard regular motorWay end" 171 "Standard regular motorWay begin" 168 "triangular_yield" 167 "triangular_wildAnimalCrossing" 166 "triangular_unguardedRailwayCross" 165 "triangular_twoWayTraffic" 164 "triangular_trafficSignals" 163 "triangular_strongCrossWind" 162 "triangular_steepUpgrade" 161 "triangular_steepDowngrade" 160 "triangular_slipperyWhenWet" 159 "triangular_roundabout" 158 "triangular_roughRoad" 157 "triangular_roadWork" 156 "triangular_roadNarrowsRight" 155 "triangular_roadNarrowsLeft" 154 "triangular_roadNarrows" 153 "triangular_riverBank" 152 "triangular_rightMerge" 151 "triangular_priority" 150 "triangular_pedestrainsCrossing" 149 "triangular_pedestrains" 148 "triangular_lowFlyingAircraft" 147 "triangular_looseGravel" 146 "triangular_leftMerge" 145 "triangular_intersection" 144 "triangular_guardedRailwayCross" 143 "triangular_generalDanger" 142 "triangular_fallingRocks" 141 "triangular_drawBrige" 140 "triangular_doubleCurveRight" 139 "triangular_doubleCurveLeft" 138 "triangular_domesticAnimalCross" 137 "triangular_curveRight" 136 "triangular_curveLeft" 135 "triangular_congestionHazard" 134 "triangular_children" 133 "triangular_buses" 132 "triangular_bicycleCrossing" 131 "triangular_bewareOfSnow" 129 "Standard electronic 145" 128 "Standard electronic 135" 127 "Standard electronic 125" 126 "Standard electronic 115" 125 "Standard electrinic 105" 124 "Standard electronic 95 " 123 "Standard electronic 85" 122 "Standard electronic 75" 121 "Standard electronic 65" 120 "Standard electronic 55" 119 "Standard electronic 45" 118 "Standard electronic 35" 117 "Standard electronic 25" 116 "Standard electronic 15" 115 "Standard electronic 5" 114 "Standard regular 145" 113 "Standard regular 135" 112 "Standard regular 125" 111 "Standard regular 115" 110 "Standard regular 105" 109 "Standard regular 95" 108 "Standard regular 85" 107 "Standard regular 75" 106 "Standard regular 65" 105 "Standard regular 55" 104 "Standard regular 45" 103 "Standard regular 35" 102 "Standard regular 25" 101 "Standard regular 15" 100 "Standard regular 5" 70 "Unknown traffic sign" 65 "Standard electronic general end" 64 "Standard regular general end" 50 "Standard electronic end of num" 41 "Standard electronic 140" 40 "Standard electronic 130" 39 "Standard electronic 120" 38 "Standard electronic 110" 37 "Standard electronic 100" 36 "Standard electronic 90" 35 "Standard electronic 80" 34 "Standard electronic 70" 33 "Standard electronic 60" 32 "Standard electronic 50" 31 "Standard electronic 40" 30 "Standard electronic 30" 29 "Standard electronic 20" 28 "Standard electronic 10" 20 "Standard regular end of number" 13 "Standard regular 140" 12 "Standard regular 130 " 11 "Standard regular 120" 10 "Standard regular 110" 9 "Standard regular 100" 8 "Standard regular 90" 7 "Standard regular 80" 6 "Standard regular 70" 5 "Standard regular 60" 4 "Standard regular 50" 3 "Standard regular 40" 2 "Standard regular 30" 1 "Standard regular 20" 0 "Standard regular 10" ;
VAL_ 3221225472 TSR3_No_Entry_Vision_Status 5 "Default" 4 "Reserved" 3 "Alert" 2 "Reject_Vision_Only" 1 "Delay" 0 "Notification" ;
VAL_ 3221225472 TSR2_VO_supplementarySignType 255 "Invalid_supp" 23 "e_ramp" 22 "e_zone" 21 "e_rappel" 20 "Supp_sign_generic" 19 "Night" 18 "Hazerdous_materials" 17 "Fog" 16 "Rain_cloud" 15 "School" 14 "Snow_rain" 13 "Tractor" 12 "Distance_in" 11 "Weight" 10 "Distance_arrow" 9 "Truck" 8 "BendArrow_right" 7 "BendArrow_left" 6 "Arrow_right" 5 "Arrow_left" 4 "Time" 3 "Trailer" 2 "Snow" 1 "Rain" 0 "None" ;
VAL_ 3221225472 TSR2_VO_signType 255 "Invalid sign" 254 "No_sign_detected" 249 "arrow_eitherSide" 248 "arrow_keepRight" 247 "arrow_keepLeft" 246 "arrow_noRight" 245 "arrow_noLeft" 244 "arrow_leftAhead" 243 "arrow_rightAhead" 242 "arrow_left" 241 "arrow_right" 240 "arrow_straight" 237 "trafficLightsRedArrowRight" 236 "trafficLightsRedArrowLeft" 235 "trafficLightsRed" 234 "trafficLightsRedOrange" 233 "trafficLightsOrange" 232 "trafficLightsGreenArrowRight" 231 "trafficLightsGreenArrowLeft" 230 "trafficLightsGreen" 226 "Electronic NoPassingTruckEnd" 225 "Electronic NoPassingTruckStart" 224 "Standard regular Roundabout" 221 "Std electronic no passing end" 220 "Std electronic no passing start" 211 "Standard regular Truck limit" 210 "Standard regular stop sign " 209 "Standard regular stop sign alert" 203 "Std regular No Pass Truck end" 202 "Std regular No Pass Truck Start" 201 "Std regular end of no passing" 200 "Std regular no passiing start " 199 "Standard regular No Entrance" 198 "Std regular No entrance Alert" 179 "Standard regular Tunnel" 178 "Std reg City Entrance Combined" 177 "Standard regular City Entrance" 176 "Std regular Playground end" 175 "Std regular Playground begin" 174 "Standard regular express end" 173 "Standard regular express begin" 172 "Standard regular motorWay end" 171 "Standard regular motorWay begin" 168 "triangular_yield" 167 "triangular_wildAnimalCrossing" 166 "triangular_unguardedRailwayCross" 165 "triangular_twoWayTraffic" 164 "triangular_trafficSignals" 163 "triangular_strongCrossWind" 162 "triangular_steepUpgrade" 161 "triangular_steepDowngrade" 160 "triangular_slipperyWhenWet" 159 "triangular_roundabout" 158 "triangular_roughRoad" 157 "triangular_roadWork" 156 "triangular_roadNarrowsRight" 155 "triangular_roadNarrowsLeft" 154 "triangular_roadNarrows" 153 "triangular_riverBank" 152 "triangular_rightMerge" 151 "triangular_priority" 150 "triangular_pedestrainsCrossing" 149 "triangular_pedestrains" 148 "triangular_lowFlyingAircraft" 147 "triangular_looseGravel" 146 "triangular_leftMerge" 145 "triangular_intersection" 144 "triangular_guardedRailwayCross" 143 "triangular_generalDanger" 142 "triangular_fallingRocks" 141 "triangular_drawBrige" 140 "triangular_doubleCurveRight" 139 "triangular_doubleCurveLeft" 138 "triangular_domesticAnimalCross" 137 "triangular_curveRight" 136 "triangular_curveLeft" 135 "triangular_congestionHazard" 134 "triangular_children" 133 "triangular_buses" 132 "triangular_bicycleCrossing" 131 "triangular_bewareOfSnow" 129 "Standard electronic 145" 128 "Standard electronic 135" 127 "Standard electronic 125" 126 "Standard electronic 115" 125 "Standard electrinic 105" 124 "Standard electronic 95 " 123 "Standard electronic 85" 122 "Standard electronic 75" 121 "Standard electronic 65" 120 "Standard electronic 55" 119 "Standard electronic 45" 118 "Standard electronic 35" 117 "Standard electronic 25" 116 "Standard electronic 15" 115 "Standard electronic 5" 114 "Standard regular 145" 113 "Standard regular 135" 112 "Standard regular 125" 111 "Standard regular 115" 110 "Standard regular 105" 109 "Standard regular 95" 108 "Standard regular 85" 107 "Standard regular 75" 106 "Standard regular 65" 105 "Standard regular 55" 104 "Standard regular 45" 103 "Standard regular 35" 102 "Standard regular 25" 101 "Standard regular 15" 100 "Standard regular 5" 70 "Unknown traffic sign" 65 "Standard electronic general end" 64 "Standard regular general end" 50 "Standard electronic end of num" 41 "Standard electronic 140" 40 "Standard electronic 130" 39 "Standard electronic 120" 38 "Standard electronic 110" 37 "Standard electronic 100" 36 "Standard electronic 90" 35 "Standard electronic 80" 34 "Standard electronic 70" 33 "Standard electronic 60" 32 "Standard electronic 50" 31 "Standard electronic 40" 30 "Standard electronic 30" 29 "Standard electronic 20" 28 "Standard electronic 10" 20 "Standard regular end of number" 13 "Standard regular 140" 12 "Standard regular 130 " 11 "Standard regular 120" 10 "Standard regular 110" 9 "Standard regular 100" 8 "Standard regular 90" 7 "Standard regular 80" 6 "Standard regular 70" 5 "Standard regular 60" 4 "Standard regular 50" 3 "Standard regular 40" 2 "Standard regular 30" 1 "Standard regular 20" 0 "Standard regular 10" ;
VAL_ 3221225472 TSR2_No_Entry_Vision_Status 5 "Default" 4 "Reserved" 3 "Alert" 2 "Reject_Vision_Only" 1 "Delay" 0 "Notification" ;
VAL_ 3221225472 TSR1_VO_supplementarySignType 255 "Invalid_supp" 23 "e_ramp" 22 "e_zone" 21 "e_rappel" 20 "Supp_sign_generic" 19 "Night" 18 "Hazerdous_materials" 17 "Fog" 16 "Rain_cloud" 15 "School" 14 "Snow_rain" 13 "Tractor" 12 "Distance_in" 11 "Weight" 10 "Distance_arrow" 9 "Truck" 8 "BendArrow_right" 7 "BendArrow_left" 6 "Arrow_right" 5 "Arrow_left" 4 "Time" 3 "Trailer" 2 "Snow" 1 "Rain" 0 "None" ;
VAL_ 3221225472 TSR1_VO_signType 255 "Invalid sign" 254 "No_sign_detected" 249 "arrow_eitherSide" 248 "arrow_keepRight" 247 "arrow_keepLeft" 246 "arrow_noRight" 245 "arrow_noLeft" 244 "arrow_leftAhead" 243 "arrow_rightAhead" 242 "arrow_left" 241 "arrow_right" 240 "arrow_straight" 237 "trafficLightsRedArrowRight" 236 "trafficLightsRedArrowLeft" 235 "trafficLightsRed" 234 "trafficLightsRedOrange" 233 "trafficLightsOrange" 232 "trafficLightsGreenArrowRight" 231 "trafficLightsGreenArrowLeft" 230 "trafficLightsGreen" 226 "Electronic NoPassingTruckEnd" 225 "Electronic NoPassingTruckStart" 224 "Standard regular Roundabout" 221 "Std electronic no passing end" 220 "Std electronic no passing start" 211 "Standard regular Truck limit" 210 "Standard regular stop sign " 209 "Standard regular stop sign alert" 203 "Std regular No Pass Truck end" 202 "Std regular No Pass Truck Start" 201 "Std regular end of no passing" 200 "Std regular no passiing start " 199 "Standard regular No Entrance" 198 "Std regular No entrance Alert" 179 "Standard regular Tunnel" 178 "Std reg City Entrance Combined" 177 "Standard regular City Entrance" 176 "Std regular Playground end" 175 "Std regular Playground begin" 174 "Standard regular express end" 173 "Standard regular express begin" 172 "Standard regular motorWay end" 171 "Standard regular motorWay begin" 168 "triangular_yield" 167 "triangular_wildAnimalCrossing" 166 "triangular_unguardedRailwayCross" 165 "triangular_twoWayTraffic" 164 "triangular_trafficSignals" 163 "triangular_strongCrossWind" 162 "triangular_steepUpgrade" 161 "triangular_steepDowngrade" 160 "triangular_slipperyWhenWet" 159 "triangular_roundabout" 158 "triangular_roughRoad" 157 "triangular_roadWork" 156 "triangular_roadNarrowsRight" 155 "triangular_roadNarrowsLeft" 154 "triangular_roadNarrows" 153 "triangular_riverBank" 152 "triangular_rightMerge" 151 "triangular_priority" 150 "triangular_pedestrainsCrossing" 149 "triangular_pedestrains" 148 "triangular_lowFlyingAircraft" 147 "triangular_looseGravel" 146 "triangular_leftMerge" 145 "triangular_intersection" 144 "triangular_guardedRailwayCross" 143 "triangular_generalDanger" 142 "triangular_fallingRocks" 141 "triangular_drawBrige" 140 "triangular_doubleCurveRight" 139 "triangular_doubleCurveLeft" 138 "triangular_domesticAnimalCross" 137 "triangular_curveRight" 136 "triangular_curveLeft" 135 "triangular_congestionHazard" 134 "triangular_children" 133 "triangular_buses" 132 "triangular_bicycleCrossing" 131 "triangular_bewareOfSnow" 129 "Standard electronic 145" 128 "Standard electronic 135" 127 "Standard electronic 125" 126 "Standard electronic 115" 125 "Standard electrinic 105" 124 "Standard electronic 95 " 123 "Standard electronic 85" 122 "Standard electronic 75" 121 "Standard electronic 65" 120 "Standard electronic 55" 119 "Standard electronic 45" 118 "Standard electronic 35" 117 "Standard electronic 25" 116 "Standard electronic 15" 115 "Standard electronic 5" 114 "Standard regular 145" 113 "Standard regular 135" 112 "Standard regular 125" 111 "Standard regular 115" 110 "Standard regular 105" 109 "Standard regular 95" 108 "Standard regular 85" 107 "Standard regular 75" 106 "Standard regular 65" 105 "Standard regular 55" 104 "Standard regular 45" 103 "Standard regular 35" 102 "Standard regular 25" 101 "Standard regular 15" 100 "Standard regular 5" 70 "Unknown traffic sign" 65 "Standard electronic general end" 64 "Standard regular general end" 50 "Standard electronic end of num" 41 "Standard electronic 140" 40 "Standard electronic 130" 39 "Standard electronic 120" 38 "Standard electronic 110" 37 "Standard electronic 100" 36 "Standard electronic 90" 35 "Standard electronic 80" 34 "Standard electronic 70" 33 "Standard electronic 60" 32 "Standard electronic 50" 31 "Standard electronic 40" 30 "Standard electronic 30" 29 "Standard electronic 20" 28 "Standard electronic 10" 20 "Standard regular end of number" 13 "Standard regular 140" 12 "Standard regular 130 " 11 "Standard regular 120" 10 "Standard regular 110" 9 "Standard regular 100" 8 "Standard regular 90" 7 "Standard regular 80" 6 "Standard regular 70" 5 "Standard regular 60" 4 "Standard regular 50" 3 "Standard regular 40" 2 "Standard regular 30" 1 "Standard regular 20" 0 "Standard regular 10" ;
VAL_ 3221225472 TSR1_No_Entry_Vision_Status 5 "Default" 4 "Reserved" 3 "Alert" 2 "Reject_Vision_Only" 1 "Delay" 0 "Notification" ;
VAL_ 3221225472 TSR0_VO_supplementarySignType 255 "Invalid_supp" 23 "e_ramp" 22 "e_zone" 21 "e_rappel" 20 "Supp_sign_generic" 19 "Night" 18 "Hazerdous_materials" 17 "Fog" 16 "Rain_cloud" 15 "School" 14 "Snow_rain" 13 "Tractor" 12 "Distance_in" 11 "Weight" 10 "Distance_arrow" 9 "Truck" 8 "BendArrow_right" 7 "BendArrow_left" 6 "Arrow_right" 5 "Arrow_left" 4 "Time" 3 "Trailer" 2 "Snow" 1 "Rain" 0 "None" ;
VAL_ 3221225472 TSR0_VO_signType 255 "Invalid sign" 254 "No_sign_detected" 249 "arrow_eitherSide" 248 "arrow_keepRight" 247 "arrow_keepLeft" 246 "arrow_noRight" 245 "arrow_noLeft" 244 "arrow_leftAhead" 243 "arrow_rightAhead" 242 "arrow_left" 241 "arrow_right" 240 "arrow_straight" 237 "trafficLightsRedArrowRight" 236 "trafficLightsRedArrowLeft" 235 "trafficLightsRed" 234 "trafficLightsRedOrange" 233 "trafficLightsOrange" 232 "trafficLightsGreenArrowRight" 231 "trafficLightsGreenArrowLeft" 230 "trafficLightsGreen" 226 "Electronic NoPassingTruckEnd" 225 "Electronic NoPassingTruckStart" 224 "Standard regular Roundabout" 221 "Std electronic no passing end" 220 "Std electronic no passing start" 211 "Standard regular Truck limit" 210 "Standard regular stop sign " 209 "Standard regular stop sign alert" 203 "Std regular No Pass Truck end" 202 "Std regular No Pass Truck Start" 201 "Std regular end of no passing" 200 "Std regular no passiing start " 199 "Standard regular No Entrance" 198 "Std regular No entrance Alert" 179 "Standard regular Tunnel" 178 "Std reg City Entrance Combined" 177 "Standard regular City Entrance" 176 "Std regular Playground end" 175 "Std regular Playground begin" 174 "Standard regular express end" 173 "Standard regular express begin" 172 "Standard regular motorWay end" 171 "Standard regular motorWay begin" 168 "triangular_yield" 167 "triangular_wildAnimalCrossing" 166 "triangular_unguardedRailwayCross" 165 "triangular_twoWayTraffic" 164 "triangular_trafficSignals" 163 "triangular_strongCrossWind" 162 "triangular_steepUpgrade" 161 "triangular_steepDowngrade" 160 "triangular_slipperyWhenWet" 159 "triangular_roundabout" 158 "triangular_roughRoad" 157 "triangular_roadWork" 156 "triangular_roadNarrowsRight" 155 "triangular_roadNarrowsLeft" 154 "triangular_roadNarrows" 153 "triangular_riverBank" 152 "triangular_rightMerge" 151 "triangular_priority" 150 "triangular_pedestrainsCrossing" 149 "triangular_pedestrains" 148 "triangular_lowFlyingAircraft" 147 "triangular_looseGravel" 146 "triangular_leftMerge" 145 "triangular_intersection" 144 "triangular_guardedRailwayCross" 143 "triangular_generalDanger" 142 "triangular_fallingRocks" 141 "triangular_drawBrige" 140 "triangular_doubleCurveRight" 139 "triangular_doubleCurveLeft" 138 "triangular_domesticAnimalCross" 137 "triangular_curveRight" 136 "triangular_curveLeft" 135 "triangular_congestionHazard" 134 "triangular_children" 133 "triangular_buses" 132 "triangular_bicycleCrossing" 131 "triangular_bewareOfSnow" 129 "Standard electronic 145" 128 "Standard electronic 135" 127 "Standard electronic 125" 126 "Standard electronic 115" 125 "Standard electrinic 105" 124 "Standard electronic 95 " 123 "Standard electronic 85" 122 "Standard electronic 75" 121 "Standard electronic 65" 120 "Standard electronic 55" 119 "Standard electronic 45" 118 "Standard electronic 35" 117 "Standard electronic 25" 116 "Standard electronic 15" 115 "Standard electronic 5" 114 "Standard regular 145" 113 "Standard regular 135" 112 "Standard regular 125" 111 "Standard regular 115" 110 "Standard regular 105" 109 "Standard regular 95" 108 "Standard regular 85" 107 "Standard regular 75" 106 "Standard regular 65" 105 "Standard regular 55" 104 "Standard regular 45" 103 "Standard regular 35" 102 "Standard regular 25" 101 "Standard regular 15" 100 "Standard regular 5" 70 "Unknown traffic sign" 65 "Standard electronic general end" 64 "Standard regular general end" 50 "Standard electronic end of num" 41 "Standard electronic 140" 40 "Standard electronic 130" 39 "Standard electronic 120" 38 "Standard electronic 110" 37 "Standard electronic 100" 36 "Standard electronic 90" 35 "Standard electronic 80" 34 "Standard electronic 70" 33 "Standard electronic 60" 32 "Standard electronic 50" 31 "Standard electronic 40" 30 "Standard electronic 30" 29 "Standard electronic 20" 28 "Standard electronic 10" 20 "Standard regular end of number" 13 "Standard regular 140" 12 "Standard regular 130 " 11 "Standard regular 120" 10 "Standard regular 110" 9 "Standard regular 100" 8 "Standard regular 90" 7 "Standard regular 80" 6 "Standard regular 70" 5 "Standard regular 60" 4 "Standard regular 50" 3 "Standard regular 40" 2 "Standard regular 30" 1 "Standard regular 20" 0 "Standard regular 10" ;
VAL_ 3221225472 TSR0_No_Entry_Vision_Status 5 "Default" 4 "Reserved" 3 "Alert" 2 "Reject_Vision_Only" 1 "Delay" 0 "Notification" ;
VAL_ 3221225472 Boot_Test_Results 10 "Reserved" 9 "Flash CRC of FFS" 8 "Flash CRC of Application" 7 "DDR Test" 6 "DDR Temperature" 5 "DDR init finished" 4 "Flash CRC of Boot" 3 "Parity Check" 2 "PLL init finished" 1 "BIST" 0 "EyeQ Over Temperature" ;
VAL_ 3221225472 Boot_LPDDR2_Temperature_Status 3 " SDRAM high temperature" 2 "is greater than 85deg" 1 "is less than 85deg" 0 "SDRAM low temperature" ;
VAL_ 3221225472 TSM3_VO_supplementarySignType 255 "Invalid_supp" 23 "e_ramp" 22 "e_zone" 21 "e_rappel" 20 "Supp_sign_generic" 19 "Night" 18 "Hazerdous_materials" 17 "Fog" 16 "Rain_cloud" 15 "School" 14 "Snow_rain" 13 "Tractor" 12 "Distance_in" 11 "Weight" 10 "Distance_arrow" 9 "Truck" 8 "BendArrow_right" 7 "BendArrow_left" 6 "Arrow_right" 5 "Arrow_left" 4 "Time" 3 "Trailer" 2 "Snow" 1 "Rain" 0 "None" ;
VAL_ 3221225472 TSM3_VO_signType 255 "Invalid sign" 254 "No_sign_detected" 249 "arrow_eitherSide" 248 "arrow_keepRight" 247 "arrow_keepLeft" 246 "arrow_noRight" 245 "arrow_noLeft" 244 "arrow_leftAhead" 243 "arrow_rightAhead" 242 "arrow_left" 241 "arrow_right" 240 "arrow_straight" 237 "trafficLightsRedArrowRight" 236 "trafficLightsRedArrowLeft" 235 "trafficLightsRed" 234 "trafficLightsRedOrange" 233 "trafficLightsOrange" 232 "trafficLightsGreenArrowRight" 231 "trafficLightsGreenArrowLeft" 230 "trafficLightsGreen" 226 "Electronic NoPassingTruckEnd" 225 "Electronic NoPassingTruckStart" 224 "Standard regular Roundabout" 221 "Std electronic no passing end" 220 "Std electronic no passing start" 211 "Standard regular Truck limit" 210 "Standard regular stop sign " 209 "Standard regular stop sign alert" 203 "Std regular No Pass Truck end" 202 "Std regular No Pass Truck Start" 201 "Std regular end of no passing" 200 "Std regular no passiing start " 199 "Standard regular No Entrance" 198 "Std regular No entrance Alert" 179 "Standard regular Tunnel" 178 "Std reg City Entrance Combined" 177 "Standard regular City Entrance" 176 "Std regular Playground end" 175 "Std regular Playground begin" 174 "Standard regular express end" 173 "Standard regular express begin" 172 "Standard regular motorWay end" 171 "Standard regular motorWay begin" 168 "triangular_yield" 167 "triangular_wildAnimalCrossing" 166 "triangular_unguardedRailwayCross" 165 "triangular_twoWayTraffic" 164 "triangular_trafficSignals" 163 "triangular_strongCrossWind" 162 "triangular_steepUpgrade" 161 "triangular_steepDowngrade" 160 "triangular_slipperyWhenWet" 159 "triangular_roundabout" 158 "triangular_roughRoad" 157 "triangular_roadWork" 156 "triangular_roadNarrowsRight" 155 "triangular_roadNarrowsLeft" 154 "triangular_roadNarrows" 153 "triangular_riverBank" 152 "triangular_rightMerge" 151 "triangular_priority" 150 "triangular_pedestrainsCrossing" 149 "triangular_pedestrains" 148 "triangular_lowFlyingAircraft" 147 "triangular_looseGravel" 146 "triangular_leftMerge" 145 "triangular_intersection" 144 "triangular_guardedRailwayCross" 143 "triangular_generalDanger" 142 "triangular_fallingRocks" 141 "triangular_drawBrige" 140 "triangular_doubleCurveRight" 139 "triangular_doubleCurveLeft" 138 "triangular_domesticAnimalCross" 137 "triangular_curveRight" 136 "triangular_curveLeft" 135 "triangular_congestionHazard" 134 "triangular_children" 133 "triangular_buses" 132 "triangular_bicycleCrossing" 131 "triangular_bewareOfSnow" 129 "Standard electronic 145" 128 "Standard electronic 135" 127 "Standard electronic 125" 126 "Standard electronic 115" 125 "Standard electrinic 105" 124 "Standard electronic 95 " 123 "Standard electronic 85" 122 "Standard electronic 75" 121 "Standard electronic 65" 120 "Standard electronic 55" 119 "Standard electronic 45" 118 "Standard electronic 35" 117 "Standard electronic 25" 116 "Standard electronic 15" 115 "Standard electronic 5" 114 "Standard regular 145" 113 "Standard regular 135" 112 "Standard regular 125" 111 "Standard regular 115" 110 "Standard regular 105" 109 "Standard regular 95" 108 "Standard regular 85" 107 "Standard regular 75" 106 "Standard regular 65" 105 "Standard regular 55" 104 "Standard regular 45" 103 "Standard regular 35" 102 "Standard regular 25" 101 "Standard regular 15" 100 "Standard regular 5" 70 "Unknown traffic sign" 65 "Standard electronic general end" 64 "Standard regular general end" 50 "Standard electronic end of num" 41 "Standard electronic 140" 40 "Standard electronic 130" 39 "Standard electronic 120" 38 "Standard electronic 110" 37 "Standard electronic 100" 36 "Standard electronic 90" 35 "Standard electronic 80" 34 "Standard electronic 70" 33 "Standard electronic 60" 32 "Standard electronic 50" 31 "Standard electronic 40" 30 "Standard electronic 30" 29 "Standard electronic 20" 28 "Standard electronic 10" 20 "Standard regular end of number" 13 "Standard regular 140" 12 "Standard regular 130 " 11 "Standard regular 120" 10 "Standard regular 110" 9 "Standard regular 100" 8 "Standard regular 90" 7 "Standard regular 80" 6 "Standard regular 70" 5 "Standard regular 60" 4 "Standard regular 50" 3 "Standard regular 40" 2 "Standard regular 30" 1 "Standard regular 20" 0 "Standard regular 10" ;
VAL_ 3221225472 TSM2_VO_supplementarySignType 255 "Invalid_supp" 23 "e_ramp" 22 "e_zone" 21 "e_rappel" 20 "Supp_sign_generic" 19 "Night" 18 "Hazerdous_materials" 17 "Fog" 16 "Rain_cloud" 15 "School" 14 "Snow_rain" 13 "Tractor" 12 "Distance_in" 11 "Weight" 10 "Distance_arrow" 9 "Truck" 8 "BendArrow_right" 7 "BendArrow_left" 6 "Arrow_right" 5 "Arrow_left" 4 "Time" 3 "Trailer" 2 "Snow" 1 "Rain" 0 "None" ;
VAL_ 3221225472 TSM2_VO_signType 255 "Invalid sign" 254 "No_sign_detected" 249 "arrow_eitherSide" 248 "arrow_keepRight" 247 "arrow_keepLeft" 246 "arrow_noRight" 245 "arrow_noLeft" 244 "arrow_leftAhead" 243 "arrow_rightAhead" 242 "arrow_left" 241 "arrow_right" 240 "arrow_straight" 237 "trafficLightsRedArrowRight" 236 "trafficLightsRedArrowLeft" 235 "trafficLightsRed" 234 "trafficLightsRedOrange" 233 "trafficLightsOrange" 232 "trafficLightsGreenArrowRight" 231 "trafficLightsGreenArrowLeft" 230 "trafficLightsGreen" 226 "Electronic NoPassingTruckEnd" 225 "Electronic NoPassingTruckStart" 224 "Standard regular Roundabout" 221 "Std electronic no passing end" 220 "Std electronic no passing start" 211 "Standard regular Truck limit" 210 "Standard regular stop sign " 209 "Standard regular stop sign alert" 203 "Std regular No Pass Truck end" 202 "Std regular No Pass Truck Start" 201 "Std regular end of no passing" 200 "Std regular no passiing start " 199 "Standard regular No Entrance" 198 "Std regular No entrance Alert" 179 "Standard regular Tunnel" 178 "Std reg City Entrance Combined" 177 "Standard regular City Entrance" 176 "Std regular Playground end" 175 "Std regular Playground begin" 174 "Standard regular express end" 173 "Standard regular express begin" 172 "Standard regular motorWay end" 171 "Standard regular motorWay begin" 168 "triangular_yield" 167 "triangular_wildAnimalCrossing" 166 "triangular_unguardedRailwayCross" 165 "triangular_twoWayTraffic" 164 "triangular_trafficSignals" 163 "triangular_strongCrossWind" 162 "triangular_steepUpgrade" 161 "triangular_steepDowngrade" 160 "triangular_slipperyWhenWet" 159 "triangular_roundabout" 158 "triangular_roughRoad" 157 "triangular_roadWork" 156 "triangular_roadNarrowsRight" 155 "triangular_roadNarrowsLeft" 154 "triangular_roadNarrows" 153 "triangular_riverBank" 152 "triangular_rightMerge" 151 "triangular_priority" 150 "triangular_pedestrainsCrossing" 149 "triangular_pedestrains" 148 "triangular_lowFlyingAircraft" 147 "triangular_looseGravel" 146 "triangular_leftMerge" 145 "triangular_intersection" 144 "triangular_guardedRailwayCross" 143 "triangular_generalDanger" 142 "triangular_fallingRocks" 141 "triangular_drawBrige" 140 "triangular_doubleCurveRight" 139 "triangular_doubleCurveLeft" 138 "triangular_domesticAnimalCross" 137 "triangular_curveRight" 136 "triangular_curveLeft" 135 "triangular_congestionHazard" 134 "triangular_children" 133 "triangular_buses" 132 "triangular_bicycleCrossing" 131 "triangular_bewareOfSnow" 129 "Standard electronic 145" 128 "Standard electronic 135" 127 "Standard electronic 125" 126 "Standard electronic 115" 125 "Standard electrinic 105" 124 "Standard electronic 95 " 123 "Standard electronic 85" 122 "Standard electronic 75" 121 "Standard electronic 65" 120 "Standard electronic 55" 119 "Standard electronic 45" 118 "Standard electronic 35" 117 "Standard electronic 25" 116 "Standard electronic 15" 115 "Standard electronic 5" 114 "Standard regular 145" 113 "Standard regular 135" 112 "Standard regular 125" 111 "Standard regular 115" 110 "Standard regular 105" 109 "Standard regular 95" 108 "Standard regular 85" 107 "Standard regular 75" 106 "Standard regular 65" 105 "Standard regular 55" 104 "Standard regular 45" 103 "Standard regular 35" 102 "Standard regular 25" 101 "Standard regular 15" 100 "Standard regular 5" 70 "Unknown traffic sign" 65 "Standard electronic general end" 64 "Standard regular general end" 50 "Standard electronic end of num" 41 "Standard electronic 140" 40 "Standard electronic 130" 39 "Standard electronic 120" 38 "Standard electronic 110" 37 "Standard electronic 100" 36 "Standard electronic 90" 35 "Standard electronic 80" 34 "Standard electronic 70" 33 "Standard electronic 60" 32 "Standard electronic 50" 31 "Standard electronic 40" 30 "Standard electronic 30" 29 "Standard electronic 20" 28 "Standard electronic 10" 20 "Standard regular end of number" 13 "Standard regular 140" 12 "Standard regular 130 " 11 "Standard regular 120" 10 "Standard regular 110" 9 "Standard regular 100" 8 "Standard regular 90" 7 "Standard regular 80" 6 "Standard regular 70" 5 "Standard regular 60" 4 "Standard regular 50" 3 "Standard regular 40" 2 "Standard regular 30" 1 "Standard regular 20" 0 "Standard regular 10" ;
VAL_ 3221225472 TSM1_VO_supplementarySignType 255 "Invalid_supp" 23 "e_ramp" 22 "e_zone" 21 "e_rappel" 20 "Supp_sign_generic" 19 "Night" 18 "Hazerdous_materials" 17 "Fog" 16 "Rain_cloud" 15 "School" 14 "Snow_rain" 13 "Tractor" 12 "Distance_in" 11 "Weight" 10 "Distance_arrow" 9 "Truck" 8 "BendArrow_right" 7 "BendArrow_left" 6 "Arrow_right" 5 "Arrow_left" 4 "Time" 3 "Trailer" 2 "Snow" 1 "Rain" 0 "None" ;
VAL_ 3221225472 TSM1_VO_signType 255 "Invalid sign" 254 "No_sign_detected" 249 "arrow_eitherSide" 248 "arrow_keepRight" 247 "arrow_keepLeft" 246 "arrow_noRight" 245 "arrow_noLeft" 244 "arrow_leftAhead" 243 "arrow_rightAhead" 242 "arrow_left" 241 "arrow_right" 240 "arrow_straight" 237 "trafficLightsRedArrowRight" 236 "trafficLightsRedArrowLeft" 235 "trafficLightsRed" 234 "trafficLightsRedOrange" 233 "trafficLightsOrange" 232 "trafficLightsGreenArrowRight" 231 "trafficLightsGreenArrowLeft" 230 "trafficLightsGreen" 226 "Electronic NoPassingTruckEnd" 225 "Electronic NoPassingTruckStart" 224 "Standard regular Roundabout" 221 "Std electronic no passing end" 220 "Std electronic no passing start" 211 "Standard regular Truck limit" 210 "Standard regular stop sign " 209 "Standard regular stop sign alert" 203 "Std regular No Pass Truck end" 202 "Std regular No Pass Truck Start" 201 "Std regular end of no passing" 200 "Std regular no passiing start " 199 "Standard regular No Entrance" 198 "Std regular No entrance Alert" 179 "Standard regular Tunnel" 178 "Std reg City Entrance Combined" 177 "Standard regular City Entrance" 176 "Std regular Playground end" 175 "Std regular Playground begin" 174 "Standard regular express end" 173 "Standard regular express begin" 172 "Standard regular motorWay end" 171 "Standard regular motorWay begin" 168 "triangular_yield" 167 "triangular_wildAnimalCrossing" 166 "triangular_unguardedRailwayCross" 165 "triangular_twoWayTraffic" 164 "triangular_trafficSignals" 163 "triangular_strongCrossWind" 162 "triangular_steepUpgrade" 161 "triangular_steepDowngrade" 160 "triangular_slipperyWhenWet" 159 "triangular_roundabout" 158 "triangular_roughRoad" 157 "triangular_roadWork" 156 "triangular_roadNarrowsRight" 155 "triangular_roadNarrowsLeft" 154 "triangular_roadNarrows" 153 "triangular_riverBank" 152 "triangular_rightMerge" 151 "triangular_priority" 150 "triangular_pedestrainsCrossing" 149 "triangular_pedestrains" 148 "triangular_lowFlyingAircraft" 147 "triangular_looseGravel" 146 "triangular_leftMerge" 145 "triangular_intersection" 144 "triangular_guardedRailwayCross" 143 "triangular_generalDanger" 142 "triangular_fallingRocks" 141 "triangular_drawBrige" 140 "triangular_doubleCurveRight" 139 "triangular_doubleCurveLeft" 138 "triangular_domesticAnimalCross" 137 "triangular_curveRight" 136 "triangular_curveLeft" 135 "triangular_congestionHazard" 134 "triangular_children" 133 "triangular_buses" 132 "triangular_bicycleCrossing" 131 "triangular_bewareOfSnow" 129 "Standard electronic 145" 128 "Standard electronic 135" 127 "Standard electronic 125" 126 "Standard electronic 115" 125 "Standard electrinic 105" 124 "Standard electronic 95 " 123 "Standard electronic 85" 122 "Standard electronic 75" 121 "Standard electronic 65" 120 "Standard electronic 55" 119 "Standard electronic 45" 118 "Standard electronic 35" 117 "Standard electronic 25" 116 "Standard electronic 15" 115 "Standard electronic 5" 114 "Standard regular 145" 113 "Standard regular 135" 112 "Standard regular 125" 111 "Standard regular 115" 110 "Standard regular 105" 109 "Standard regular 95" 108 "Standard regular 85" 107 "Standard regular 75" 106 "Standard regular 65" 105 "Standard regular 55" 104 "Standard regular 45" 103 "Standard regular 35" 102 "Standard regular 25" 101 "Standard regular 15" 100 "Standard regular 5" 70 "Unknown traffic sign" 65 "Standard electronic general end" 64 "Standard regular general end" 50 "Standard electronic end of num" 41 "Standard electronic 140" 40 "Standard electronic 130" 39 "Standard electronic 120" 38 "Standard electronic 110" 37 "Standard electronic 100" 36 "Standard electronic 90" 35 "Standard electronic 80" 34 "Standard electronic 70" 33 "Standard electronic 60" 32 "Standard electronic 50" 31 "Standard electronic 40" 30 "Standard electronic 30" 29 "Standard electronic 20" 28 "Standard electronic 10" 20 "Standard regular end of number" 13 "Standard regular 140" 12 "Standard regular 130 " 11 "Standard regular 120" 10 "Standard regular 110" 9 "Standard regular 100" 8 "Standard regular 90" 7 "Standard regular 80" 6 "Standard regular 70" 5 "Standard regular 60" 4 "Standard regular 50" 3 "Standard regular 40" 2 "Standard regular 30" 1 "Standard regular 20" 0 "Standard regular 10" ;
VAL_ 3221225472 TSM0_VO_supplementarySignType 255 "Invalid_supp" 23 "e_ramp" 22 "e_zone" 21 "e_rappel" 20 "Supp_sign_generic" 19 "Night" 18 "Hazerdous_materials" 17 "Fog" 16 "Rain_cloud" 15 "School" 14 "Snow_rain" 13 "Tractor" 12 "Distance_in" 11 "Weight" 10 "Distance_arrow" 9 "Truck" 8 "BendArrow_right" 7 "BendArrow_left" 6 "Arrow_right" 5 "Arrow_left" 4 "Time" 3 "Trailer" 2 "Snow" 1 "Rain" 0 "None" ;
VAL_ 3221225472 TSM0_VO_signType 255 "Invalid sign" 254 "No_sign_detected" 249 "arrow_eitherSide" 248 "arrow_keepRight" 247 "arrow_keepLeft" 246 "arrow_noRight" 245 "arrow_noLeft" 244 "arrow_leftAhead" 243 "arrow_rightAhead" 242 "arrow_left" 241 "arrow_right" 240 "arrow_straight" 237 "trafficLightsRedArrowRight" 236 "trafficLightsRedArrowLeft" 235 "trafficLightsRed" 234 "trafficLightsRedOrange" 233 "trafficLightsOrange" 232 "trafficLightsGreenArrowRight" 231 "trafficLightsGreenArrowLeft" 230 "trafficLightsGreen" 226 "Electronic NoPassingTruckEnd" 225 "Electronic NoPassingTruckStart" 224 "Standard regular Roundabout" 221 "Std electronic no passing end" 220 "Std electronic no passing start" 211 "Standard regular Truck limit" 210 "Standard regular stop sign " 209 "Standard regular stop sign alert" 203 "Std regular No Pass Truck end" 202 "Std regular No Pass Truck Start" 201 "Std regular end of no passing" 200 "Std regular no passiing start " 199 "Standard regular No Entrance" 198 "Std regular No entrance Alert" 179 "Standard regular Tunnel" 178 "Std reg City Entrance Combined" 177 "Standard regular City Entrance" 176 "Std regular Playground end" 175 "Std regular Playground begin" 174 "Standard regular express end" 173 "Standard regular express begin" 172 "Standard regular motorWay end" 171 "Standard regular motorWay begin" 168 "triangular_yield" 167 "triangular_wildAnimalCrossing" 166 "triangular_unguardedRailwayCross" 165 "triangular_twoWayTraffic" 164 "triangular_trafficSignals" 163 "triangular_strongCrossWind" 162 "triangular_steepUpgrade" 161 "triangular_steepDowngrade" 160 "triangular_slipperyWhenWet" 159 "triangular_roundabout" 158 "triangular_roughRoad" 157 "triangular_roadWork" 156 "triangular_roadNarrowsRight" 155 "triangular_roadNarrowsLeft" 154 "triangular_roadNarrows" 153 "triangular_riverBank" 152 "triangular_rightMerge" 151 "triangular_priority" 150 "triangular_pedestrainsCrossing" 149 "triangular_pedestrains" 148 "triangular_lowFlyingAircraft" 147 "triangular_looseGravel" 146 "triangular_leftMerge" 145 "triangular_intersection" 144 "triangular_guardedRailwayCross" 143 "triangular_generalDanger" 142 "triangular_fallingRocks" 141 "triangular_drawBrige" 140 "triangular_doubleCurveRight" 139 "triangular_doubleCurveLeft" 138 "triangular_domesticAnimalCross" 137 "triangular_curveRight" 136 "triangular_curveLeft" 135 "triangular_congestionHazard" 134 "triangular_children" 133 "triangular_buses" 132 "triangular_bicycleCrossing" 131 "triangular_bewareOfSnow" 129 "Standard electronic 145" 128 "Standard electronic 135" 127 "Standard electronic 125" 126 "Standard electronic 115" 125 "Standard electrinic 105" 124 "Standard electronic 95 " 123 "Standard electronic 85" 122 "Standard electronic 75" 121 "Standard electronic 65" 120 "Standard electronic 55" 119 "Standard electronic 45" 118 "Standard electronic 35" 117 "Standard electronic 25" 116 "Standard electronic 15" 115 "Standard electronic 5" 114 "Standard regular 145" 113 "Standard regular 135" 112 "Standard regular 125" 111 "Standard regular 115" 110 "Standard regular 105" 109 "Standard regular 95" 108 "Standard regular 85" 107 "Standard regular 75" 106 "Standard regular 65" 105 "Standard regular 55" 104 "Standard regular 45" 103 "Standard regular 35" 102 "Standard regular 25" 101 "Standard regular 15" 100 "Standard regular 5" 70 "Unknown traffic sign" 65 "Standard electronic general end" 64 "Standard regular general end" 50 "Standard electronic end of num" 41 "Standard electronic 140" 40 "Standard electronic 130" 39 "Standard electronic 120" 38 "Standard electronic 110" 37 "Standard electronic 100" 36 "Standard electronic 90" 35 "Standard electronic 80" 34 "Standard electronic 70" 33 "Standard electronic 60" 32 "Standard electronic 50" 31 "Standard electronic 40" 30 "Standard electronic 30" 29 "Standard electronic 20" 28 "Standard electronic 10" 20 "Standard regular end of number" 13 "Standard regular 140" 12 "Standard regular 130 " 11 "Standard regular 120" 10 "Standard regular 110" 9 "Standard regular 100" 8 "Standard regular 90" 7 "Standard regular 80" 6 "Standard regular 70" 5 "Standard regular 60" 4 "Standard regular 50" 3 "Standard regular 40" 2 "Standard regular 30" 1 "Standard regular 20" 0 "Standard regular 10" ;
VAL_ 3221225472 CS_PCW_Sensitivity_Valid 1 "valid" 0 "invalid" ;
VAL_ 3221225472 CS_LDW_Sensitivity_Valid 1 "valid" 0 "invalid" ;
VAL_ 3221225472 CS_FCW_Sensitivity_Valid 1 "valid" 0 "invalid" ;
VAL_ 3221225472 CS_PCW_Sensitivity 2 "far" 1 "medium" 0 "near" ;
VAL_ 3221225472 CS_FCW_Sensitivity 2 "far" 1 "medium" 0 "near" ;
VAL_ 3221225472 CS_LDW_Sensitivity 2 "early" 1 "middle" 0 "late" ;
VAL_ 3221225472 CS_BrkPosInitTravelAchVald 1 "1=valid" 0 "0=invalid" ;
VAL_ 3221225472 CS_BrakePosInitTravelAch 1 "0x1 = on" 0 "0x0 = Off" ;
VAL_ 3221225472 CS_BrakePosModTravelAch 1 "0x1 = true" 0 "0x0 = false" ;
VAL_ 3221225472 CS_ReverseIndicatorValid 1 "1=valid" 0 "0=invalid" ;
VAL_ 3221225472 CS_AcceleratorPedalValid 1 "1=valid" 0 "0=invalid" ;
VAL_ 3221225472 FS_spotHalos_bool 1 "true" 0 "false" ;
VAL_ 3221225472 currentCalibrationIsOK_yaw 1 "True: Yaw is trustable " 0 "false Yaw isnot trustable" ;
VAL_ 3221225472 FS_Autofix_Out_Of_Calib_Yaw 1 "true" 0 "false" ;
VAL_ 3221225472 FS_Autofix_Out_Of_Calib_Horizon 1 "true" 0 "false" ;
VAL_ 3221225472 FS_Autofix_Out_Of_Calib 1 "true" 0 "false" ;
VAL_ 3221225472 Exposure_Type 1 "Color" 0 "Texture" ;
VAL_ 3221225472 FS_OutOfFocusStatus 1 "Out Of Focus" 0 "In Focus" ;
VAL_ 3221225472 DayTimeIndicator 2 "Dusk" 1 "Night" 0 "Day" ;
VAL_ 3221225472 Driving_Side 2 "Unknown" 1 "Right" 0 "Left" ;
VAL_ 3221225472 FS_Foggy_Spots_bool 1 "true" 0 "false" ;
VAL_ 3221225472 FS_Frozen_Windshield_bool 1 "true" 0 "false" ;
VAL_ 3221225472 FS_Full_Blockage_bool 1 "true" 0 "false" ;
VAL_ 3221225472 FS_Partial_Blockage_bool 1 "true" 0 "false" ;
VAL_ 3221225472 FS_Smeared_Spots_bool 1 "true" 0 "false" ;
VAL_ 3221225472 FS_Low_Sun_bool 1 "true" 0 "false" ;
VAL_ 3221225472 FS_Blurred_Image_bool 1 "true" 0 "false" ;
VAL_ 3221225472 FS_Road_Spray_bool 1 "true" 0 "false" ;
VAL_ 3221225472 FS_Sun_Ray_bool 1 "true" 0 "false" ;
VAL_ 3221225472 FS_Self_Glare_bool 1 "true" 0 "false" ;
VAL_ 3221225472 FCW_SafetySuppress 3 "Low internal confidence" 2 "SafeState Suppresion" 1 "FailSafe Suppresion" 0 "No Suppression" ;
VAL_ 3221225472 FCW_VO_FCW_SETB 1 "True" 0 "False" ;
VAL_ 3221225472 FCW_VO_AEB_SETC_pattern 1 "True" 0 "False" ;
VAL_ 3221225472 FCW_VO_FCW_SETA 1 "True" 0 "False" ;
VAL_ 3221225472 LBD_Reason_Load_Balance 1 "on" 0 "off" ;
VAL_ 3221225472 LBD_Reason_Sharp_Curve 1 "on" 0 "off" ;
VAL_ 3221225472 LBD_Reason_Bright_Scene 1 "on" 0 "off" ;
VAL_ 3221225472 LBD_Reason_Low_speed 1 "on" 0 "off" ;
VAL_ 3221225472 LBD_Reason_Lit_Night 1 "on" 0 "off" ;
VAL_ 3221225472 LBD_Reason_Street_Light_Grace 1 "on" 0 "off" ;
VAL_ 3221225472 LBD_Reason_Street_Light 1 "on" 0 "off" ;
VAL_ 3221225472 LBD_Reason_Oncoming_Grace 1 "on" 0 "off" ;
VAL_ 3221225472 LBD_Reason_Oncoming 1 "on" 0 "off" ;
VAL_ 3221225472 LBD_Reason_Preceding_Grace 1 "on" 0 "off" ;
VAL_ 3221225472 LBD_Reason_preceding 1 "on" 0 "off" ;
VAL_ 3221225472 HLB_Running_Mode -1 "invalid" 2 "HLB_Full" 1 "HLB_Inactive" 0 "HLB_Day" ;
VAL_ 3221225472 HLB_Decision 1 "HB on" 0 "HB off" ;
VAL_ 3221225472 LDW_Inhibit_Reasons_generic 1 "generic suppression" 0 "no generic suppression" ;
VAL_ 3221225472 LDW_Inhibit_Reasons_accel 1 "acceleration" 0 "no  acceleration" ;
VAL_ 3221225472 LDW_Inhibit_Reasons_brake 1 "brake" 0 "no brake" ;
VAL_ 3221225472 LDW_Inhibit_Reasons_left 1 "left  turn signal active" 0 "no left  turn signal active" ;
VAL_ 3221225472 LDW_Inhibit_Reasons_right 1 "right  turn signal active" 0 "no  right  turn signal active" ;
VAL_ 3221225472 LDW_Inhibit_Reasons_steering 1 "steering wheel rate above threshold" 0 "no steering wheel rate above threshold" ;
VAL_ 3221225472 LDW_NRTA_Reasons_narrow 1 "too narrow lane" 0 "no too narrow lane" ;
VAL_ 3221225472 LDW_NRTA_Reasons_single 1 "single lane performance" 0 "no single lane performance" ;
VAL_ 3221225472 LDW_NRTA_Reasons_right 1 "right lane position is invalid" 0 "right lane position is ok" ;
VAL_ 3221225472 LDW_NRTA_Reasons_left 1 "left lane position is invalid" 0 "left lane position is ok" ;
VAL_ 3221225472 LDW_NRTA_Reasons_speed 1 "speed under threshold" 0 "no speed under threshold" ;
VAL_ 3221225472 LDW_RTA 1 "Valid" 0 "Not Valid" ;
VAL_ 3221225472 Construction_Area 3 "ConstructionAreaDetectedBoth" 2 "ConstructionAreaDetectedRight" 1 "ConstructionAreaDetectedLeft" 0 "ConstructionAreaNotDetected" ;
VAL_ 3221225472 Road_Type 2 "InnerCity" 1 "Highway" 0 "Unknown" ;
VAL_ 3221225472 Lane_Model_Valid 1 "Valid" 0 "Not Valid" ;
VAL_ 3221225472 PD_SafetySuppress 3 "Low Internal confidence" 2 "SafeState Suppresion" 1 "FailSafe Suppression" 0 "No Suppresion" ;
VAL_ 3221225472 PD_alert_L1_pattern 1 "alert " 0 "no alert " ;
VAL_ 3221225472 PD_alert_L2 1 "alert " 0 "no alert " ;
VAL_ 3221225472 PD_alert_L3 1 "alert " 0 "no alert " ;
VAL_ 3221225472 PD_alert_pedsExist 1 "exist" 0 "not exist" ;
VAL_ 3221225472 TSR_TSM_DND_decision 3 "DUSK" 2 "NIGHT" 1 "DAY" 0 "UNKNOWN" ;
VAL_ 3221225472 TSR_TSM_region_code 9 "AUSTRALIA_RC" 8 "KOREA_RC" 7 "SOUTH_AFRICA_RC" 6 "CHINA_RC" 5 "JAPAN_RC" 4 "CANADA_RC" 3 "USA_RC" 2 "GULFREGION_RC" 1 "EUROPE_RC" 0 "INVALID_RC" ;
VAL_ 3221225472 App_Fatal_Error 70 "APP_PATTERN_TEST" 52 "APP_I2C_TIMEOUT_ERROR" 51 "APP_I2C_CAMERA_SELF_RESET" 50 "APP_I2C_VIDEO_GRAB_FAILED" 21 "APP_INIT_CAMERA_INIT" 20 "APP_INIT_FAILED" 11 "APP_CALIBRATION_ERROR" 10 "APP_FS_ERROR" 1 "APP_ERROR" 0 "APP_OK" ;
VAL_ 3221225472 App_Main_State 172 "running tac2" 170 "running burn" 146 "pending vision" 133 "pending tac2" 130 "pending spc" 34 "running spc" 3 "boot" 2 "running vision" 1 "pending" 0 "unkown" ;
VAL_ 3221225472 CS_VehicleSpeedValid 1 "1=valid" 0 "0=invalid" ;
VAL_ 3221225472 CS_VehicleYawValid 1 "1=valid" 0 "0=invalid" ;
VAL_ 3221225472 CS_Wiper 1 "0x1 = on" 0 "0x0 = Off" ;
VAL_ 3221225472 CS_SteeringWheelAngVal 1 "1=valid" 0 "0=invalid" ;
VAL_ 3221225472 CS_ClutchStartSwitchAct 1 "0x1 = true" 0 "0x0 = false" ;
VAL_ 3221225472 CS_TopTrvlClutchSwitchAct 1 "0x1 = true" 0 "0x0 = false" ;
VAL_ 3221225472 CS_HighBeamStatus 1 "0x1 = true" 0 "0x0 = false" ;
VAL_ 3221225472 CS_FogLightActivation 1 "0x1 = true" 0 "0x0 = false" ;
VAL_ 3221225472 CS_AmbientLightLevelValid 1 "1=valid" 0 "0=invalid" ;
